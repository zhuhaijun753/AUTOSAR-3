AUTOSAR XML (schema 4-0-3)
package /MICROSAR
  bsw implementation Com_Impl: programming-language=C, sw-version=8.01.00, used-code-generator=DaVinci Configurator, vendor-id=30, ar-release-version=4.00.03
package /MICROSAR/Com_ib_bswmd/BswModuleDescriptions
  bsw module description Com: provided-entrys=[Com_MainFunctionTx, Com_MainFunctionRx]
    bsw internal behavior ComBehavior
      4 x exclusive area:
        COM_EXCLUSIVE_AREA_COMMON  # The critical section has to lock interrupts to protect common critical sections.
        COM_EXCLUSIVE_AREA_TX  # Interrupts have to be locked, if the function Com_MainFunctionTx() can be interrupted by the function Com_TxConfirmation().
        COM_EXCLUSIVE_AREA_RX  # Interrupts have to be locked, if the function Com_MainFunctionRx() can be interrupted by the function Com_RxIndication().
        COM_EXCLUSIVE_AREA_ROUTE  # Interrupts have to be locked, if the function Com_MainFunctionRouteSignals() can be interrupted by the function Com_RxIndication().
      bsw schedulable entity Com_MainFunctionTx: implemented-entry=Com_MainFunctionTx
      bsw schedulable entity Com_MainFunctionRx: implemented-entry=Com_MainFunctionRx
      bsw timing event Com_MainFunctionTxTimingEvent0: starts-on-event=Com_MainFunctionTx, period=0.01
      bsw timing event Com_MainFunctionRxTimingEvent0: starts-on-event=Com_MainFunctionRx, period=0.01
  bsw module entry Com_MainFunctionTx: call-type=SCHEDULED, execution-context=TASK
  bsw module entry Com_MainFunctionRx: call-type=SCHEDULED, execution-context=TASK

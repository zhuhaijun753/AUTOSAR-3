AUTOSAR XML (schema 4-0-3)
package /COM/VECTOR/CFG/WORKFLOW/SYSDESC/SYNC
  flat map FLATMAP
    21 x flat instance descriptor:
      PPortPrototype: upstream-reference=PpLightStateRear, ecu-extract-reference=PpLightStateRear
      RPortPrototype: upstream-reference=PpDoorStateRearLeft, ecu-extract-reference=PpDoorStateRearLeft
      RPortPrototype_001: upstream-reference=PpDoorStateRearRight, ecu-extract-reference=PpDoorStateRearRight
      ComponentPrototype: upstream-reference=ECU_Composition.CtCoApplication.CpSaInteriorLightFront, ecu-extract-reference=COMPOSITIONTYPE.CpSaInteriorLightFront
      ComponentPrototype_001: upstream-reference=ECU_Composition.CtCoApplication.CpSaDoorFrontRight, ecu-extract-reference=COMPOSITIONTYPE.CpSaDoorFrontRight
      ComponentPrototype_002: upstream-reference=ECU_Composition.CtCoApplication.CpSaDoorFrontLeft, ecu-extract-reference=COMPOSITIONTYPE.CpSaDoorFrontLeft
      ComponentPrototype_004: upstream-reference=ECU_Composition.CtCoApplication.CpApMySwc, ecu-extract-reference=COMPOSITIONTYPE.CpApMySwc
      AssemblySwConnector_001: ecu-extract-reference=CpApMySWCDPpLightStateFrontDCpSaInteriorLightFrontDPpLightState
      AssemblySwConnector_003: ecu-extract-reference=CpSaDoorFrontLeftDPpDoorStateDCpApMySWCDPpDoorStateFrontLeft
      AssemblySwConnector_004: ecu-extract-reference=CpSaDoorFrontRightDPpDoorStateDCpApMySWCDPpDoorStateFrontRight
      DelegationSwConnector: ecu-extract-reference=PpLightStateRearDDCpApMySWCDPpLightStateRear
      DelegationSwConnector_001: ecu-extract-reference=PpDoorStateRearRightDDCtCoApplicationDPpDoorStateRearRight
      DelegationSwConnector_002: ecu-extract-reference=PpDoorStateRearLeftDDCtCoApplicationDPpDoorStateRearLeft
      ComponentPrototype_005: upstream-reference=ECU_Composition.CtCoApplication.CpCddIoHwAb, ecu-extract-reference=COMPOSITIONTYPE.CpCddIoHwAb
      AssemblySwConnector_007: ecu-extract-reference=CtCddIoHwAbDPpDoorFrontLeftDCpSaDoorFrontLeftDPpDoorIoHwAb
      AssemblySwConnector_008: ecu-extract-reference=CtCddIoHwAbDPpDoorFrontRightDCpSaDoorFrontRightDPpDoorIoHwAb
      AssemblySwConnector_009: ecu-extract-reference=CtCddIoHwAbDPpInteriorLightFrontDEFECTDCpSaInteriorLightFrontDPpInteriorLightDefect
      AssemblySwConnector_010: ecu-extract-reference=CtCddIoHwAbDPpInteriorLightFrontDCpSaInteriorLightFrontDPpInteriorLightIoHwAb
      DataMapping: upstream-reference=ECU_Composition.PpDoorStateRearLeft.DeDoorState, ecu-extract-reference=COMPOSITIONTYPE.PpDoorStateRearLeft.DeDoorState
      DataMapping_001: upstream-reference=ECU_Composition.PpLightStateRear.DeLightState, ecu-extract-reference=COMPOSITIONTYPE.PpLightStateRear.DeLightState
      DataMapping_002: upstream-reference=ECU_Composition.PpDoorStateRearRight.DeDoorState, ecu-extract-reference=COMPOSITIONTYPE.PpDoorStateRearRight.DeDoorState

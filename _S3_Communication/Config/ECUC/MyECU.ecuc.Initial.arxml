AUTOSAR XML (schema 4-2-1)
package /InitialEcuC
  ecuc value collection InitialEcuC: ecuc-values=[Can, CanIf, CanNm, CanSM, CanTp, Com, ComM, Dcm, EcuC, EcuM, Nm, PduR]
  module config Can
    CanConfigSet
      CT_CAN00_e98c47e6 (CanController)
        CanControllerBaudrateConfig
    CanGeneral: CanIndex=0
  module config CanIf
    CanIfCtrlDrvCfg: CanIfCtrlDrvInitHohConfigRef=CanIfInitHohCfg, CanIfCtrlDrvNameRef=CanGeneral
      CT_CAN00_e98c47e6 (CanIfCtrlCfg): CanIfCtrlCanCtrlRef=CanConfigSet/CT_CAN00_e98c47e6
    CanIfInitCfg
      MyECU_5faa4e95_NMCanIDRange (CanIfRxPduCfg): CanIfRxPduCanIdType=STANDARD_CAN, CanIfRxPduRef=MyECU_NmRxPdu_5faa4e95
        CHNL (CanIfRxPduCanIdRange): CanIfRxPduCanIdRangeLowerCanId=1024, CanIfRxPduCanIdRangeUpperCanId=1087
      msg_Receive_oCAN00_Rx_3abd61be (CanIfRxPduCfg): CanIfRxPduCanId=528, CanIfRxPduCanIdType=STANDARD_CAN, CanIfRxPduRef=msg_Receive_ff2f8fca
      msg_Transmit_oCAN00_Tx_3abd61be (CanIfTxPduCfg): CanIfTxPduCanId=512, CanIfTxPduCanIdType=STANDARD_CAN, CanIfTxPduRef=msg_Transmit_ca20852c
      msg_nm_MyECU_oCAN00_Tx_3abd61be (CanIfTxPduCfg): CanIfTxPduCanId=1024, CanIfTxPduCanIdType=STANDARD_CAN, CanIfTxPduRef=msg_nm_MyECU_5fb848b3
    CanIfPrivateCfg
    CanIfPublicCfg: CanIfPublicPnSupport=false
  module config CanNm
    CanNmGlobalConfig: CanNmComUserDataSupport=false, CanNmPnEiraCalcEnabled=false, CanNmUserDataEnabled=true
      CAN00_CAN_17d0077e (CanNmChannelConfig):
        CanNmMsgCycleTime = 0.1
        CanNmMsgReducedTime = 0.05
        CanNmRepeatMessageTime = 0.4
        CanNmTimeoutTime = 1
        CanNmUserDataLength = 6
        CanNmWaitBusSleepTime = 0.75
        CanNmComMNetworkHandleRef = ComMConfigSet/CAN00_f26020e5
        CAN00_CAN_17d0077e_RxPdu_2d241a48 (CanNmRxPdu): CanNmRxPduRef=MyECU_NmRxPdu_5faa4e95
        msg_nm_MyECU_oCAN00_3abd61be (CanNmTxPdu): CanNmTxPduRef=msg_nm_MyECU_5fb848b3
  module config CanSM
    CanSMConfiguration
      CHNL_f276589c (CanSMManagerNetwork): CanSMComMNetworkHandleRef=ComMConfigSet/CAN00_f26020e5
        CT_CAN00_e98c47e6 (CanSMController): CanSMControllerId=CanIfCtrlDrvCfg/CT_CAN00_e98c47e6
  module config Com
    ComConfig
      msg_Receive_oCAN00_In (ComIPdu):
        ComIPduDirection = RECEIVE
        ComIPduType = NORMAL
        ComIPduGroupRef = MyECU_oCAN00_Rx_fcef2243
        ComIPduSignalRef = sig_State_RearInteriorLight_In
        ComIPduSignalRef = sig_State_RearLeftDoor_In
        ComIPduSignalRef = sig_State_RearRightDoor_In
        ComPduIdRef = msg_Receive_ff2f8fca
      msg_Transmit_oCAN00_Out (ComIPdu):
        ComIPduDirection = SEND
        ComIPduType = NORMAL
        ComIPduGroupRef = MyECU_oCAN00_Tx_fcef2243
        ComIPduSignalRef = sig_RearInteriorLight_Out
        ComPduIdRef = msg_Transmit_ca20852c
        ComTxIPdu: ComMinimumDelayTime=0, ComTxIPduUnusedAreasDefault=0
          ComTxModeFalse
            ComTxMode: ComTxModeMode=PERIODIC, ComTxModeTimeOffset=0, ComTxModeTimePeriod=0.1
          ComTxModeTrue
            ComTxMode: ComTxModeMode=PERIODIC, ComTxModeTimeOffset=0, ComTxModeTimePeriod=0.1
      MyECU_oCAN00_Rx_fcef2243 (ComIPduGroup)
      MyECU_oCAN00_Tx_fcef2243 (ComIPduGroup)
      4 x ComSignal, all with ComBitSize=1, ComSignalEndianness=LITTLE_ENDIAN, ComSignalInitValue=0, ComTransferProperty=PENDING:
        sig_RearInteriorLight_Out: ComBitPosition=0, ComSystemTemplateSystemSignalRef=sig_RearInteriorLight
        sig_State_RearInteriorLight_In: ComBitPosition=2, ComSystemTemplateSystemSignalRef=sig_State_RearInteriorLight
        sig_State_RearLeftDoor_In: ComBitPosition=0, ComSystemTemplateSystemSignalRef=sig_State_RearLeftDoor
        sig_State_RearRightDoor_In: ComBitPosition=1, ComSystemTemplateSystemSignalRef=sig_State_RearRightDoor
    ComGeneral
  module config ComM
    ComMConfigSet
      CAN00_f26020e5 (ComMChannel): ComMBusType=COMM_BUS_TYPE_CAN
        ComMNetworkManagement
        CHNL_f276589c (ComMUserPerChannel)
    ComMGeneral: ComMPncIdCounting=COMM_PNC_ID_COUNT_FROM_NM_MESSAGE
  module config EcuC
    EcucPduCollection
      4 x Pdu:
        MyECU_NmRxPdu_5faa4e95: PduLength=8, SysTPduToFrameMappingRef=msg_nm_RearECU
        msg_Receive_ff2f8fca: PduLength=1, SysTPduToFrameMappingRef=msg_Receive
        msg_Transmit_ca20852c: PduLength=1, SysTPduToFrameMappingRef=msg_Transmit
        msg_nm_MyECU_5fb848b3: PduLength=8, SysTPduToFrameMappingRef=msg_nm_MyECU
  module config EcuM
    EcuMConfiguration
      EcuMCommonConfiguration
      EcuMFlexConfiguration: EcuMFlexModuleConfigurationRef=CanConfigSet
  module config Nm
    CAN00_f26020e5 (NmChannelConfig): NmComMChannelRef=ComMConfigSet/CAN00_f26020e5
      CAN00_CAN_17d0077e (NmBusType)
        NmStandardBusNmConfig: NmStandardBusType=NM_BUSNM_CANNM
    NmGlobalConfig
      NmGlobalFeatures: NmComUserDataSupport=false, NmNodeIdEnabled=true, NmUserDataEnabled=true
      NmGlobalProperties
  module config PduR
    CanIf (PduRBswModules): PduRBswModuleRef=CanIf
    Com (PduRBswModules): PduRBswModuleRef=Com
    PduRGeneral
    PduRRoutingTables: PduRConfigurationId=0
      PduRRoutingTable
        Can_PT_msg_Receive_0fb271d2_In (PduRRoutingPath)
          DST_Can_PT_msg_Receive_0fb271d2_In (PduRDestPdu): PduRDestPduRef=msg_Receive_ff2f8fca
          SRC_Can_PT_msg_Receive_0fb271d2_In (PduRSrcPdu): PduRSrcPduRef=msg_Receive_ff2f8fca
        Can_PT_msg_Transmit_0fb271d2_Out (PduRRoutingPath)
          DST_Can_PT_msg_Transmit_0fb271d2_Out (PduRDestPdu): PduRDestPduRef=msg_Transmit_ca20852c
          SRC_Can_PT_msg_Transmit_0fb271d2_Out (PduRSrcPdu): PduRSrcPduRef=msg_Transmit_ca20852c

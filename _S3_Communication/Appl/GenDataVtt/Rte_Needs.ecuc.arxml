AUTOSAR XML (schema 4-0-3)
package /DaVinci_Project
  module config Com
    ComConfig
      3 x ComSignal, all with ComSignalType=UINT8:
        sig_RearInteriorLight_Out
        sig_State_RearLeftDoor_In: ComNotification=Rte_COMCbk_sig_State_RearLeftDoor_In
        sig_State_RearRightDoor_In: ComNotification=Rte_COMCbk_sig_State_RearRightDoor_In
  module config Rte
    15 x RteBswModuleInstance:
      BswM
        BswM_MainFunctionTimingEvent0 (RteBswEventToTaskMapping): RteBswUsedOsEventRef=Rte_Ev_Cyclic2_SchM_Task_0_10ms, RteBswUsedOsAlarmRef=Os/Rte_Al_TE2_SchM_Task_0_10ms
      Can
        3 x RteBswEventToTaskMapping, all with RteBswUsedOsEventRef=Rte_Ev_Cyclic2_SchM_Task_0_10ms, RteBswUsedOsAlarmRef=Os/Rte_Al_TE2_SchM_Task_0_10ms:
          Can_MainFunction_BusOffTimingEvent0
          Can_MainFunction_ModeTimingEvent0
          Can_MainFunction_WakeupTimingEvent0
      CanIf
      CanNm
        CanNm_MainFunctionTimingEvent0 (RteBswEventToTaskMapping): RteBswUsedOsEventRef=Rte_Ev_Cyclic2_SchM_Task_0_10ms, RteBswUsedOsAlarmRef=Os/Rte_Al_TE2_SchM_Task_0_10ms
      CanSM
        CanSM_MainFunctionTimingEvent0 (RteBswEventToTaskMapping): RteBswUsedOsEventRef=Rte_Ev_Cyclic2_SchM_Task_0_10ms, RteBswUsedOsAlarmRef=Os/Rte_Al_TE2_SchM_Task_0_10ms
      Com
        Com_MainFunctionRxTimingEvent0 (RteBswEventToTaskMapping): RteBswUsedOsEventRef=Rte_Ev_Cyclic2_SchM_Task_0_10ms, RteBswUsedOsAlarmRef=Os/Rte_Al_TE2_SchM_Task_0_10ms
        Com_MainFunctionTxTimingEvent0 (RteBswEventToTaskMapping): RteBswUsedOsEventRef=Rte_Ev_Cyclic2_SchM_Task_0_10ms, RteBswUsedOsAlarmRef=Os/Rte_Al_TE2_SchM_Task_0_10ms
      ComM
        ComM_MainFunction_0TimingEvent0 (RteBswEventToTaskMapping): RteBswUsedOsEventRef=Rte_Ev_Cyclic2_SchM_Task_0_20ms, RteBswUsedOsAlarmRef=Os/Rte_Al_TE2_SchM_Task_0_20ms
      Dem
        Dem_MainFunctionTimingEvent0 (RteBswEventToTaskMapping): RteBswUsedOsEventRef=Rte_Ev_Cyclic2_SchM_Task_0_10ms, RteBswUsedOsAlarmRef=Os/Rte_Al_TE2_SchM_Task_0_10ms
      Det
      EcuM
        EcuM_MainFunctionTimingEvent0 (RteBswEventToTaskMapping): RteBswUsedOsEventRef=Rte_Ev_Cyclic2_SchM_Task_0_10ms, RteBswUsedOsAlarmRef=Os/Rte_Al_TE2_SchM_Task_0_10ms
      Fee
        Fee_MainFunctionTimingEvent0 (RteBswEventToTaskMapping): RteBswUsedOsEventRef=Rte_Ev_Run_Fee_Fee_MainFunction, RteBswUsedOsAlarmRef=Os/Rte_Al_TE_Fee_Fee_MainFunction
      Fls
        Fls_MainFunctionTimingEvent0 (RteBswEventToTaskMapping): RteBswUsedOsEventRef=Rte_Ev_Cyclic2_SchM_Task_0_10ms, RteBswUsedOsAlarmRef=Os/Rte_Al_TE2_SchM_Task_0_10ms
      Nm
      NvM
        NvM_MainFunctionTimingEvent0 (RteBswEventToTaskMapping): RteBswUsedOsEventRef=Rte_Ev_Cyclic2_SchM_Task_0_10ms, RteBswUsedOsAlarmRef=Os/Rte_Al_TE2_SchM_Task_0_10ms
      PduR
    11 x RteSwComponentInstance:
      BswM_EcuSwComposition
        Timer_BswM_MainFunction (RteEventToTaskMapping): RteUsedOsEventRef=Rte_Ev_Cyclic2_SchM_Task_0_10ms, RteUsedOsAlarmRef=Os/Rte_Al_TE2_SchM_Task_0_10ms
      ComM_EcuSwComposition
        Timer_ComM_MainFunction_0 (RteEventToTaskMapping): RteUsedOsEventRef=Rte_Ev_Cyclic2_SchM_Task_0_20ms, RteUsedOsAlarmRef=Os/Rte_Al_TE2_SchM_Task_0_20ms
      CpApMySwc_EcuSwComposition
        4 x RteEventToTaskMapping, all with RteUsedOsEventRef=Rte_Ev_Run_CpApMySwc_RCtApMySwcCode:
          DRT_RCtApMySwcCode_PpDoorStateFrontLeft_DeDoorState
          DRT_RCtApMySwcCode_PpDoorStateFrontRight_DeDoorState
          DRT_RCtApMySwcCode_PpDoorStateRearLeft_DeDoorState
          DRT_RCtApMySwcCode_PpDoorStateRearRight_DeDoorState
      CtCddIoHwAb_EcuSwComposition
      CpSaDoorFrontLeft_EcuSwComposition
        TMT_RCtSaDoorReadDoor (RteEventToTaskMapping): RteUsedOsEventRef=Rte_Ev_Cyclic_IO_Task_0_200ms, RteUsedOsAlarmRef=Os/Rte_Al_TE_IO_Task_0_200ms
      CpSaDoorFrontRight_EcuSwComposition
        TMT_RCtSaDoorReadDoor (RteEventToTaskMapping): RteUsedOsEventRef=Rte_Ev_Cyclic_IO_Task_0_200ms, RteUsedOsAlarmRef=Os/Rte_Al_TE_IO_Task_0_200ms
      CpSaInteriorLightFront_EcuSwComposition
        DRT_RCtSaInteriorLightSwitchLight_PpLightState_Element (RteEventToTaskMapping): RteUsedOsEventRef=Rte_Ev_Run_CpSaInteriorLightFront_RCtSaInteriorLightSwitchLight
      Dem_EcuSwComposition
        Timer_Dem_MainFunction (RteEventToTaskMapping): RteUsedOsEventRef=Rte_Ev_Cyclic2_SchM_Task_0_10ms, RteUsedOsAlarmRef=Os/Rte_Al_TE2_SchM_Task_0_10ms
      Det_EcuSwComposition
      EcuM_EcuSwComposition
        Timer_EcuM_MainFunction (RteEventToTaskMapping): RteUsedOsEventRef=Rte_Ev_Cyclic2_SchM_Task_0_10ms, RteUsedOsAlarmRef=Os/Rte_Al_TE2_SchM_Task_0_10ms
      NvM_EcuSwComposition
        Timer_NvM_MainFunction (RteEventToTaskMapping): RteUsedOsEventRef=Rte_Ev_Cyclic2_SchM_Task_0_10ms, RteUsedOsAlarmRef=Os/Rte_Al_TE2_SchM_Task_0_10ms
    RteOsInteraction
      4 x RteUsedOsActivation, all with RteExpectedActivationOffset=0:
        Rte_Al_TE_IO_Task_0_200ms: RteActivationOsAlarmRef=Os/Rte_Al_TE_IO_Task_0_200ms, RteActivationOsTaskRef=IO_Task
        Rte_Al_TE2_SchM_Task_0_10ms: RteActivationOsAlarmRef=Os/Rte_Al_TE2_SchM_Task_0_10ms, RteActivationOsTaskRef=SchM_Task
        Rte_Al_TE2_SchM_Task_0_20ms: RteActivationOsAlarmRef=Os/Rte_Al_TE2_SchM_Task_0_20ms, RteActivationOsTaskRef=SchM_Task
        Rte_Al_TE_Fee_Fee_MainFunction: RteActivationOsAlarmRef=Os/Rte_Al_TE_Fee_Fee_MainFunction, RteActivationOsTaskRef=SchM_Task
  module config NvM
  module config Os
    IO_Task (OsTask):
      OsTaskActivation = 1
      OsTaskPriority = 3
      OsTaskSchedule = FULL
      OsTaskEventRef = Rte_Ev_Cyclic_IO_Task_0_200ms
      OsTaskEventRef = Rte_Ev_Run_CpSaInteriorLightFront_RCtSaInteriorLightSwitchLight
    Rte_Al_TE_IO_Task_0_200ms (OsAlarm): OsAlarmCounterRef=SystemTimer
      OsAlarmAction
        OsAlarmSetEvent: OsAlarmSetEventRef=Rte_Ev_Cyclic_IO_Task_0_200ms, OsAlarmSetEventTaskRef=IO_Task
    My_Task (OsTask): OsTaskActivation=1, OsTaskPriority=2, OsTaskSchedule=FULL, OsTaskEventRef=Rte_Ev_Run_CpApMySwc_RCtApMySwcCode
    SchM_Task (OsTask):
      OsTaskActivation = 1
      OsTaskPriority = 6
      OsTaskSchedule = FULL
      OsTaskEventRef = Rte_Ev_Cyclic2_SchM_Task_0_10ms
      OsTaskEventRef = Rte_Ev_Cyclic2_SchM_Task_0_20ms
      OsTaskEventRef = Rte_Ev_Run_Fee_Fee_MainFunction
    3 x OsAlarm, all with OsAlarmCounterRef=SystemTimer:
      Rte_Al_TE2_SchM_Task_0_10ms
        OsAlarmAction
          OsAlarmSetEvent: OsAlarmSetEventRef=Rte_Ev_Cyclic2_SchM_Task_0_10ms, OsAlarmSetEventTaskRef=SchM_Task
      Rte_Al_TE2_SchM_Task_0_20ms
        OsAlarmAction
          OsAlarmSetEvent: OsAlarmSetEventRef=Rte_Ev_Cyclic2_SchM_Task_0_20ms, OsAlarmSetEventTaskRef=SchM_Task
      Rte_Al_TE_Fee_Fee_MainFunction
        OsAlarmAction
          OsAlarmSetEvent: OsAlarmSetEventRef=Rte_Ev_Run_Fee_Fee_MainFunction, OsAlarmSetEventTaskRef=SchM_Task
    6 x OsEvent:
      Rte_Ev_Cyclic2_SchM_Task_0_10ms
      Rte_Ev_Cyclic2_SchM_Task_0_20ms
      Rte_Ev_Cyclic_IO_Task_0_200ms
      Rte_Ev_Run_CpApMySwc_RCtApMySwcCode
      Rte_Ev_Run_CpSaInteriorLightFront_RCtSaInteriorLightSwitchLight
      Rte_Ev_Run_Fee_Fee_MainFunction
  ecuc value collection DaVinci_Project: ecuc-values=[Com, Rte, Os, NvM]

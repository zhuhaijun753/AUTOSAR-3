AUTOSAR XML (schema 4-0-3)
package /COM/VECTOR/CFG/WORKFLOW/SYSDESC/SYNC
  flat map FLATMAP
    12 x flat instance descriptor:
      ComponentPrototype: upstream-reference=ECU_Composition.CtCoApplication.CpSaInteriorLightFront, ecu-extract-reference=COMPOSITIONTYPE.CpSaInteriorLightFront
      ComponentPrototype_001: upstream-reference=ECU_Composition.CtCoApplication.CpSaDoorFrontRight, ecu-extract-reference=COMPOSITIONTYPE.CpSaDoorFrontRight
      ComponentPrototype_002: upstream-reference=ECU_Composition.CtCoApplication.CpSaDoorFrontLeft, ecu-extract-reference=COMPOSITIONTYPE.CpSaDoorFrontLeft
      ComponentPrototype_004: upstream-reference=ECU_Composition.CtCoApplication.CpApMySwc, ecu-extract-reference=COMPOSITIONTYPE.CpApMySwc
      AssemblySwConnector_001: ecu-extract-reference=CpApMySWCDPpLightStateFrontDCpSaInteriorLightFrontDPpLightState
      AssemblySwConnector_003: ecu-extract-reference=CpSaDoorFrontLeftDPpDoorStateDCpApMySWCDPpDoorStateFrontLeft
      AssemblySwConnector_004: ecu-extract-reference=CpSaDoorFrontRightDPpDoorStateDCpApMySWCDPpDoorStateFrontRight
      ComponentPrototype_005: upstream-reference=ECU_Composition.CtCoApplication.CpCddIoHwAb, ecu-extract-reference=COMPOSITIONTYPE.CpCddIoHwAb
      AssemblySwConnector_007: ecu-extract-reference=CtCddIoHwAbDPpDoorFrontLeftDCpSaDoorFrontLeftDPpDoorIoHwAb
      AssemblySwConnector_008: ecu-extract-reference=CtCddIoHwAbDPpDoorFrontRightDCpSaDoorFrontRightDPpDoorIoHwAb
      AssemblySwConnector_009: ecu-extract-reference=CtCddIoHwAbDPpInteriorLightFrontDEFECTDCpSaInteriorLightFrontDPpInteriorLightDefect
      AssemblySwConnector_010: ecu-extract-reference=CtCddIoHwAbDPpInteriorLightFrontDCpSaInteriorLightFrontDPpInteriorLightIoHwAb

AUTOSAR XML (schema 4-2-1)
package /ECUCompositionTypes
  composition sw component type ECU_Composition
    component CtCoApplication: type=CtCoApplication
package /EndToEndProtections
  end to end protection set EndToEndConnections
package /VehicleProject
  system System: category=SYSTEM_EXTRACT
    system mapping System_MPPNG
    root-software-compositions:
      root sw composition prototype ECU_Composition: software-composition=ECU_Composition

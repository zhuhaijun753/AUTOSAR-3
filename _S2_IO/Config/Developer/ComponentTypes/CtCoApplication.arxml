AUTOSAR XML (schema 4-2-1)
package /ComponentTypes
  composition sw component type CtCoApplication
    5 x component:
      CpApMySwc: type=CtApMySwc
      CpCddIoHwAb: type=CtCddIoHwAb
      CpSaDoorFrontLeft: type=CtSaDoor
      CpSaDoorFrontRight: type=CtSaDoor
      CpSaInteriorLightFront: type=CtSaInteriorLight
    connect CpApMySwc.PpLightStateFront -> CpSaInteriorLightFront.PpLightState
    connect CpCddIoHwAb.PpDoorFrontLeft -> CpSaDoorFrontLeft.PpDoorIoHwAb
    connect CpCddIoHwAb.PpDoorFrontRight -> CpSaDoorFrontRight.PpDoorIoHwAb
    connect CpCddIoHwAb.PpInteriorLightFrontDEFECT -> CpSaInteriorLightFront.PpInteriorLightDefect
    connect CpCddIoHwAb.PpInteriorLightFront -> CpSaInteriorLightFront.PpInteriorLightIoHwAb
    connect CpSaDoorFrontLeft.PpDoorState -> CpApMySwc.PpDoorStateFrontLeft
    connect CpSaDoorFrontRight.PpDoorState -> CpApMySwc.PpDoorStateFrontRight

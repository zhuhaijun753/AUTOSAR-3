AUTOSAR XML (schema 4-2-1)
standard types defined: boolean, UInt8, uint32_DataConstr, uint8_DataConstr, uint32, uint8
package /ComponentTypes/DataTypeMappingSets
  data type mapping set DemoTypeMapping
    data-type-maps:
      application-data-type=AdtDoorState, implementation-data-type=IdtDoorState
      application-data-type=AdtLightOnOffCounter, implementation-data-type=uint32
      application-data-type=AdtLightState, implementation-data-type=IdtLightState
      application-data-type=AdtOdometer, implementation-data-type=uint32
package /DataType/Semantics
  compu method CM_sig_RearInteriorLight: phys=raw for raw 0..1
  compu method CM_sig_State_RearInteriorLight: phys=raw for raw 0..1
  compu method CM_sig_State_RearLeftDoor: phys=raw for raw 0..1
  compu method CM_sig_State_RearRightDoor: phys=raw for raw 0..1
package /DataTypes
  4 x app type, all with sw-calibration-access=READ-ONLY:
    AdtDoorState: category=BOOLEAN
    AdtLightOnOffCounter: category=VALUE
    AdtLightState: category=BOOLEAN
    AdtOdometer: category=VALUE
  4 x impl type, all with type-emitter=RTE:
    IdtDioValueType: implementation-data-type=uint8
    IdtDisplayIgnitionState: category=VALUE, base-type=UInt8, sw-calibration-access=READ-ONLY, compu {0=BSWM_REQUESTSHUTDOWN_INACTIVE, 1=BSWM_REQUESTSHUTDOWN_ACTIVE}
    IdtDoorState: compu {0=CMDOORSTATE_DOORCLOSED, 1=CMDOORSTATE_DOOROPEN}, implementation-data-type=boolean
    IdtLightState: compu {0=CMLIGHTSTATE_LIGHTOFF, 1=CMLIGHTSTATE_LIGHTON}, implementation-data-type=boolean
package /Predefined_DEV/ImplementationDataTypes
  impl type NvM_RequestResultType: compu {0=NVM_REQ_OK, 1=NVM_REQ_NOT_OK, 2=NVM_REQ_PENDING, 3=NVM_REQ_INTEGRITY_FAILED, 4=NVM_REQ_BLOCK_SKIPPED, 5=NVM_REQ_NV_INVALIDATED, 6=NVM_REQ_CANCELED, 7=NVM_REQ_REDUNDANCY_FAILED, 8=NVM_REQ_RESTORED_FROM_ROM}, implementation-data-type=uint8
  impl type NvM_ServiceIdType: compu {6=NVM_READ_BLOCK, 7=NVM_WRITE_BLOCK, 8=NVM_RESTORE_BLOCK_DEFAULTS, 9=NVM_ERASE_BLOCK, 11=NVM_INVALIDATE_NV_BLOCK, 12=NVM_READ_ALL}, implementation-data-type=uint8

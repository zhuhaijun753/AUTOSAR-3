[part 1 of 2: package /ActiveEcuC]
AUTOSAR XML (schema 4-2-1)
package /ActiveEcuC
  ecuc value collection ActiveEcuC: ecu-extract=SYSTEM
    ecuc-values:
      BswM
      CanIf
      CanNm
      CanSM
      Can
      ComM
      Com
      Crc
      Det
      Dio
      EcuC
      EcuM
      Fee
      Fls
      Mcu
      MemIf
      Nm
      NvM
      Os
      PduR
      Rte
      VTTCan
      VTTCntrl
      VTTDio
      VTTEcuC
      VTTFls
      VTTMcu
      VTTOs
      Dem
      Dcm
      CanTp
  module config BswM: implementation-config-variant=VARIANT-PRE-COMPILE, module-description=BswM_Impl
    BswMGeneral:
      BswMMainFunctionPeriod = 0.01
      BswMVersionInfoApi = false
      BswMDevErrorDetect = true
      BswMCanSMEnabled = true
      BswMComMEnabled = true
      BswMDcmEnabled = true
      BswMEcuMEnabled = true
      BswMEthSMEnabled = false
      BswMFrSMEnabled = false
      BswMGenericRequestEnabled = true
      BswMLinSMEnabled = false
      BswMLinTPEnabled = false
      BswMNvMEnabled = true
      BswMJ1939NmEnabled = false
      BswMNmEnabled = false
      BswMSdEnabled = false
      BswMPduREnabled = false
      BswMRuleControlEnabled = false
      BswMModeCheck = true
      BswMUserIncludeFiles: BswMUserIncludeFile=main.h
      BswMCommonData
      BswMGeneration:
        BswMOutOfBoundsWriteSanitizer = false
        BswMOutOfBoundsReadSanitizer = false
        BswMReduceConstantData2Define = true
        BswMReduceDataByStreaming = false
        BswMBoolDataInArrayOfStructStrategy = BITMASKING
        BswMInterfacesForDeactivatedData = false
    BswMConfig
      BswMArbitration
        SWCModeSwitch_BswM_MdgBswMRequestShutdown (BswMModeRequestPort): BswMRequestProcessing=BSWM_DEFERRED, BswMArbitrateOnInit=false
          BswMModeRequestSource
            BswMSwcModeNotification: BswMSwcModeNotificationModeDeclarationGroupPrototypeRef=BswM_MDGP_MdgBswMRequestShutdown
          BswMModeInitValue
            BswMSwcModeInitValue: BswMSwcModeInitValueRef=BSWM_REQUESTSHUTDOWN_INACTIVE
        BswMRule_EcuShutdown (BswMRule):
          BswMNestedExecutionOnly = false
          BswMRuleInitState = BSWM_FALSE
          BswMRuleId = 1
          BswMRuleExpressionRef = CleRequestShutdownActive
          BswMRuleTrueActionList = BswMActionList_EcuShutdown
        AleRequestShutdownActive (BswMModeCondition): BswMConditionType=BSWM_EQUALS, BswMConditionMode=SWCModeSwitch_BswM_MdgBswMRequestShutdown
          BswMConditionValue
            BswMModeDeclaration: BswMModeValueRef=BSWM_REQUESTSHUTDOWN_ACTIVE
        CleRequestShutdownActive (BswMLogicalExpression): BswMLogicalOperator=BSWM_AND, BswMArgumentRef=AleRequestShutdownActive
        CC_CAN00_f26020e5_RX_DM (BswMRule):
          BswMNestedExecutionOnly = false
          BswMRuleInitState = BSWM_FALSE
          BswMRuleId = 3
          BswMRuleExpressionRef = CC_LE_CAN00_f26020e5_RX_DM
          BswMRuleFalseActionList = CC_AL_CAN00_f26020e5_Disable_DM
          BswMRuleTrueActionList = CC_AL_CAN00_f26020e5_Enable_DM
        CC_LE_CAN00_f26020e5_RX_DM (BswMLogicalExpression): BswMLogicalOperator=BSWM_AND, BswMArgumentRef=CC_Cond_CanSMIndication_CAN00_f26020e5_EQ_CANSM_BSWM_FULL_COMMUNICATION
        CC_Cond_CanSMIndication_CAN00_f26020e5_EQ_CANSM_BSWM_FULL_COMMUNICATION (BswMModeCondition): BswMConditionType=BSWM_EQUALS, BswMConditionMode=CC_CanSMIndication_CAN00_f26020e5
          BswMConditionValue
            BswMBswMode: BswMBswRequestedMode=CANSM_BSWM_FULL_COMMUNICATION
        CC_CanSMIndication_CAN00_f26020e5 (BswMModeRequestPort): BswMRequestProcessing=BSWM_IMMEDIATE, BswMArbitrateOnInit=false
          BswMModeRequestSource
            BswMCanSMIndication: BswMCanSMChannelRef=ComMConfigSet/CAN00_f26020e5
          BswMModeInitValue
            BswMBswModeInitValue: BswMBswModeInitValueMode=CANSM_BSWM_NO_COMMUNICATION
        CC_CAN00_f26020e5_RX (BswMRule):
          BswMNestedExecutionOnly = false
          BswMRuleInitState = BSWM_FALSE
          BswMRuleId = 2
          BswMRuleExpressionRef = CC_LE_CAN00_f26020e5_RX
          BswMRuleFalseActionList = CC_AL_CAN00_f26020e5_RX_Disable
          BswMRuleTrueActionList = CC_AL_CAN00_f26020e5_RX_EnableNoinit
        CC_LE_CAN00_f26020e5_RX (BswMLogicalExpression): BswMLogicalOperator=BSWM_AND, BswMArgumentRef=CC_Cond_CanSMIndication_CAN00_f26020e5_NEQ_CANSM_BSWM_NO_COMMUNICATION
        CC_Cond_CanSMIndication_CAN00_f26020e5_NEQ_CANSM_BSWM_NO_COMMUNICATION (BswMModeCondition): BswMConditionType=BSWM_EQUALS_NOT, BswMConditionMode=CC_CanSMIndication_CAN00_f26020e5
          BswMConditionValue
            BswMBswMode: BswMBswRequestedMode=CANSM_BSWM_NO_COMMUNICATION
        CC_CAN00_f26020e5_TX (BswMRule):
          BswMNestedExecutionOnly = false
          BswMRuleInitState = BSWM_FALSE
          BswMRuleId = 4
          BswMRuleExpressionRef = CC_LE_CAN00_f26020e5_TX
          BswMRuleFalseActionList = CC_AL_CAN00_f26020e5_TX_Disable
          BswMRuleTrueActionList = CC_AL_CAN00_f26020e5_TX_EnableNoinit
        CC_LE_CAN00_f26020e5_TX (BswMLogicalExpression): BswMLogicalOperator=BSWM_AND, BswMArgumentRef=CC_Cond_CanSMIndication_CAN00_f26020e5_EQ_CANSM_BSWM_FULL_COMMUNICATION
        ESH_PrepToWait (BswMRule):
          BswMNestedExecutionOnly = false
          BswMRuleInitState = BSWM_FALSE
          BswMRuleId = 9
          BswMRuleExpressionRef = ESH_LE_PrepShutdownToWaitForNvM
          BswMRuleTrueActionList = ESH_AL_PrepShutdownToWaitForNvM
        ESH_LE_PrepShutdownToWaitForNvM (BswMLogicalExpression): BswMLogicalOperator=BSWM_AND, BswMArgumentRef=ESH_Cond_StateIsPrepShutdown, BswMArgumentRef=ESH_Cond_ModeIsShutdown
        ESH_Cond_StateIsPrepShutdown (BswMModeCondition): BswMConditionType=BSWM_EQUALS, BswMConditionMode=ESH_State
          BswMConditionValue
            BswMBswMode: BswMBswRequestedMode=ESH_PREP_SHUTDOWN
        ESH_State (BswMModeRequestPort): BswMRequestProcessing=BSWM_IMMEDIATE, BswMArbitrateOnInit=true
          BswMModeRequestSource
            BswMGenericRequest: BswMModeRequesterId=230, BswMRequestedModeMax=7
              7 x BswMGenericRequestMode:
                ESH_INIT: BswMGenericRequestModeValue=0
                ESH_RUN: BswMGenericRequestModeValue=1
                ESH_POST_RUN: BswMGenericRequestModeValue=2
                ESH_PREP_SHUTDOWN: BswMGenericRequestModeValue=3
                ESH_WAIT_FOR_NVM: BswMGenericRequestModeValue=4
                ESH_SHUTDOWN: BswMGenericRequestModeValue=5
                ESH_WAKEUP: BswMGenericRequestModeValue=6
          BswMModeInitValue
            BswMBswModeInitValue: BswMBswModeInitValueMode=ESH_INIT
        ESH_WaitToShutdown (BswMRule):
          BswMNestedExecutionOnly = false
          BswMRuleInitState = BSWM_FALSE
          BswMRuleId = 12
          BswMRuleExpressionRef = ESH_LE_WaitForNvMToShutdown
          BswMRuleTrueActionList = ESH_AL_WaitForNvMToShutdown
        ESH_LE_WaitForNvMToShutdown (BswMLogicalExpression): BswMLogicalOperator=BSWM_AND, BswMArgumentRef=ESH_Cond_StateIsWaitForNvm, BswMArgumentRef=ESH_LE_WriteNotPending, BswMArgumentRef=ESH_LE_NoWakeup
        ESH_Cond_StateIsWaitForNvm (BswMModeCondition): BswMConditionType=BSWM_EQUALS, BswMConditionMode=ESH_State
          BswMConditionValue
            BswMBswMode: BswMBswRequestedMode=ESH_WAIT_FOR_NVM
        ESH_WaitToWakeup (BswMRule):
          BswMNestedExecutionOnly = false
          BswMRuleInitState = BSWM_FALSE
          BswMRuleId = 13
          BswMRuleExpressionRef = ESH_LE_WaitForNvMToWakeup
          BswMRuleTrueActionList = ESH_AL_WaitForNvMWakeup
        ESH_LE_WaitForNvMToWakeup (BswMLogicalExpression): BswMLogicalOperator=BSWM_AND, BswMArgumentRef=ESH_Cond_StateIsWaitForNvm, BswMArgumentRef=ESH_LE_ValidWakeup
        ESH_LE_ValidWakeup (BswMLogicalExpression): BswMLogicalOperator=BSWM_OR, BswMArgumentRef=ESH_Cond_ValidatedWakeups, BswMArgumentRef=ESH_Cond_ComMPendingRequests
        ESH_Cond_ValidatedWakeups (BswMModeCondition): BswMConditionType=BSWM_EQUALS_NOT, BswMConditionMode=ESH_EcuM_GetValidatedWakeupEvents
          BswMConditionValue
            BswMBswMode: BswMBswRequestedMode=0
        ESH_EcuM_GetValidatedWakeupEvents (BswMModeRequestPort): BswMRequestProcessing=BSWM_DEFERRED, BswMArbitrateOnInit=false
          BswMModeRequestSource
            BswMUserConditionRequest: BswMUserCondition=EcuM_GetValidatedWakeupEvents()
        ESH_RunToPostRun (BswMRule):
          BswMNestedExecutionOnly = false
          BswMRuleInitState = BSWM_FALSE
          BswMRuleId = 10
          BswMRuleExpressionRef = ESH_LE_RunToPostRun
          BswMRuleTrueActionList = ESH_AL_ExitRun
        ESH_LE_RunToPostRun (BswMLogicalExpression):
          BswMLogicalOperator = BSWM_AND
          BswMArgumentRef = ESH_Cond_StateIsRun
          BswMArgumentRef = ESH_LE_AllChannelsNoCom
          BswMArgumentRef = ESH_Cond_SelfRunReqTimerExpired
          BswMArgumentRef = ESH_Cond_ModeIsRun
        ESH_Cond_StateIsRun (BswMModeCondition): BswMConditionType=BSWM_EQUALS, BswMConditionMode=ESH_State
          BswMConditionValue
            BswMBswMode: BswMBswRequestedMode=ESH_RUN
        ESH_LE_AllChannelsNoCom (BswMLogicalExpression): BswMLogicalOperator=BSWM_AND, BswMArgumentRef=ESH_Cond_NoComOn_CAN00_f26020e5
        ESH_Cond_SelfRunReqTimerExpired (BswMModeCondition): BswMConditionType=BSWM_EQUALS, BswMConditionMode=ESH_SelfRunRequestTimer
          BswMConditionValue
            BswMBswMode: BswMBswRequestedMode=BSWM_TIMER_EXPIRED
        ESH_SelfRunRequestTimer (BswMModeRequestPort): BswMRequestProcessing=BSWM_DEFERRED, BswMArbitrateOnInit=false
          BswMModeRequestSource
            BswMTimer
          BswMModeInitValue
            BswMBswModeInitValue: BswMBswModeInitValueMode=BSWM_TIMER_STOPPED
        ESH_Cond_StateIsPostRun (BswMModeCondition): BswMConditionType=BSWM_EQUALS, BswMConditionMode=ESH_State
          BswMConditionValue
            BswMBswMode: BswMBswRequestedMode=ESH_POST_RUN
        ESH_LE_RunRequestsOrWakeup (BswMLogicalExpression): BswMLogicalOperator=BSWM_OR, BswMArgumentRef=ESH_LE_ValidWakeup
        ESH_WakeupToRun (BswMRule):
          BswMNestedExecutionOnly = false
          BswMRuleInitState = BSWM_FALSE
          BswMRuleId = 15
          BswMRuleExpressionRef = ESH_LE_WakeupToRun
          BswMRuleTrueActionList = ESH_AL_WakeupToRun
        ESH_LE_WakeupToRun (BswMLogicalExpression):
          BswMLogicalOperator = BSWM_AND
          BswMArgumentRef = ESH_Cond_StateIsWakeup
          BswMArgumentRef = ESH_LE_ValidWakeup
          BswMArgumentRef = ESH_LE_CancelNotPending
          BswMArgumentRef = ESH_Cond_ModeIsWakeup
        ESH_Cond_StateIsWakeup (BswMModeCondition): BswMConditionType=BSWM_EQUALS, BswMConditionMode=ESH_State
          BswMConditionValue
            BswMBswMode: BswMBswRequestedMode=ESH_WAKEUP
        ESH_WakeupToPrep (BswMRule):
          BswMNestedExecutionOnly = false
          BswMRuleInitState = BSWM_FALSE
          BswMRuleId = 14
          BswMRuleExpressionRef = ESH_LE_WakeupToPrepShutdown
          BswMRuleTrueActionList = ESH_AL_WakeupToPrep
        ESH_LE_WakeupToPrepShutdown (BswMLogicalExpression):
          BswMLogicalOperator = BSWM_AND
          BswMArgumentRef = ESH_Cond_StateIsWakeup
          BswMArgumentRef = ESH_LE_CancelNotPending
          BswMArgumentRef = ESH_Cond_NoPendingWakeups
          BswMArgumentRef = ESH_LE_NoWakeup
          BswMArgumentRef = ESH_Cond_ModeIsWakeup
        ESH_Cond_NoPendingWakeups (BswMModeCondition): BswMConditionType=BSWM_EQUALS, BswMConditionMode=ESH_EcuM_GetPendingWakeupEvents
          BswMConditionValue
            BswMBswMode: BswMBswRequestedMode=0
        ESH_EcuM_GetPendingWakeupEvents (BswMModeRequestPort): BswMRequestProcessing=BSWM_DEFERRED, BswMArbitrateOnInit=false
          BswMModeRequestSource
            BswMUserConditionRequest: BswMUserCondition=EcuM_GetPendingWakeupEvents()
        ESH_Cond_NoValidatedWakeups (BswMModeCondition): BswMConditionType=BSWM_EQUALS, BswMConditionMode=ESH_EcuM_GetValidatedWakeupEvents
          BswMConditionValue
            BswMBswMode: BswMBswRequestedMode=0
        ESH_InitToWakeup (BswMRule):
          BswMNestedExecutionOnly = false
          BswMRuleInitState = BSWM_FALSE
          BswMRuleId = 6
          BswMRuleExpressionRef = ESH_LE_InitToWakeup
          BswMRuleTrueActionList = ESH_AL_InitToWakeup
        ESH_LE_InitToWakeup (BswMLogicalExpression): BswMLogicalOperator=BSWM_AND, BswMArgumentRef=ESH_Cond_StateIsInit
        ESH_Cond_StateIsInit (BswMModeCondition): BswMConditionType=BSWM_EQUALS, BswMConditionMode=ESH_State
          BswMConditionValue
            BswMBswMode: BswMBswRequestedMode=ESH_INIT
        ESH_Cond_ModeIsShutdown (BswMModeCondition): BswMConditionType=BSWM_EQUALS, BswMConditionMode=ESH_ModeNotification
          BswMConditionValue
            BswMModeDeclaration: BswMModeValueRef=SHUTDOWN
        ESH_ModeNotification (BswMModeRequestPort): BswMArbitrateOnInit=false, BswMRequestProcessing=BSWM_DEFERRED
          BswMModeRequestSource
            BswMSwcModeNotification: BswMSwcModeNotificationModeDeclarationGroupPrototypeRef=BswM_MDGP_ESH_Mode
          BswMModeInitValue
            BswMSwcModeInitValue: BswMSwcModeInitValueRef=STARTUP
        ESH_NvM_WriteAllTimer (BswMModeRequestPort): BswMArbitrateOnInit=false, BswMRequestProcessing=BSWM_DEFERRED
          BswMModeRequestSource
            BswMTimer
          BswMModeInitValue
            BswMBswModeInitValue: BswMBswModeInitValueMode=BSWM_TIMER_STOPPED
        ESH_DemInit (BswMRule):
          BswMNestedExecutionOnly = true
          BswMRuleId = 5
          BswMRuleInitState = BSWM_FALSE
          BswMRuleExpressionRef = ESH_LE_DemNotInitialized
          BswMRuleTrueActionList = ESH_AL_DemInit
        ESH_LE_DemNotInitialized (BswMLogicalExpression): BswMLogicalOperator=BSWM_OR, BswMArgumentRef=ESH_Cond_DemNotInitialized
        ESH_Cond_DemNotInitialized (BswMModeCondition): BswMConditionType=BSWM_EQUALS, BswMConditionMode=ESH_DemInitStatus
          BswMConditionValue
            BswMBswMode: BswMBswRequestedMode=DEM_NOT_INITIALIZED
        ESH_DemInitStatus (BswMModeRequestPort): BswMArbitrateOnInit=false, BswMRequestProcessing=BSWM_IMMEDIATE
          BswMModeRequestSource
            BswMGenericRequest: BswMModeRequesterId=231, BswMRequestedModeMax=2
              DEM_INITIALIZED (BswMGenericRequestMode): BswMGenericRequestModeValue=0
              DEM_NOT_INITIALIZED (BswMGenericRequestMode): BswMGenericRequestModeValue=1
          BswMModeInitValue
            BswMBswModeInitValue: BswMBswModeInitValueMode=DEM_INITIALIZED
        ESH_LE_WriteNotPending (BswMLogicalExpression): BswMLogicalOperator=BSWM_OR, BswMArgumentRef=ESH_Cond_NvMWAIsNotPending, BswMArgumentRef=ESH_Cond_NvWWriteAllTimerNotRunning
        ESH_Cond_NvMWAIsNotPending (BswMModeCondition): BswMConditionType=BSWM_EQUALS_NOT, BswMConditionMode=ESH_NvMIndication
          BswMConditionValue
            BswMBswMode: BswMBswRequestedMode=NVM_REQ_PENDING
        ESH_NvMIndication (BswMModeRequestPort): BswMArbitrateOnInit=false, BswMRequestProcessing=BSWM_DEFERRED
          BswMModeRequestSource
            BswMNvMJobModeIndication: BswMNvmService=NvmWriteAll
          BswMModeInitValue
            BswMBswModeInitValue: BswMBswModeInitValueMode=NVM_REQ_OK
        ESH_Cond_NvWWriteAllTimerNotRunning (BswMModeCondition): BswMConditionType=BSWM_EQUALS_NOT, BswMConditionMode=ESH_NvM_WriteAllTimer
          BswMConditionValue
            BswMBswMode: BswMBswRequestedMode=BSWM_TIMER_STARTED
        ESH_NvM_CancelWriteAllTimer (BswMModeRequestPort): BswMArbitrateOnInit=false, BswMRequestProcessing=BSWM_DEFERRED
          BswMModeRequestSource
            BswMTimer
          BswMModeInitValue
            BswMBswModeInitValue: BswMBswModeInitValueMode=BSWM_TIMER_STOPPED
        ESH_Cond_NoComOn_CAN00_f26020e5 (BswMModeCondition): BswMConditionType=BSWM_EQUALS, BswMConditionMode=ESH_ComMIndication_CAN00_f26020e5
          BswMConditionValue
            BswMBswMode: BswMBswRequestedMode=COMM_NO_COMMUNICATION
        ESH_ComMIndication_CAN00_f26020e5 (BswMModeRequestPort): BswMArbitrateOnInit=false, BswMRequestProcessing=BSWM_DEFERRED
          BswMModeRequestSource
            BswMComMIndication: BswMComMChannelRef=ComMConfigSet/CAN00_f26020e5
          BswMModeInitValue
            BswMBswModeInitValue: BswMBswModeInitValueMode=COMM_NO_COMMUNICATION
        ESH_Cond_ModeIsRun (BswMModeCondition): BswMConditionType=BSWM_EQUALS, BswMConditionMode=ESH_ModeNotification
          BswMConditionValue
            BswMModeDeclaration: BswMModeValueRef=RUN
        ESH_Cond_ModeIsPostRun (BswMModeCondition): BswMConditionType=BSWM_EQUALS, BswMConditionMode=ESH_ModeNotification
          BswMConditionValue
            BswMModeDeclaration: BswMModeValueRef=POSTRUN
        ESH_LE_CancelNotPending (BswMLogicalExpression): BswMLogicalOperator=BSWM_OR, BswMArgumentRef=ESH_Cond_NvMWAIsNotPending, BswMArgumentRef=ESH_Cond_NvWCancelTimerNotRunning
        ESH_Cond_NvWCancelTimerNotRunning (BswMModeCondition): BswMConditionType=BSWM_EQUALS_NOT, BswMConditionMode=ESH_NvM_CancelWriteAllTimer
          BswMConditionValue
            BswMBswMode: BswMBswRequestedMode=BSWM_TIMER_STARTED
        ESH_Cond_ModeIsWakeup (BswMModeCondition): BswMConditionType=BSWM_EQUALS, BswMConditionMode=ESH_ModeNotification
          BswMConditionValue
            BswMModeDeclaration: BswMModeValueRef=WAKEUP
        ESH_RunToPostRunNested (BswMRule):
          BswMNestedExecutionOnly = true
          BswMRuleId = 11
          BswMRuleInitState = BSWM_FALSE
          BswMRuleExpressionRef = ESH_LE_ComMNoPendingRequests
          BswMRuleTrueActionList = ESH_AL_RunToPostRun
        ESH_LE_ComMNoPendingRequests (BswMLogicalExpression): BswMLogicalOperator=BSWM_AND, BswMArgumentRef=ESH_Cond_ComMNoPendingRequests
        ESH_Cond_ComMNoPendingRequests (BswMModeCondition): BswMConditionType=BSWM_EQUALS, BswMConditionMode=ESH_ComMPendingRequests
          BswMConditionValue
            BswMBswMode: BswMBswRequestedMode=ESH_COMM_NO_REQUEST
        ESH_ComMPendingRequests (BswMModeRequestPort): BswMArbitrateOnInit=false, BswMRequestProcessing=BSWM_DEFERRED
          BswMModeRequestSource
            BswMGenericRequest: BswMModeRequesterId=232, BswMRequestedModeMax=2
              ESH_COMM_NO_REQUEST (BswMGenericRequestMode): BswMGenericRequestModeValue=0
              ESH_COMM_PENDING_REQUEST (BswMGenericRequestMode): BswMGenericRequestModeValue=1
          BswMModeInitValue
            BswMBswModeInitValue: BswMBswModeInitValueMode=ESH_COMM_NO_REQUEST
        ESH_LE_NoWakeup (BswMLogicalExpression): BswMLogicalOperator=BSWM_AND, BswMArgumentRef=ESH_Cond_NoValidatedWakeups, BswMArgumentRef=ESH_Cond_ComMNoPendingRequests
        ESH_Cond_ComMPendingRequests (BswMModeCondition): BswMConditionType=BSWM_EQUALS, BswMConditionMode=ESH_ComMPendingRequests
          BswMConditionValue
            BswMBswMode: BswMBswRequestedMode=ESH_COMM_PENDING_REQUEST
        ESH_PostRunNested (BswMRule):
          BswMNestedExecutionOnly = true
          BswMRuleId = 8
          BswMRuleInitState = BSWM_FALSE
          BswMRuleExpressionRef = ESH_LE_RunRequestsOrWakeup
          BswMRuleFalseActionList = ESH_AL_PostRunToPrepShutdown
          BswMRuleTrueActionList = ESH_AL_PostRunToRun
        ESH_PostRun (BswMRule):
          BswMNestedExecutionOnly = false
          BswMRuleId = 7
          BswMRuleInitState = BSWM_FALSE
          BswMRuleExpressionRef = ESH_LE_PostRun
          BswMRuleTrueActionList = ESH_AL_ExitPostRun
        ESH_LE_PostRun (BswMLogicalExpression): BswMLogicalOperator=BSWM_AND, BswMArgumentRef=ESH_Cond_StateIsPostRun, BswMArgumentRef=ESH_Cond_ModeIsPostRun
        BswModeSwitch_DcmEcuReset_BSWM_EQUALS_EXECUTE (BswMModeCondition): BswMConditionType=BSWM_EQUALS, BswMConditionMode=BswModeSwitch_DcmEcuReset
          BswMConditionValue
            BswMModeDeclaration: BswMModeValueRef=EXECUTE
        BswModeSwitch_DcmEcuReset (BswMModeRequestPort): BswMArbitrateOnInit=false, BswMRequestProcessing=BSWM_DEFERRED
          BswMModeRequestSource
            BswMSwcModeNotification: BswMSwcModeNotificationModeDeclarationGroupPrototypeRef=DcmEcuReset
          BswMModeInitValue
            BswMSwcModeInitValue: BswMSwcModeInitValueRef=NONE
        CleDcmEcuResetActive (BswMLogicalExpression): BswMArgumentRef=BswModeSwitch_DcmEcuReset_BSWM_EQUALS_EXECUTE
        BswMRule_DcmEcuReset (BswMRule):
          BswMNestedExecutionOnly = false
          BswMRuleId = 0
          BswMRuleInitState = BSWM_FALSE
          BswMRuleExpressionRef = CleDcmEcuResetActive
          BswMRuleTrueActionList = BswMActionList_Mcu_PerformReset
      BswMModeControl: BswMInitActionListRef=INIT_AL_Initialize
        INIT_AL_Initialize (BswMActionList): BswMActionListExecution=BSWM_CONDITION
          18 x BswMActionListItem, all with BswMAbortOnFail=false:
            INIT_Action_Fls_Init: BswMActionListItemIndex=1, BswMActionListItemRef=BswMModeControl/INIT_Action_Fls_Init
            INIT_Action_Fee_Init: BswMActionListItemIndex=5, BswMActionListItemRef=BswMModeControl/INIT_Action_Fee_Init
            INIT_Action_NvM_Init: BswMActionListItemIndex=12, BswMActionListItemRef=BswMModeControl/INIT_Action_NvM_Init
            INIT_Action_NvMReadAll: BswMActionListItemIndex=13, BswMActionListItemRef=BswMModeControl/INIT_Action_NvMReadAll
            INIT_Action_Nm_Init: BswMActionListItemIndex=10, BswMActionListItemRef=BswMModeControl/INIT_Action_Nm_Init
            INIT_Action_Can_Init: BswMActionListItemIndex=3, BswMActionListItemRef=BswMModeControl/INIT_Action_Can_Init
            INIT_Action_CanIf_Init: BswMActionListItemIndex=4, BswMActionListItemRef=BswMModeControl/INIT_Action_CanIf_Init
            INIT_Action_CanNm_Init: BswMActionListItemIndex=9, BswMActionListItemRef=BswMModeControl/INIT_Action_CanNm_Init
            INIT_Action_CanSM_Init: BswMActionListItemIndex=8, BswMActionListItemRef=BswMModeControl/INIT_Action_CanSM_Init
            INIT_Action_PduR_Init: BswMActionListItemIndex=7, BswMActionListItemRef=BswMModeControl/INIT_Action_PduR_Init
            INIT_Action_Com_Init: BswMActionListItemIndex=6, BswMActionListItemRef=BswMModeControl/INIT_Action_Com_Init
            INIT_Action_ComM_Init: BswMActionListItemIndex=14, BswMActionListItemRef=BswMModeControl/INIT_Action_ComM_Init
            INIT_Action_Dem_Init: BswMActionListItemIndex=16, BswMActionListItemRef=BswMModeControl/INIT_Action_Dem_Init
            INIT_Action_RteStart: BswMActionListItemIndex=17, BswMActionListItemRef=BswMModeControl/INIT_Action_RteStart
            INIT_Action_Dio_Init: BswMActionListItemIndex=0, BswMActionListItemRef=BswMModeControl/INIT_Action_Dio_Init
            INIT_Action_Mcu_Init: BswMActionListItemIndex=2, BswMActionListItemRef=BswMModeControl/INIT_Action_Mcu_Init
            INIT_Action_CanTp_Init: BswMActionListItemIndex=11, BswMActionListItemRef=BswMModeControl/INIT_Action_CanTp_Init
            INIT_Action_Dcm_Init: BswMActionListItemIndex=15, BswMActionListItemRef=BswMModeControl/INIT_Action_Dcm_Init
        16 x BswMAction:
          INIT_Action_Fls_Init
            BswMAvailableActions
              BswMUserCallout: BswMUserCalloutFunction=Fls_Init(&FlsConfigSet), BswMCreateCallout=false, BswMUserIncludeFile=Fls.h
          INIT_Action_Fee_Init
            BswMAvailableActions
              BswMUserCallout: BswMUserCalloutFunction=Fee_Init(), BswMCreateCallout=false, BswMUserIncludeFile=Fee.h
          INIT_Action_NvM_Init
            BswMAvailableActions
              BswMUserCallout: BswMUserCalloutFunction=NvM_Init(), BswMCreateCallout=false, BswMUserIncludeFile=NvM.h
          INIT_Action_NvMReadAll
            BswMAvailableActions
              BswMUserCallout: BswMUserCalloutFunction=BswM_INIT_NvMReadAll(), BswMCreateCallout=true
          INIT_Action_Nm_Init
            BswMAvailableActions
              BswMUserCallout: BswMUserCalloutFunction=Nm_Init(), BswMCreateCallout=false, BswMUserIncludeFile=Nm.h
          INIT_Action_Can_Init
            BswMAvailableActions
              BswMUserCallout: BswMUserCalloutFunction=Can_Init(Can_Config_Ptr), BswMCreateCallout=false, BswMUserIncludeFile=Can.h
          INIT_Action_CanIf_Init
            BswMAvailableActions
              BswMUserCallout: BswMUserCalloutFunction=CanIf_Init(CanIf_Config_Ptr), BswMCreateCallout=false, BswMUserIncludeFile=CanIf.h
          INIT_Action_CanNm_Init
            BswMAvailableActions
              BswMUserCallout: BswMUserCalloutFunction=CanNm_Init(CanNm_Config_Ptr), BswMCreateCallout=false, BswMUserIncludeFile=CanNm.h
          INIT_Action_CanSM_Init
            BswMAvailableActions
              BswMUserCallout: BswMUserCalloutFunction=CanSM_Init(CanSM_Config_Ptr), BswMCreateCallout=false, BswMUserIncludeFile=CanSM_EcuM.h
          INIT_Action_PduR_Init
            BswMAvailableActions
              BswMUserCallout: BswMUserCalloutFunction=PduR_Init(PduR_Config_Ptr), BswMCreateCallout=false, BswMUserIncludeFile=PduR.h
          INIT_Action_Com_Init
            BswMAvailableActions
              BswMUserCallout: BswMUserCalloutFunction=Com_Init(Com_Config_Ptr), BswMCreateCallout=false, BswMUserIncludeFile=Com.h
          INIT_Action_ComM_Init
            BswMAvailableActions
              BswMUserCallout: BswMUserCalloutFunction=ComM_Init(), BswMCreateCallout=false, BswMUserIncludeFile=ComM.h
          INIT_Action_Dem_Init
            BswMAvailableActions
              BswMUserCallout: BswMUserCalloutFunction=Dem_Init(Dem_Config_Ptr), BswMCreateCallout=false, BswMUserIncludeFile=Dem.h
          INIT_Action_RteStart
            BswMAvailableActions
              BswMUserCallout: BswMUserCalloutFunction=(void)Rte_Start(), BswMCreateCallout=false, BswMUserIncludeFile=Rte_Main.h
          INIT_Action_Dio_Init
            BswMAvailableActions
              BswMUserCallout: BswMUserCalloutFunction=Dio_Init(&DioConfig), BswMCreateCallout=false, BswMUserIncludeFile=Dio.h
          EcuM_GoDown_EcuMFlexUserConfig
            BswMAvailableActions
              BswMEcuMGoDown: BswMEcuMUserIdRef=EcuMFlexUserConfig
        BswMActionList_EcuShutdown (BswMActionList): BswMActionListExecution=BSWM_TRIGGER
          BswMActionListItem: BswMAbortOnFail=false, BswMActionListItemIndex=0, BswMActionListItemRef=EcuM_GoDown_EcuMFlexUserConfig
        CC_AL_CAN00_f26020e5_Disable_DM (BswMActionList): BswMActionListExecution=BSWM_TRIGGER
          CC_DisableDM_MyECU_oCAN00_Rx_fcef2243 (BswMActionListItem): BswMAbortOnFail=false, BswMActionListItemIndex=0, BswMActionListItemRef=BswMModeControl/CC_DisableDM_MyECU_oCAN00_Rx_fcef2243
        CC_DisableDM_MyECU_oCAN00_Rx_fcef2243 (BswMAction)
          BswMAvailableActions
            BswMDeadlineMonitoringControl: BswMDisabledDMPduGroupRef=MyECU_oCAN00_Rx_fcef2243
        CC_AL_CAN00_f26020e5_Enable_DM (BswMActionList): BswMActionListExecution=BSWM_TRIGGER
          CC_EnableDM_MyECU_oCAN00_Rx_fcef2243 (BswMActionListItem): BswMAbortOnFail=false, BswMActionListItemIndex=0, BswMActionListItemRef=BswMModeControl/CC_EnableDM_MyECU_oCAN00_Rx_fcef2243
        CC_EnableDM_MyECU_oCAN00_Rx_fcef2243 (BswMAction)
          BswMAvailableActions
            BswMDeadlineMonitoringControl: BswMEnabledDMPduGroupRef=MyECU_oCAN00_Rx_fcef2243
        CC_AL_CAN00_f26020e5_RX_Disable (BswMActionList): BswMActionListExecution=BSWM_TRIGGER
          CC_DisablePDUGroup_MyECU_oCAN00_Rx_fcef2243 (BswMActionListItem): BswMAbortOnFail=false, BswMActionListItemIndex=0, BswMActionListItemRef=BswMModeControl/CC_DisablePDUGroup_MyECU_oCAN00_Rx_fcef2243
        CC_DisablePDUGroup_MyECU_oCAN00_Rx_fcef2243 (BswMAction)
          BswMAvailableActions
            BswMPduGroupSwitch: BswMPduGroupSwitchReinit=false, BswMDisabledPduGroupRef=MyECU_oCAN00_Rx_fcef2243
        CC_AL_CAN00_f26020e5_RX_EnableNoinit (BswMActionList): BswMActionListExecution=BSWM_TRIGGER
          CC_EnablePDUGroup_MyECU_oCAN00_Rx_fcef2243 (BswMActionListItem): BswMAbortOnFail=false, BswMActionListItemIndex=0, BswMActionListItemRef=BswMModeControl/CC_EnablePDUGroup_MyECU_oCAN00_Rx_fcef2243
        CC_EnablePDUGroup_MyECU_oCAN00_Rx_fcef2243 (BswMAction)
          BswMAvailableActions
            BswMPduGroupSwitch: BswMPduGroupSwitchReinit=false, BswMEnabledPduGroupRef=MyECU_oCAN00_Rx_fcef2243
        CC_AL_CAN00_f26020e5_TX_Disable (BswMActionList): BswMActionListExecution=BSWM_TRIGGER
          CC_DisablePDUGroup_MyECU_oCAN00_Tx_fcef2243 (BswMActionListItem): BswMAbortOnFail=false, BswMActionListItemIndex=0, BswMActionListItemRef=BswMModeControl/CC_DisablePDUGroup_MyECU_oCAN00_Tx_fcef2243
        CC_DisablePDUGroup_MyECU_oCAN00_Tx_fcef2243 (BswMAction)
          BswMAvailableActions
            BswMPduGroupSwitch: BswMPduGroupSwitchReinit=false, BswMDisabledPduGroupRef=MyECU_oCAN00_Tx_fcef2243
        CC_AL_CAN00_f26020e5_TX_EnableNoinit (BswMActionList): BswMActionListExecution=BSWM_TRIGGER
          CC_EnablePDUGroup_MyECU_oCAN00_Tx_fcef2243 (BswMActionListItem): BswMAbortOnFail=false, BswMActionListItemIndex=0, BswMActionListItemRef=BswMModeControl/CC_EnablePDUGroup_MyECU_oCAN00_Tx_fcef2243
        CC_EnablePDUGroup_MyECU_oCAN00_Tx_fcef2243 (BswMAction)
          BswMAvailableActions
            BswMPduGroupSwitch: BswMPduGroupSwitchReinit=false, BswMEnabledPduGroupRef=MyECU_oCAN00_Tx_fcef2243
        ESH_AL_PrepShutdownToWaitForNvM (BswMActionList): BswMActionListExecution=BSWM_CONDITION
          5 x BswMActionListItem, all with BswMAbortOnFail=false:
            ESH_Action_ESH_WaitForNvm: BswMActionListItemIndex=4, BswMActionListItemRef=BswMModeControl/ESH_Action_ESH_WaitForNvm
            ESH_Action_WriteAllTimer_Start: BswMActionListItemIndex=0, BswMActionListItemRef=BswMModeControl/ESH_Action_WriteAllTimer_Start
            ESH_Action_NvMWriteAll: BswMActionListItemIndex=1, BswMActionListItemRef=BswMModeControl/ESH_Action_NvMWriteAll
            ESH_Action_OnEnterWaitForNvm: BswMActionListItemIndex=3, BswMActionListItemRef=BswMModeControl/ESH_Action_OnEnterWaitForNvm
            ESH_Action_ComMCheckPendingRequests: BswMActionListItemIndex=2, BswMActionListItemRef=BswMModeControl/ESH_Action_ComMCheckPendingRequests
        ESH_Action_ESH_WaitForNvm (BswMAction)
          BswMAvailableActions
            BswMGenericModeSwitch: BswMGenericRequestRef=ESH_State, BswMGenericRequestModeRef=ESH_WAIT_FOR_NVM
        ESH_AL_WaitForNvMToShutdown (BswMActionList): BswMActionListExecution=BSWM_CONDITION
          3 x BswMActionListItem, all with BswMAbortOnFail=false:
            ESH_Action_EcuMGoToSelectedShutdownTarget: BswMActionListItemIndex=2, BswMActionListItemRef=BswMModeControl/ESH_Action_EcuMGoToSelectedShutdownTarget
            ESH_Action_WriteAllTimer_Stop: BswMActionListItemIndex=0, BswMActionListItemRef=BswMModeControl/ESH_Action_WriteAllTimer_Stop
            ESH_Action_OnEnterShutdown: BswMActionListItemIndex=1, BswMActionListItemRef=BswMModeControl/ESH_Action_OnEnterShutdown
        ESH_Action_EcuMGoToSelectedShutdownTarget (BswMAction)
          BswMAvailableActions
            BswMUserCallout: BswMUserCalloutFunction=(void)EcuM_GoToSelectedShutdownTarget(), BswMCreateCallout=false, BswMUserIncludeFile=EcuM.h
        ESH_AL_WaitForNvMWakeup (BswMActionList): BswMActionListExecution=BSWM_CONDITION
          6 x BswMActionListItem, all with BswMAbortOnFail=false:
            ESH_Action_ESH_Wakeup: BswMActionListItemIndex=5, BswMActionListItemRef=BswMModeControl/ESH_Action_ESH_Wakeup
            ESH_Action_WriteAllTimer_Stop: BswMActionListItemIndex=0, BswMActionListItemRef=BswMModeControl/ESH_Action_WriteAllTimer_Stop
            ESH_Action_CancelWriteAllTimer_Start: BswMActionListItemIndex=1, BswMActionListItemRef=BswMModeControl/ESH_Action_CancelWriteAllTimer_Start
            ESH_Action_CancelNvMWriteAll: BswMActionListItemIndex=2, BswMActionListItemRef=BswMModeControl/ESH_Action_CancelNvMWriteAll
            ESH_Action_OnEnterWakeup: BswMActionListItemIndex=3, BswMActionListItemRef=BswMModeControl/ESH_Action_OnEnterWakeup
            ESH_Action_SwitchWakeup: BswMActionListItemIndex=4, BswMActionListItemRef=BswMModeControl/ESH_Action_SwitchWakeup
        ESH_Action_ESH_Wakeup (BswMAction)
          BswMAvailableActions
            BswMGenericModeSwitch: BswMGenericRequestRef=ESH_State, BswMGenericRequestModeRef=ESH_WAKEUP
        ESH_AL_RunToPostRun (BswMActionList): BswMActionListExecution=BSWM_CONDITION
          5 x BswMActionListItem, all with BswMAbortOnFail=false:
            ESH_Action_EcuMClearValidatedWakeupEvents: BswMActionListItemIndex=1, BswMActionListItemRef=BswMModeControl/ESH_Action_EcuMClearValidatedWakeupEvents
            ESH_Action_ESH_PostRun: BswMActionListItemIndex=4, BswMActionListItemRef=BswMModeControl/ESH_Action_ESH_PostRun
            ESH_Action_ComMDisallow_CAN00_f26020e5: BswMActionListItemIndex=0, BswMActionListItemRef=BswMModeControl/ESH_Action_ComMDisallow_CAN00_f26020e5
            ESH_Action_OnEnterPostRun: BswMActionListItemIndex=2, BswMActionListItemRef=BswMModeControl/ESH_Action_OnEnterPostRun
            ESH_Action_SwitchPostRun: BswMActionListItemIndex=3, BswMActionListItemRef=BswMModeControl/ESH_Action_SwitchPostRun
        ESH_Action_EcuMClearValidatedWakeupEvents (BswMAction)
          BswMAvailableActions
            BswMUserCallout: BswMUserCalloutFunction=EcuM_ClearValidatedWakeupEvent(ECUM_WKSOURCE_ALL_SOURCES), BswMCreateCallout=false, BswMUserIncludeFile=EcuM.h
        ESH_Action_ESH_PostRun (BswMAction)
          BswMAvailableActions
            BswMGenericModeSwitch: BswMGenericRequestRef=ESH_State, BswMGenericRequestModeRef=ESH_POST_RUN
        ESH_AL_PostRunToRun (BswMActionList): BswMActionListExecution=BSWM_CONDITION
          5 x BswMActionListItem, all with BswMAbortOnFail=false:
            ESH_Action_SelfRunRequestTimer_Start: BswMActionListItemIndex=1, BswMActionListItemRef=BswMModeControl/ESH_Action_SelfRunRequestTimer_Start
            ESH_Action_ESH_Run: BswMActionListItemIndex=4, BswMActionListItemRef=BswMModeControl/ESH_Action_ESH_Run
            ESH_Action_ComMAllow_CAN00_f26020e5: BswMActionListItemIndex=0, BswMActionListItemRef=BswMModeControl/ESH_Action_ComMAllow_CAN00_f26020e5
            ESH_Action_OnEnterRun: BswMActionListItemIndex=2, BswMActionListItemRef=BswMModeControl/ESH_Action_OnEnterRun
            ESH_Action_SwitchRun: BswMActionListItemIndex=3, BswMActionListItemRef=BswMModeControl/ESH_Action_SwitchRun
        ESH_Action_SelfRunRequestTimer_Start (BswMAction)
          BswMAvailableActions
            BswMTimerControl: BswMTimerAction=BSWM_TIMER_STOP, BswMTimerValue=0, BswMTimerRef=ESH_SelfRunRequestTimer
        ESH_Action_ESH_Run (BswMAction)
          BswMAvailableActions
            BswMGenericModeSwitch: BswMGenericRequestRef=ESH_State, BswMGenericRequestModeRef=ESH_RUN
        ESH_AL_PostRunToPrepShutdown (BswMActionList): BswMActionListExecution=BSWM_CONDITION
          5 x BswMActionListItem, all with BswMAbortOnFail=false:
            ESH_Action_ESH_PrepShutdown: BswMActionListItemIndex=4, BswMActionListItemRef=BswMModeControl/ESH_Action_ESH_PrepShutdown
            ESH_Action_DemShutdown: BswMActionListItemIndex=0, BswMActionListItemRef=BswMModeControl/ESH_Action_DemShutdown
            ESH_Action_DemNotInitialized: BswMActionListItemIndex=1, BswMActionListItemRef=BswMModeControl/ESH_Action_DemNotInitialized
            ESH_Action_OnEnterPrepShutdown: BswMActionListItemIndex=2, BswMActionListItemRef=BswMModeControl/ESH_Action_OnEnterPrepShutdown
            ESH_Action_SwitchShutdown: BswMActionListItemIndex=3, BswMActionListItemRef=BswMModeControl/ESH_Action_SwitchShutdown
        ESH_Action_ESH_PrepShutdown (BswMAction)
          BswMAvailableActions
            BswMGenericModeSwitch: BswMGenericRequestRef=ESH_State, BswMGenericRequestModeRef=ESH_PREP_SHUTDOWN
        3 x BswMActionList, all with BswMActionListExecution=BSWM_CONDITION:
          ESH_AL_WakeupToRun
            7 x BswMActionListItem, all with BswMAbortOnFail=false:
              ESH_Action_SelfRunRequestTimer_Start: BswMActionListItemIndex=3, BswMActionListItemRef=BswMModeControl/ESH_Action_SelfRunRequestTimer_Start
              ESH_Action_ESH_Run: BswMActionListItemIndex=6, BswMActionListItemRef=BswMModeControl/ESH_Action_ESH_Run
              ESH_Action_CancelWriteAllTimer_Stop: BswMActionListItemIndex=0, BswMActionListItemRef=BswMModeControl/ESH_Action_CancelWriteAllTimer_Stop
              ESH_DemInit: BswMActionListItemIndex=1, BswMActionListItemRef=BswMArbitration/ESH_DemInit
              ESH_Action_ComMAllow_CAN00_f26020e5: BswMActionListItemIndex=2, BswMActionListItemRef=BswMModeControl/ESH_Action_ComMAllow_CAN00_f26020e5
              ESH_Action_OnEnterRun: BswMActionListItemIndex=4, BswMActionListItemRef=BswMModeControl/ESH_Action_OnEnterRun
              ESH_Action_SwitchRun: BswMActionListItemIndex=5, BswMActionListItemRef=BswMModeControl/ESH_Action_SwitchRun
          ESH_AL_WakeupToPrep
            3 x BswMActionListItem, all with BswMAbortOnFail=false:
              ESH_Action_ESH_PrepShutdown: BswMActionListItemIndex=2, BswMActionListItemRef=BswMModeControl/ESH_Action_ESH_PrepShutdown
              ESH_Action_OnEnterPrepShutdown: BswMActionListItemIndex=0, BswMActionListItemRef=BswMModeControl/ESH_Action_OnEnterPrepShutdown
              ESH_Action_SwitchShutdown: BswMActionListItemIndex=1, BswMActionListItemRef=BswMModeControl/ESH_Action_SwitchShutdown
          ESH_AL_InitToWakeup
            3 x BswMActionListItem, all with BswMAbortOnFail=false:
              ESH_Action_ESH_Wakeup: BswMActionListItemIndex=2, BswMActionListItemRef=BswMModeControl/ESH_Action_ESH_Wakeup
              ESH_Action_OnEnterWakeup: BswMActionListItemIndex=0, BswMActionListItemRef=BswMModeControl/ESH_Action_OnEnterWakeup
              ESH_Action_SwitchWakeup: BswMActionListItemIndex=1, BswMActionListItemRef=BswMModeControl/ESH_Action_SwitchWakeup
        3 x BswMAction:
          ESH_Action_WriteAllTimer_Start
            BswMAvailableActions
              BswMTimerControl: BswMTimerAction=BSWM_TIMER_START, BswMTimerValue=60, BswMTimerRef=ESH_NvM_WriteAllTimer
          ESH_Action_NvMWriteAll
            BswMAvailableActions
              BswMUserCallout: BswMUserCalloutFunction=NvM_WriteAll(), BswMCreateCallout=false, BswMUserIncludeFile=NvM.h
          ESH_Action_OnEnterWaitForNvm
            BswMAvailableActions
              BswMUserCallout: BswMUserCalloutFunction=BswM_ESH_OnEnterWaitForNvm(), BswMCreateCallout=true
        ESH_AL_DemInit (BswMActionList): BswMActionListExecution=BSWM_CONDITION
          ESH_Action_DemInit (BswMActionListItem): BswMAbortOnFail=false, BswMActionListItemIndex=0, BswMActionListItemRef=BswMModeControl/ESH_Action_DemInit
          ESH_Action_DemInitialized (BswMActionListItem): BswMAbortOnFail=false, BswMActionListItemIndex=1, BswMActionListItemRef=BswMModeControl/ESH_Action_DemInitialized
        8 x BswMAction:
          ESH_Action_DemInit
            BswMAvailableActions
              BswMUserCallout: BswMUserCalloutFunction=Dem_Init(Dem_Config_Ptr), BswMCreateCallout=false, BswMUserIncludeFile=Dem.h
          ESH_Action_DemInitialized
            BswMAvailableActions
              BswMGenericModeSwitch: BswMGenericRequestRef=ESH_DemInitStatus, BswMGenericRequestModeRef=DEM_INITIALIZED
          ESH_Action_WriteAllTimer_Stop
            BswMAvailableActions
              BswMTimerControl: BswMTimerAction=BSWM_TIMER_STOP, BswMTimerValue=0, BswMTimerRef=ESH_NvM_WriteAllTimer
          ESH_Action_OnEnterShutdown
            BswMAvailableActions
              BswMUserCallout: BswMUserCalloutFunction=BswM_ESH_OnEnterShutdown(), BswMCreateCallout=true
          ESH_Action_CancelWriteAllTimer_Start
            BswMAvailableActions
              BswMTimerControl: BswMTimerAction=BSWM_TIMER_START, BswMTimerValue=60, BswMTimerRef=ESH_NvM_CancelWriteAllTimer
          ESH_Action_CancelNvMWriteAll
            BswMAvailableActions
              BswMUserCallout: BswMUserCalloutFunction=NvM_CancelWriteAll(), BswMCreateCallout=false, BswMUserIncludeFile=NvM.h
          ESH_Action_OnEnterWakeup
            BswMAvailableActions
              BswMUserCallout: BswMUserCalloutFunction=BswM_ESH_OnEnterWakeup(), BswMCreateCallout=true
          ESH_Action_SwitchWakeup
            BswMAvailableActions
              BswMRteSwitch: BswMSwitchedMode=WAKEUP, BswMRteSwitchPortRef=ESH_ModeSwitch
        ESH_ModeSwitch (BswMSwitchPort): BswMModeSwitchInterfaceRef=BswM_MSI_ESH_Mode
        12 x BswMAction:
          ESH_Action_ComMDisallow_CAN00_f26020e5
            BswMAvailableActions
              BswMComMAllowCom: BswMComAllowed=false, BswMComMAllowChannelRef=ComMConfigSet/CAN00_f26020e5
          ESH_Action_OnEnterPostRun
            BswMAvailableActions
              BswMUserCallout: BswMUserCalloutFunction=BswM_ESH_OnEnterPostRun(), BswMCreateCallout=true
          ESH_Action_SwitchPostRun
            BswMAvailableActions
              BswMRteSwitch: BswMSwitchedMode=POSTRUN, BswMRteSwitchPortRef=ESH_ModeSwitch
          ESH_Action_ComMAllow_CAN00_f26020e5
            BswMAvailableActions
              BswMComMAllowCom: BswMComAllowed=true, BswMComMAllowChannelRef=ComMConfigSet/CAN00_f26020e5
          ESH_Action_OnEnterRun
            BswMAvailableActions
              BswMUserCallout: BswMUserCalloutFunction=BswM_ESH_OnEnterRun(), BswMCreateCallout=true
          ESH_Action_SwitchRun
            BswMAvailableActions
              BswMRteSwitch: BswMSwitchedMode=RUN, BswMRteSwitchPortRef=ESH_ModeSwitch
          ESH_Action_DemShutdown
            BswMAvailableActions
              BswMUserCallout: BswMUserCalloutFunction=Dem_Shutdown(), BswMCreateCallout=false, BswMUserIncludeFile=Dem.h
          ESH_Action_DemNotInitialized
            BswMAvailableActions
              BswMGenericModeSwitch: BswMGenericRequestRef=ESH_DemInitStatus, BswMGenericRequestModeRef=DEM_NOT_INITIALIZED
          ESH_Action_OnEnterPrepShutdown
            BswMAvailableActions
              BswMUserCallout: BswMUserCalloutFunction=BswM_ESH_OnEnterPrepShutdown(), BswMCreateCallout=true
          ESH_Action_SwitchShutdown
            BswMAvailableActions
              BswMRteSwitch: BswMSwitchedMode=SHUTDOWN, BswMRteSwitchPortRef=ESH_ModeSwitch
          ESH_Action_CancelWriteAllTimer_Stop
            BswMAvailableActions
              BswMTimerControl: BswMTimerAction=BSWM_TIMER_STOP, BswMTimerValue=0, BswMTimerRef=ESH_NvM_CancelWriteAllTimer
          INIT_Action_Mcu_Init
            BswMAvailableActions
              BswMUserCallout: BswMUserCalloutFunction=Mcu_Init(McuModuleConfiguration), BswMCreateCallout=false, BswMUserIncludeFile=Mcu.h
        ESH_AL_ExitRun (BswMActionList): BswMActionListExecution=BSWM_CONDITION
          4 x BswMActionListItem, all with BswMAbortOnFail=false:
            ESH_Action_EnterExclusiveArea: BswMActionListItemIndex=0, BswMActionListItemRef=BswMModeControl/ESH_Action_EnterExclusiveArea
            ESH_Action_ComMCheckPendingRequests: BswMActionListItemIndex=1, BswMActionListItemRef=BswMModeControl/ESH_Action_ComMCheckPendingRequests
            ESH_RunToPostRunNested: BswMActionListItemIndex=2, BswMActionListItemRef=BswMArbitration/ESH_RunToPostRunNested
            ESH_Action_ExitExclusiveArea: BswMActionListItemIndex=3, BswMActionListItemRef=BswMModeControl/ESH_Action_ExitExclusiveArea
        3 x BswMAction:
          ESH_Action_EnterExclusiveArea
            BswMAvailableActions
              BswMUserCallout: BswMUserCalloutFunction=SchM_Enter_BswM_BSWM_EXCLUSIVE_AREA_0(), BswMCreateCallout=false, BswMUserIncludeFile=SchM_BswM.h
          ESH_Action_ComMCheckPendingRequests
            BswMAvailableActions
              BswMUserCallout:
                BswMUserCalloutFunction = ESH_ComM_CheckPendingRequests()
                BswMCreateCallout = true
                BswMUserCode = ComM_StateType CAN00_f26020e5 = COMM_NO_COM_NO_PENDING_REQUEST; (void)ComM_GetState(ComMConf_ComMChannel_CAN00_f26020e5, &CAN00_f26020e5); /* SBSW_BSWM_FCTCALL_LOCALVAR */ if(CAN00_f26020e5 != COMM_NO_COM_NO_PENDING_REQUEST) { BswM_RequestMode(BSWM_GENERIC_ESH_ComMPendingRequests, BSWM_GENERICVALUE_ESH_ComMPendingRequests_ESH_COMM_PENDING_REQUEST); } else { BswM_RequestMode(BSWM_GENERIC_ESH_ComMPendingRequests, BSWM_GENERICVALUE_ESH_ComMPendingRequests_ESH_COMM_NO_REQUEST); }
          ESH_Action_ExitExclusiveArea
            BswMAvailableActions
              BswMUserCallout: BswMUserCalloutFunction=SchM_Exit_BswM_BSWM_EXCLUSIVE_AREA_0(), BswMCreateCallout=false, BswMUserIncludeFile=SchM_BswM.h
        ESH_AL_ExitPostRun (BswMActionList): BswMActionListExecution=BSWM_CONDITION
          4 x BswMActionListItem, all with BswMAbortOnFail=false:
            ESH_Action_EnterExclusiveArea: BswMActionListItemIndex=0, BswMActionListItemRef=BswMModeControl/ESH_Action_EnterExclusiveArea
            ESH_Action_ComMCheckPendingRequests: BswMActionListItemIndex=1, BswMActionListItemRef=BswMModeControl/ESH_Action_ComMCheckPendingRequests
            ESH_PostRunNested: BswMActionListItemIndex=2, BswMActionListItemRef=BswMArbitration/ESH_PostRunNested
            ESH_Action_ExitExclusiveArea: BswMActionListItemIndex=3, BswMActionListItemRef=BswMModeControl/ESH_Action_ExitExclusiveArea
        3 x BswMAction:
          INIT_Action_CanTp_Init
            BswMAvailableActions
              BswMUserCallout: BswMUserCalloutFunction=CanTp_Init(CanTp_Config_Ptr), BswMCreateCallout=false, BswMUserIncludeFile=CanTp.h
          INIT_Action_Dcm_Init
            BswMAvailableActions
              BswMUserCallout: BswMUserCalloutFunction=Dcm_Init(NULL_PTR), BswMCreateCallout=false, BswMUserIncludeFile=Dcm.h
          BswMcuPerformReset
            BswMAvailableActions
              BswMUserCallout: BswMCreateCallout=false, BswMUserIncludeFile=Mcu.h, BswMUserCode=, BswMUserCalloutFunction=Mcu_PerformReset()
        BswMActionList_Mcu_PerformReset (BswMActionList): BswMActionListExecution=BSWM_TRIGGER
          BswMActionListItem: BswMAbortOnFail=false, BswMActionListItemIndex=0, BswMActionListItemRef=BswMcuPerformReset
      MdgBswMRequestShutdown (BswMRteModeDclGroup): BswMInitMode=BSWM_REQUESTSHUTDOWN_INACTIVE
        BSWM_REQUESTSHUTDOWN_INACTIVE (BswMRteMode): BswMModePhysicalValue=1
        BSWM_REQUESTSHUTDOWN_ACTIVE (BswMRteMode): BswMModePhysicalValue=0
      ESH_Mode (BswMRteModeDclGroup): BswMInitMode=STARTUP
        5 x BswMRteMode:
          STARTUP: BswMModePhysicalValue=0
          RUN: BswMModePhysicalValue=1
          POSTRUN: BswMModePhysicalValue=2
          WAKEUP: BswMModePhysicalValue=3
          SHUTDOWN: BswMModePhysicalValue=4
  module config CanIf: implementation-config-variant=VARIANT-PRE-COMPILE, module-description=CanIf_Impl
    CanIfPrivateCfg:
      CanIfPrivateSoftwareFilterType = LINEAR
      CanIfPrivateDlcCheck = true
      CanIfSupportTTCAN = false
      CanIfTransceiverMapping = false
      CanIfTransceiverHandling = false
      CanIfSupportExtendedIds = false
      CanIfSupportNmOsek = false
      CanIfTxBufferType = BYTE_QUEUE
      CanIfOptimizeOneController = true
      CanIfWakeupSupport = true
      CanIfStaticFdTxBufferSupport = false
      CanIfRxSearchConsiderMsgType = false
      CanIfMultipleBasicCANTxObjects = false
      CanIfTxBufferFifoSupport = false
    CanIfPublicCfg:
      CanIfPublicPnSupport = false
      CanIfPublicCancelTransmitSupport = false
      CanIfPublicDevErrorDetect = true
      CanIfPublicHandleTypeEnum = UINT8
      CanIfPublicMultipleDrvSupport = false
      CanIfPublicNumberOfCanHwUnits = 1
      CanIfPublicReadRxPduDataApi = false
      CanIfPublicReadRxPduNotifyStatusApi = false
      CanIfPublicReadTxPduNotifyStatusApi = false
      CanIfPublicSetDynamicTxIdApi = false
      CanIfPublicTxBuffering = true
      CanIfPublicTxConfirmPollingSupport = false
      CanIfPublicVersionInfoApi = true
      CanIfPublicWakeupCheckValidSupport = false
      CanIfPnWakeupTxPduFilterSupport = false
      CanIfPnTrcvHandlingSupport = false
      CanIfJ1939DynAddrSupport = DISABLED
      CanIfSetBaudrateApi = false
      CanIfPublicChangeBaudrateSupport = false
    CanIfCtrlDrvCfg: CanIfCtrlDrvTxCancellation=false, CanIfCtrlDrvInitHohConfigRef=CanIfInitHohCfg, CanIfCtrlDrvNameRef=Can/CanGeneral
      CT_CAN00_e98c47e6 (CanIfCtrlCfg): CanIfCtrlId=0, CanIfCtrlWakeupSupport=true, CanIfCtrlJ1939DynAddrSupport=DISABLED, CanIfCtrlCanCtrlRef=CanConfigSet/CT_CAN00_e98c47e6
    CanIfInitCfg: CanIfInitCfgSet=dummy
      CanIfBufferCfg_Tx_Std_0fb271d2 (CanIfBufferCfg):
        CanIfBufferSize = 3
        CanIfTxBufferHandlingType = PRIO_BY_CANID
        CanIfTxBufferMappedTxPdus = 3
        CanIfTxBufferMaxPduLength = 8
        CanIfBufferHthRef = CanIfInitHohCfg/CN_CAN00_e98c47e6_Tx_Std
      CanIfInitHohCfg: CanIfInitRefCfgSet=Can/CanConfigSet
        CN_CAN00_e98c47e6_Tx_Std (CanIfHthCfg): CanIfHthCanCtrlIdRef=CanIfCtrlDrvCfg/CT_CAN00_e98c47e6, CanIfHthIdSymRef=CanConfigSet/CN_CAN00_e98c47e6_Tx_Std
        CN_CAN00_e98c47e6_Rx_Std (CanIfHrhCfg): CanIfHrhSoftwareFilter=true, CanIfHrhCanCtrlIdRef=CanIfCtrlDrvCfg/CT_CAN00_e98c47e6, CanIfHrhIdSymRef=CanConfigSet/CN_CAN00_e98c47e6_Rx_Std
      msg_nm_MyECU_oCAN00_Tx_3abd61be (CanIfTxPduCfg):
        CanIfTxPduCanId = 1024
        CanIfTxPduCanIdType = STANDARD_CAN
        CanIfTxPduDlc = 8
        CanIfTxPduUserTxConfirmationName = CanNm_TxConfirmation
        CanIfTxPduUserTxConfirmationUL = CAN_NM
        CanIfTxPduId = 1
        CanIfTxPduReadNotifyStatus = false
        CanIfTxPduType = STATIC
        CanIfTxPduBufferRef = CanIfBufferCfg_Tx_Std_0fb271d2
        CanIfTxPduRef = msg_nm_MyECU_5fb848b3
      msg_Receive_oCAN00_Rx_3abd61be (CanIfRxPduCfg):
        CanIfRxPduCanId = 528
        CanIfRxPduCanIdType = STANDARD_CAN
        CanIfRxPduDlc = 1
        CanIfRxPduUserRxIndicationName = PduR_CanIfRxIndication
        CanIfRxPduUserRxIndicationUL = PDUR
        CanIfRxPduId = 3
        CanIfRxPduReadData = false
        CanIfRxPduReadNotifyStatus = false
        CanIfRxPduDlcCheck = true
        CanIfRxPduHrhIdRef = CanIfInitHohCfg/CN_CAN00_e98c47e6_Rx_Std
        CanIfRxPduRef = msg_Receive_ff2f8fca
      msg_Transmit_oCAN00_Tx_3abd61be (CanIfTxPduCfg):
        CanIfTxPduCanId = 512
        CanIfTxPduCanIdType = STANDARD_CAN
        CanIfTxPduDlc = 1
        CanIfTxPduUserTxConfirmationName = NULL_PTR
        CanIfTxPduUserTxConfirmationUL = NONE
        CanIfTxPduId = 2
        CanIfTxPduReadNotifyStatus = false
        CanIfTxPduType = STATIC
        CanIfTxPduBufferRef = CanIfBufferCfg_Tx_Std_0fb271d2
        CanIfTxPduRef = msg_Transmit_ca20852c
      MyECU_5faa4e95_NMCanIDRange (CanIfRxPduCfg):
        CanIfRxPduCanIdType = STANDARD_CAN
        CanIfRxPduDlc = 8
        CanIfRxPduUserRxIndicationName = CanNm_RxIndication
        CanIfRxPduUserRxIndicationUL = CAN_NM
        CanIfRxPduId = 0
        CanIfRxPduReadData = false
        CanIfRxPduReadNotifyStatus = false
        CanIfRxPduDlcCheck = true
        CanIfRxPduHrhIdRef = CanIfInitHohCfg/CN_CAN00_e98c47e6_Rx_Std
        CanIfRxPduRef = MyECU_NmRxPdu_5faa4e95
        CHNL (CanIfRxPduCanIdRange): CanIfRxPduCanIdRangeLowerCanId=1024, CanIfRxPduCanIdRangeUpperCanId=1087
      msg_diag_Response_MyECU_Tp_oCAN00_Tx_3abd61be (CanIfTxPduCfg):
        CanIfTxPduCanId = 1554
        CanIfTxPduCanIdType = STANDARD_CAN
        CanIfTxPduDlc = 8
        CanIfTxPduUserTxConfirmationName = CanTp_TxConfirmation
        CanIfTxPduUserTxConfirmationUL = CAN_TP
        CanIfTxPduId = 0
        CanIfTxPduReadNotifyStatus = false
        CanIfTxPduType = STATIC
        CanIfTxPduBufferRef = CanIfBufferCfg_Tx_Std_0fb271d2
        CanIfTxPduRef = msg_diag_Response_MyECU_Tp_4167da22
      msg_diag_Request_MyECU_Tp_oCAN00_Rx_3abd61be (CanIfRxPduCfg):
        CanIfRxPduCanId = 1552
        CanIfRxPduCanIdType = STANDARD_CAN
        CanIfRxPduDlc = 8
        CanIfRxPduUserRxIndicationName = CanTp_RxIndication
        CanIfRxPduUserRxIndicationType = PDUID_PDUINFOPTR
        CanIfRxPduUserRxIndicationUL = CAN_TP
        CanIfRxPduId = 2
        CanIfRxPduReadData = false
        CanIfRxPduReadNotifyStatus = false
        CanIfRxPduDlcCheck = true
        CanIfRxPduHrhIdRef = CanIfInitHohCfg/CN_CAN00_e98c47e6_Rx_Std
        CanIfRxPduRef = msg_diag_Request_MyECU_Tp_fec7ea51
      msg_diag_RequestGlobal_Tp_oCAN00_Rx_3abd61be (CanIfRxPduCfg):
        CanIfRxPduCanId = 1556
        CanIfRxPduCanIdType = STANDARD_CAN
        CanIfRxPduDlc = 8
        CanIfRxPduUserRxIndicationName = CanTp_RxIndication
        CanIfRxPduUserRxIndicationType = PDUID_PDUINFOPTR
        CanIfRxPduUserRxIndicationUL = CAN_TP
        CanIfRxPduId = 1
        CanIfRxPduReadData = false
        CanIfRxPduReadNotifyStatus = false
        CanIfRxPduDlcCheck = true
        CanIfRxPduHrhIdRef = CanIfInitHohCfg/CN_CAN00_e98c47e6_Rx_Std
        CanIfRxPduRef = msg_diag_RequestGlobal_Tp_4e10fc23
    CanIfDispatchCfg:
      CanIfDispatchUserCtrlBusOffName = CanSM_ControllerBusOff
      CanIfDispatchUserCtrlBusOffUL = CAN_SM
      CanIfDispatchUserCtrlModeIndicationName = CanSM_ControllerModeIndication
      CanIfDispatchUserCtrlModeIndicationUL = CAN_SM
  module config CanNm: implementation-config-variant=VARIANT-PRE-COMPILE, module-description=CanNm_Impl
    CanNmGlobalConfig:
      CanNmComUserDataSupport = false
      CanNmPnEiraCalcEnabled = false
      CanNmUserDataEnabled = false
      CanNmBusLoadReductionEnabled = false
      CanNmBusSynchronizationEnabled = false
      CanNmComControlEnabled = false
      CanNmCoordinatorSyncSupport = false
      CanNmDevErrorDetect = true
      CanNmImmediateRestartEnabled = false
      CanNmImmediateTxconfEnabled = false
      CanNmMainFunctionPeriod = 0.01
      CanNmNodeDetectionEnabled = false
      CanNmPassiveModeEnabled = false
      CanNmPduRxIndicationEnabled = false
      CanNmRemoteSleepIndEnabled = false
      CanNmRepeatMsgIndEnabled = false
      CanNmStateChangeIndEnabled = false
      CanNmVersionInfoApi = false
      CanNmDisableTxErrReport = false
      CanNmApiOptimization = false
      CanNmCanIfRangeConfigDLCCheck = true
      CanNmNodeIdEnabled = false
      CanNmRuntimeMeasurementSupport = false
      CanNmNumberOfChannels = 1
      CAN00_CAN_17d0077e (CanNmChannelConfig):
        CanNmMsgCycleTime = 0.1
        CanNmMsgReducedTime = 0.05
        CanNmRepeatMessageTime = 0.4
        CanNmTimeoutTime = 1
        CanNmUserDataLength = 8
        CanNmWaitBusSleepTime = 0.75
        CanNmBusLoadReductionActive = false
        CanNmCarWakeUpRxEnabled = false
        CanNmImmediateNmTransmissions = 0
        CanNmMsgCycleOffset = 0
        CanNmMsgTimeoutTime = 0.06
        CanNmNodeId = 0
        CanNmPduCbvPosition = CANNM_PDU_OFF
        CanNmPduNidPosition = CANNM_PDU_OFF
        CanNmRemoteSleepIndTime = 0.5
        CanNmActiveWakeupBitEnabled = false
        CanNmAllNmMessagesKeepAwake = true
        CanNmComMNetworkHandleRef = ComMConfigSet/CAN00_f26020e5
        CAN00_CAN_17d0077e_RxPdu_2d241a48 (CanNmRxPdu): CanNmRxPduId=0, CanNmRxPduRef=MyECU_NmRxPdu_5faa4e95
        msg_nm_MyECU_oCAN00_3abd61be (CanNmTxPdu): CanNmTxConfirmationPduId=0, CanNmTxPduRef=msg_nm_MyECU_5fb848b3
      CanNmGeneration: CanNmOutOfBoundsWriteSanitizer=false, CanNmOutOfBoundsReadSanitizer=false, CanNmInterfacesForDeactivatedData=false
  module config CanSM: implementation-config-variant=VARIANT-PRE-COMPILE, module-description=CanSM_Impl
    CanSMGeneral:
      CanSMDevErrorDetect = true
      CanSMMainFunctionTimePeriod = 0.01
      CanSMVersionInfoApi = false
      CanSMBorCheckLevel = false
      CanSMSetBaudrateApi = false
      CanSmChangeBaudrateApi = false
      CanSMGeneration: CanSMOutOfBoundsWriteSanitizer=false, CanSMOutOfBoundsReadSanitizer=false
    CanSMConfiguration: CanSMModeRequestRepetitionMax=10, CanSMModeRequestRepetitionTime=0.1
      CHNL_f276589c (CanSMManagerNetwork):
        CanSMBorCounterL1ToL2 = 5
        CanSMBorTimeL1 = 1
        CanSMBorTimeL2 = 3
        CanSMBorTimeTxEnsured = 5
        CanSMBorTxConfirmationPolling = false
        CanSMComMNetworkHandleRef = ComMConfigSet/CAN00_f26020e5
        CT_CAN00_e98c47e6 (CanSMController): CanSMControllerId=CanIfCtrlDrvCfg/CT_CAN00_e98c47e6
  module config Can: implementation-config-variant=VARIANT-PRE-COMPILE, module-description=Can_Impl
    CanConfigSet
      CN_CAN00_e98c47e6_Tx_Std (CanHardwareObject):
        CanHandleType = BASIC
        CanIdType = STANDARD
        CanIdValue = 0
        CanObjectType = TRANSMIT
        CanObjectId = 0
        CanHwProcessing = false
        CanObjectHwSize = 1
        CanObjectHwHandle = 0
        CanMaxDataLen = 8
        CanFdPaddingValue = 0
        CanControllerRef = CanConfigSet/CT_CAN00_e98c47e6
      CT_CAN00_e98c47e6 (CanController):
        CanControllerActivation = true
        CanBusoffProcessing = INTERRUPT
        CanControllerBaseAddress = 0
        CanControllerId = 0
        CanRxProcessing = INTERRUPT
        CanTxProcessing = INTERRUPT
        CanWakeupProcessing = INTERRUPT
        CanWakeupSupport = true
        CanWakeupSourceId = 32
        CanBusName = CAN
        CanControllerDefaultBaudrate = CT_CAN00_e98c47e6/CanControllerBaudrateConfig
        CanWakeupSourceRef = ECUM_WKSOURCE_CAN
        CanCpuClockRef = McuClockSettingConfig/McuClockReferencePoint
        CanControllerBaudrateConfig:
          CanControllerBaudRate = 500
          CanControllerBaudRateConfigID = 0
          CanControllerPropSeg = 9
          CanControllerSeg1 = 3
          CanControllerSeg2 = 3
          CanControllerSyncJumpWidth = 2
          CanBaudrateClock = 80000
          CanBaudratePrescaler = 10
          CanSamplingMode = OneSample
        CanFilterMask: CanFilterMaskValue=448, CanFilterCodeValue=0, IsLocked=false
      CN_CAN00_e98c47e6_Rx_Std (CanHardwareObject):
        CanHandleType = BASIC
        CanIdType = STANDARD
        CanIdValue = 0
        CanObjectType = RECEIVE
        CanObjectId = 1
        CanHwProcessing = false
        CanObjectHwSize = 1
        CanObjectHwHandle = 1
        CanMaxDataLen = 8
        CanFdPaddingValue = 0
        CanControllerRef = CanConfigSet/CT_CAN00_e98c47e6
        CanFilterMaskRef = CT_CAN00_e98c47e6/CanFilterMask
    CanGeneral:
      CanIndex = 0
      CanHardwareLoopCheck = false
      CanChangeBaudrateApi = false
      CanDevErrorDetection = true
      CanHardwareCancellation = false
      CanIdenticalIdCancellation = false
      CanMainFunctionBusoffPeriod = 0.01
      CanMainFunctionModePeriod = 0.01
      CanMainFunctionWakeupPeriod = 0.01
      CanMultiplexedTransmission = false
      CanSetBaudrateApi = false
      CanTimeoutDuration = 0.01
      CanVersionInfoApi = false
      CanGenericPrecopy = false
      CanSecureTempBuffer = false
      CanRxFullCANSupport = false
      CanTxFullCANSupport = false
      CanRxBasicCANSupport = true
      CanUseNestedCANInterrupts = false
      CanHardwareCancelByAppl = false
      CanIndividualProcessing = false
      CanGenericConfirmation = false
      CanRxQueue = false
      CanSupportMixedID = false
      CanRxQueueSize = 1
      CanMultipleBasicCANObjects = false
      CanMultipleBasicCANTxObjects = false
      CanHardwareHandleType = UINT16
      CanOptimizeOneController = true
      CanInterruptCategory = CATEGORY2
      CanGetStatus = false
      CanInterruptLock = DRIVER
      CanWakeupSupport = true
      CanRamCheck = None
      CanOverrunNotification = DET
      CanReinitStart = true
      CanGenericPreTransmit = false
      CanFdSupport = NONE
      CanRuntimeMeasurementSupport = false
      CanMaxRxDataLen = 8
      CanMaxTxDataLen = 8
      CanUsePeripheralAccessApi = false
      CanMirrorModeSupport = false
      CanCounterRef = Os/SystemTimer
      CanMainFunctionRWPeriods
    CanTest: CanHwLayout=STANDARD, CanHwMailboxMax=500, CanHwFullCanTxSize=1, CanHwFullCanRxSize=1, CanHwBasicCanTxSize=1, CanHwBasicCanRxSize=1
  module config ComM: implementation-config-variant=VARIANT-PRE-COMPILE, module-description=ComM_Impl
    ComMGeneral:
      ComMPncIdCounting = COMM_PNC_ID_COUNT_FROM_NM_MESSAGE
      ComMPncSupport = false
      ComMDevErrorDetect = true
      ComMEcuGroupClassification = 3
      ComMModeLimitationEnabled = false
      ComMSynchronousWakeUp = true
      ComMTMinFullComModeDuration = 5
      ComMVersionInfoApi = true
      ComMWakeupInhibitionEnabled = false
      ComMOperationGetInhibitionStatusEnabled = false
      ComMPncExtendedFunctionalityEnabled = false
      ComMPncGatewayEnabled = false
      ComMPncToChannelRoutingLimitationEnabled = false
      ComMGeneration: ComMOutOfBoundsWriteSanitizer=false, ComMOutOfBoundsReadSanitizer=false
    ComMConfigSet: ComMPncEnabled=false
      CAN00_f26020e5 (ComMChannel):
        ComMBusType = COMM_BUS_TYPE_CAN
        ComMChannelId = 0
        ComMFullCommRequestNotificationEnabled = false
        ComMMainFunctionPeriod = 0.02
        ComMNoCom = false
        ComMNoWakeup = false
        ComMNetworkManagement: ComMNmVariant=FULL, ComMPncNmRequest=true
        CHNL_f276589c (ComMUserPerChannel): ComMUserChannel=USR_CHNL_CAN00
      USR_CHNL_CAN00 (ComMUser): ComMUserIdentifier=0, ComMUserModeNotification=true
  module config Com: implementation-config-variant=VARIANT-PRE-COMPILE, module-description=Com_Impl
    ComConfig: ComConfigurationId=0
      ComTimeBase: ComRxTimeBase=0.01, ComTxTimeBase=0.01, ComGwTimeBase=0.01, ComTxCycleCounterTimeBase=0.1
      MyECU_oCAN00_Tx_fcef2243 (ComIPduGroup): ComIPduGroupHandleId=1
      MyECU_oCAN00_Rx_fcef2243 (ComIPduGroup): ComIPduGroupHandleId=0
      4 x ComSignal, all with ComBitSize=1, ComSignalEndianness=LITTLE_ENDIAN, ComSignalInitValue=0, ComSignalType=BOOLEAN, ComTransferProperty=PENDING:
        sig_State_RearRightDoor_In: ComBitPosition=1, ComHandleId=1, ComTimeout=0, ComSignalAccess=ACCESS_NEEDED_BY_SWC_OR_COM, ComSignalLength=0, ComSystemTemplateSystemSignalRef=sig_State_RearRightDoor
        sig_RearInteriorLight_Out: ComBitPosition=0, ComHandleId=0, ComSignalAccess=ACCESS_NEEDED_BY_SWC_OR_COM, ComSignalLength=0, ComSystemTemplateSystemSignalRef=sig_RearInteriorLight
        sig_State_RearInteriorLight_In: ComBitPosition=2, ComTimeout=0, ComSignalAccess=ACCESS_NOT_NEEDED, ComSystemTemplateSystemSignalRef=sig_State_RearInteriorLight
        sig_State_RearLeftDoor_In: ComBitPosition=0, ComHandleId=0, ComTimeout=0, ComSignalAccess=ACCESS_NEEDED_BY_SWC_OR_COM, ComSignalLength=0, ComSystemTemplateSystemSignalRef=sig_State_RearLeftDoor
      msg_Receive_oCAN00_In (ComIPdu):
        ComIPduDirection = RECEIVE
        ComIPduType = NORMAL
        ComIPduHandleId = 0
        ComIPduSignalProcessing = DEFERRED
        ComIPduCancellationSupport = false
        ComIPduGroupRef = MyECU_oCAN00_Rx_fcef2243
        ComIPduSignalRef = sig_State_RearInteriorLight_In
        ComIPduSignalRef = sig_State_RearLeftDoor_In
        ComIPduSignalRef = sig_State_RearRightDoor_In
        ComPduIdRef = msg_Receive_ff2f8fca
      msg_Transmit_oCAN00_Out (ComIPdu):
        ComIPduDirection = SEND
        ComIPduType = NORMAL
        ComIPduHandleId = 0
        ComIPduSignalProcessing = DEFERRED
        ComIPduCancellationSupport = false
        ComIPduGroupRef = MyECU_oCAN00_Tx_fcef2243
        ComIPduSignalRef = sig_RearInteriorLight_Out
        ComPduIdRef = msg_Transmit_ca20852c
        ComTxIPdu: ComMinimumDelayTime=0, ComTxIPduUnusedAreasDefault=0
          ComTxModeTrue
            ComTxMode: ComTxModeMode=PERIODIC, ComTxModeTimeOffset=0, ComTxModeTimePeriod=0.1
          ComTxModeFalse
            ComTxMode: ComTxModeMode=PERIODIC, ComTxModeTimeOffset=0, ComTxModeTimePeriod=0.1
    ComGeneral:
      ComConfigurationUseDet = true
      ComEnableSignalGroupArrayApi = false
      ComRetryFailedTransmitRequests = false
      ComSupportedIPduGroups = 2
      ComVersionInfoApi = false
      ComDeInitApi = false
      ComMinimizeNumericalDataTypes = MINIMIZE_NUMERICAL_DATA_TYPES_WITH_CAST
      ComConstDataDeduplication = DEDUPLICATE_CONST_DATA_WITH_CAST
      ComOptimizeConstArrays2Define = true
      ComStructBoolDataUsage = BITMASKING
      ComDeduplicateZero2NIndirectedData = true
      ComReduceBoolDataByNegationThreshold = 2
      ComReduceNumericalDataByOffsetThreshold = 2
      ComReduceBoolDataByNumericalComparisonThreshold = 2
      ComReduceBoolDataByNumericalRelationThreshold = 2
      ComReduceNumericalDataByArraySubtractionThreshold = 2
      ComDeduplicateBoolDataByNumericalComparision = DEDUPLICATE_DATA_WITH_ANY_VALUE
      ComTriggerIPDUSendApi = false
      ComGetStatusApi = false
      ComReceptionDMApi = true
      ComReduceDataByStreaming = false
      ComSwitchIpduTxModeApi = false
      ComMainfunctionRxExclusiveAreas = FEWER_LONGER
      ComMainfunctionTxExclusiveAreas = FEWER_LONGER
      ComMainfunctionRouteSignalsExclusiveAreas = FEWER_LONGER
      ComAdvancedIPduCallouts = false
      ComOptimizedIPduGroupHandling = false
      ComMetaDataSupport = false
      ComReceiveSignalMacroAPI = false
      ComDeferredEventCacheSupport = false
      ComMainfunctionTimingDomainSupport = true
      ComDescriptionRoutingCodeGeneration = false
  module config Crc: implementation-config-variant=VARIANT-PRE-COMPILE, module-description=Crc_Impl
    CrcGeneral:
      Crc16Mode = CRC_16_RUNTIME
      Crc32Mode = CRC_32_RUNTIME
      Crc8Mode = CRC_8_RUNTIME
      CrcVersionInfoApi = true
      Crc32P4Mode = CRC_32P4_RUNTIME
      Crc8H2FMode = CRC_8H2F_RUNTIME
  module config Det: implementation-config-variant=VARIANT-PRE-COMPILE, module-description=Det_Impl
    DetGeneral:
      DetVersionInfoApi = false
      DetEnableDet = true
      DetExtDebugSupport = true
      DetGlobalFilterSize = 2
      DetBreakFilterSize = 1
      DetLogBufferSize = 0
      DetEntryCallout = false
  module config Dio: implementation-config-variant=VARIANT-PRE-COMPILE, module-description=Dio_Impl
    DioConfig
      DioPort: DioPortId=0
        env_InteriorLightFront (DioChannel): DioChannelId=0
        DioChannelGroup: DioPortMask=1, DioPortOffset=0
        5 x DioChannel:
          env_DoorFrontLeft: DioChannelId=1
          env_DoorFrontRight: DioChannelId=2
          env_InteriorLightFrontDEFECT: DioChannelId=3
          env_DisplayBusAwake: DioChannelId=4
          env_LocalClamp15: DioChannelId=5
    DioGeneral: DioDevErrorDetect=true, DioFlipChannelApi=false, DioVersionInfoApi=true
  module config EcuC: implementation-config-variant=VARIANT-PRE-COMPILE, module-description=EcuC_Impl
    EcucPduCollection: PduIdTypeEnum=UINT8, PduLengthTypeEnum=UINT16
      12 x Pdu, all with J1939Requestable=false:
        msg_Transmit_ca20852c: PduLength=1, SysTPduToFrameMappingRef=msg_Transmit
        msg_nm_RearECU_721237f7: PduLength=8, SysTPduToFrameMappingRef=msg_nm_RearECU
        msg_nm_MyECU_5fb848b3: PduLength=8, SysTPduToFrameMappingRef=msg_nm_MyECU
        msg_Receive_ff2f8fca: PduLength=1, SysTPduToFrameMappingRef=msg_Receive
        CAN00_NmRxPdu_f26020e5: PduLength=8
        MyECU_NmRxPdu_5faa4e95: PduLength=8, SysTPduToFrameMappingRef=msg_nm_RearECU
        PT_msg_diag_RequestGlobal_PP_msg_diag_RequestGlobal_Rx_0fb271d2_5e566ad9: PduLength=7
        PT_msg_diag_Request_MyECU_PP_msg_diag_Request_MyECU_Rx_0fb271d2_5e566ad9: PduLength=8
        PT_msg_diag_Response_MyECU_PP_msg_diag_Response_MyECU_Tx_0fb271d2_5e566ad9: PduLength=8
        msg_diag_RequestGlobal_Tp_4e10fc23: PduLength=8, SysTPduToFrameMappingRef=msg_diag_RequestGlobal_Tp
        msg_diag_Request_MyECU_Tp_fec7ea51: PduLength=8, SysTPduToFrameMappingRef=msg_diag_Request_MyECU_Tp
        msg_diag_Response_MyECU_Tp_4167da22: PduLength=8, SysTPduToFrameMappingRef=msg_diag_Response_MyECU_Tp
    EcucGeneral:
      CPUType = CPU32Bit
      SizeOfInt = Size32Bit
      ByteOrder = LITTLE_ENDIAN
      AtomicBitAccessInBitfield = false
      AtomicVariableAccess = Atomic32BitAccess
      BitOrder = LSB_to_MSB
      SizeOfEnum = Size16Bit
      SizeOfROMPointer = Size32Bit
      SizeOfRAMPointer = Size32Bit
      BitFieldDataType = INT
      StructAlignment = Auto
      ArrayAlignment = Auto
      StructInArrayAlignment = Auto
      DummyFunction = false
      EcuCSafeBswChecks = false
      DummyStatement = false
      DummyStatementKind = SelfAssignment
      ConditionalGenerating = true
      EcucBswImplementationCodeType = EcuCSourceCode
      EcuCUseStdReturnTypeForRte = true
      PostbuildLoadable: AlignmentFillPattern=0, PBROMStartAddress=0, PBRAMStartAddress=0, PBROMEndAddress=0, PBRAMEndAddress=0
      BswInitialization
        34 x InitFunction:
          BswM_Init: Header=BswM.h, InitPhase=NO_INIT, ConfigType=BswM_ConfigType, ConfigPtrName=BswM_Config_Ptr, ConfigPtrClass=BSWM_INIT_DATA, ModuleRef=BswM
          BswM_InitMemory: Header=BswM.h, InitPhase=INIT_MEMORY, ModuleRef=BswM
          Can_InitMemory: Header=Can.h, InitPhase=INIT_MEMORY, ModuleRef=Can
          Can_Init: Header=Can.h, InitPhase=INIT_TWO_DRV, ConfigType=Can_ConfigType, ConfigPtrName=Can_Config_Ptr, ConfigPtrClass=CAN_INIT_DATA, ModuleRef=Can
          CanIf_InitMemory: Header=CanIf.h, InitPhase=INIT_MEMORY, ModuleRef=CanIf
          CanIf_Init: Header=CanIf.h, InitPhase=INIT_TWO_IF, ConfigType=CanIf_ConfigType, ConfigPtrName=CanIf_Config_Ptr, ConfigPtrClass=CANIF_INIT_DATA, ModuleRef=CanIf
          CanNm_InitMemory: Header=CanNm.h, InitPhase=INIT_MEMORY, ModuleRef=CanNm
          CanNm_Init: Header=CanNm.h, InitPhase=INIT_TWO_NM, ConfigType=CanNm_ConfigType, ConfigPtrName=CanNm_Config_Ptr, ConfigPtrClass=CANNM_INIT_DATA, ModuleRef=CanNm
          CanSM_InitMemory: Header=CanSM_EcuM.h, InitPhase=INIT_MEMORY, ModuleRef=CanSM
          CanSM_Init: Header=CanSM_EcuM.h, InitPhase=INIT_TWO_SM, ConfigType=CanSM_ConfigType, ConfigPtrName=CanSM_Config_Ptr, ConfigPtrClass=CANSM_INIT_DATA, ModuleRef=CanSM
          Com_Init: Header=Com.h, InitPhase=INIT_TWO_COM, ConfigType=Com_ConfigType, ConfigPtrName=Com_Config_Ptr, ConfigPtrClass=COM_INIT_DATA, ModuleRef=Com
          Com_InitMemory: Header=Com.h, InitPhase=INIT_MEMORY, ModuleRef=Com
          ComM_InitMemory: Header=ComM.h, InitPhase=INIT_MEMORY, ModuleRef=ComM
          ComM_Init: Header=ComM.h, InitPhase=INIT_TWO_POST_NVMREADALL, ModuleRef=ComM
          Dem_PreInit: Header=Dem.h, InitPhase=INIT_ZERO, ConfigType=Dem_ConfigType, ConfigPtrName=Dem_Config_Ptr, ConfigPtrClass=DEM_INIT_DATA, ModuleRef=Dem
          Dem_Init: Header=Dem.h, InitPhase=INIT_TWO_POST_NVMREADALL, ConfigType=Dem_ConfigType, ConfigPtrName=Dem_Config_Ptr, ConfigPtrClass=DEM_INIT_DATA, ModuleRef=Dem
          Dem_InitMemory: Header=Dem.h, InitPhase=INIT_MEMORY, ModuleRef=Dem
          Det_Init: Header=Det.h, InitPhase=INIT_ZERO, ModuleRef=Det
          Det_InitMemory: Header=Det.h, InitPhase=INIT_MEMORY, ModuleRef=Det
          Dio_Init: Header=Dio.h, InitPhase=INIT_TWO_MCAL, ConfigType=Dio_ConfigType, ConfigPtrName=DioConfig, ConfigPtrClass=DIO_APPL_CONST, ModuleRef=Dio
          EcuM_Init: Header=EcuM.h, InitPhase=NO_INIT, ConfigType=EcuM_PbConfigType, ConfigPtrName=EcuM_Config_Ptr, ConfigPtrClass=ECUM_INIT_DATA, ModuleRef=EcuM
          Fee_Init: Header=Fee.h, InitPhase=INIT_TWO_IF, ModuleRef=Fee
          Fls_Init: Header=Fls.h, InitPhase=INIT_TWO_MCAL, ConfigType=Fls_ConfigType, ConfigPtrName=FlsConfigSet, ConfigPtrClass=FLS_APPL_CONST, ModuleRef=Fls
          Mcu_Init: Header=Mcu.h, InitPhase=INIT_TWO_MCAL, ConfigType=Mcu_ConfigType, ConfigPtrName=McuModuleConfiguration, ConfigPtrClass=MCU_APPL_CONST, ModuleRef=Mcu
          Nm_InitMemory: Header=Nm.h, InitPhase=INIT_MEMORY, ModuleRef=Nm
          Nm_Init: Header=Nm.h, InitPhase=INIT_TWO_NM, ModuleRef=Nm
          NvM_Init: Header=NvM.h, InitPhase=INIT_TWO_SYS, ModuleRef=NvM
          PduR_Init: Header=PduR.h, InitPhase=INIT_TWO_COM, ConfigType=PduR_PBConfigType, ConfigPtrName=PduR_Config_Ptr, ConfigPtrClass=PDUR_INIT_DATA, ModuleRef=PduR
          PduR_InitMemory: Header=PduR.h, InitPhase=INIT_MEMORY, ModuleRef=PduR
          SchM_Init: Header=Rte_Main.h, InitPhase=NO_INIT, ModuleRef=Rte
          Rte_InitMemory: Header=Rte_Main.h, InitPhase=INIT_MEMORY, ModuleRef=Rte
          CanTp_InitMemory: Header=CanTp.h, InitPhase=INIT_MEMORY, ModuleRef=CanTp
          CanTp_Init: Header=CanTp.h, InitPhase=INIT_TWO_TP, ConfigType=CanTp_ConfigType, ConfigPtrName=CanTp_Config_Ptr, ConfigPtrClass=CANTP_INIT_DATA, ModuleRef=CanTp
          Dcm_Init: Header=Dcm.h, InitPhase=INIT_TWO_POST_NVMREADALL, ConfigType=Dcm_ConfigType, ConfigPtrName=NULL_PTR, ConfigPtrClass=DCM_CONST, ModuleRef=Dcm
  module config EcuM: implementation-config-variant=VARIANT-PRE-COMPILE, module-description=EcuM_Impl
    EcuMGeneral:
      EcuMDevErrorDetect = true
      EcuMIncludeDem = false
      EcuMIncludeDet = true
      EcuMMainFunctionPeriod = 0.01
      EcuMVersionInfoApi = false
      EcuMDeferredBswMNotification = false
      EcuMSlaveCoreHandling = false
      EcuMEnableFixBehavior = false
      EcuMGeneration: EcuMOutOfBoundsWriteSanitizer=false, EcuMOutOfBoundsReadSanitizer=false, EcuMInterfacesForDeactivatedData=false
    EcuMFlexGeneral: EcuMAlarmClockPresent=false, EcuMResetLoopDetection=false, EcuMEnableDefBehaviour=true
    EcuMConfiguration
      EcuMFlexConfiguration: EcuMFlexModuleConfigurationRef=Can/CanConfigSet, EcuMNormalMcuModeRef=McuModuleConfiguration/NORMAL, EcuMFlexModuleConfigurationRef=DemConfigSet
        ECUM_RESET_WDG (EcuMResetMode): EcuMResetModeId=1
        ECUM_CAUSE_DCM (EcuMShutdownCause): EcuMShutdownCauseId=3
        ECUM_CAUSE_UNKNOWN (EcuMShutdownCause): EcuMShutdownCauseId=0
        ECUM_RESET_IO (EcuMResetMode): EcuMResetModeId=2
        ECUM_RESET_MCU (EcuMResetMode): EcuMResetModeId=0
        ECUM_CAUSE_WDGM (EcuMShutdownCause): EcuMShutdownCauseId=2
        ECUM_RESET_WAKEUP (EcuMResetMode): EcuMResetModeId=3
        ECUM_CAUSE_ECU_STATE (EcuMShutdownCause): EcuMShutdownCauseId=1
        EcuMFlexUserConfig: EcuMGoDownRequestID=42, EcuMFlexUser=0
        EcuMGoDownAllowedUsers: EcuMGoDownAllowedUserRef=EcuMFlexUserConfig
      EcuMCommonConfiguration: EcuMConfigConsistencyHash=15241451780430143149, EcuMDefaultAppMode=Os/OSDEFAULTAPPMODE, EcuMOSResource=Os/OsResource
        EcuMDefaultShutdownTarget: EcuMDefaultState=EcuMStateReset, EcuMDefaultResetModeRef=ECUM_RESET_MCU
        5 x EcuMWakeupSource, all with EcuMValidationTimeout=0, EcuMCheckWakeupTimeout=0, EcuMWakeupSourcePolling=false, EcuMResetReasonRef=McuPublishedInformation/McuResetReasonConf:
          ECUM_WKSOURCE_POWER: EcuMWakeupSourceId=0
          ECUM_WKSOURCE_INTERNAL_RESET: EcuMWakeupSourceId=2
          ECUM_WKSOURCE_INTERNAL_WDG: EcuMWakeupSourceId=3
          ECUM_WKSOURCE_RESET: EcuMWakeupSourceId=1
          ECUM_WKSOURCE_EXTERNAL_WDG: EcuMWakeupSourceId=4
        EcuMSleepMode:
          EcuMSleepModeId = 0
          EcuMSleepModeMcuModeRef = McuModuleConfiguration/SLEEP
          EcuMWakeupSourceMask = ECUM_WKSOURCE_EXTERNAL_WDG
          EcuMWakeupSourceMask = ECUM_WKSOURCE_INTERNAL_RESET
          EcuMWakeupSourceMask = ECUM_WKSOURCE_INTERNAL_WDG
          EcuMWakeupSourceMask = ECUM_WKSOURCE_POWER
          EcuMWakeupSourceMask = ECUM_WKSOURCE_RESET
        EcuMDriverInitListOne
          EcuMDriverInitItem: EcuMModuleID=Code, EcuMAdditionalInitCode=BswInitListOne();
        EcuMDemEventParameterRefs:
          ECUM_E_CONFIGURATION_DATA_INCONSISTENT = AutoCreatedDemEvent_EcuMConfiguration_ECUM_E_CONFIGURATION_DATA_INCONSISTENT
          ECUM_E_RAM_CHECK_FAILED = AutoCreatedDemEvent_EcuMConfiguration_ECUM_E_RAM_CHECK_FAILED
          ECUM_E_ALL_RUN_REQUESTS_KILLED = AutoCreatedDemEvent_EcuMConfiguration_ECUM_E_ALL_RUN_REQUESTS_KILLED
          ECUM_E_IMPROPER_CALLER = AutoCreatedDemEvent_EcuMConfiguration_ECUM_E_IMPROPER_CALLER
        EcuMDriverRestartList
        ECUM_WKSOURCE_CAN (EcuMWakeupSource): EcuMWakeupSourceId=5, EcuMWakeupSourcePolling=false, EcuMComMChannelRef=ComMConfigSet/CAN00_f26020e5
  module config Fee: implementation-config-variant=VARIANT-PRE-COMPILE, module-description=Fee_Impl
    FeeGeneral:
      FeeDevErrorDetect = true
      FeeIndex = 0
      FeeNvmJobEndNotification = NvM_JobEndNotification
      FeeNvmJobErrorNotification = NvM_JobErrorNotification
      FeePollingMode = true
      FeeVersionInfoApi = true
      FeeInternalBufferSize = 64
      FeeMainFunctionPeriod = 0.005
      FeeMainFunctionTriggering = FixedCycleTime
      FeeDevErrorChecks: FeeDebugReporting=true, FeeDetErrorhook=Det_ReportError, FeeDetIncludeFile=Det.h
    FeePublishedInformation: FeeBlockOverhead=2, FeeMaximumBlockingTime=1, FeePageOverhead=0, FeeChunkHeader=16, FeeChunkLink=8, FeeSectorHeader=8
    FeeSpecificFeatures:
      FeeApplErrorCallbackFunction = Appl_CriticalErrorCallback
      FeeApplErrorCallbackIncludeFile = Appl_Include.h
      FeeGetEraseCycleApi = false
      FeeGetWriteCycleApi = false
      FeeUseApplErrorCallback = false
      FeeUseJobCache = false
      FeeForceSectorSwitchApi = false
      FeeDataConversionApi = false
      FeeFblConfig = false
      FeeMaxLinkTableSize = 4095
      FeeFssControlApi = false
    FeePartitionConfiguration:
      FeeBssThresholdReserved = 2048
      FeeFssThresholdReserved = 1024
      FeeLowerSectorAddress = 0
      FeeLowerSectorSize = 16384
      FeeUpperSectorAddress = 16384
      FeeUpperSectorSize = 16384
      FeeAddressAlignment = 8
      FeeWriteAlignment = 8
      FeePartitionDevice = Fls/FlsConfigSet
    13 x FeeBlockConfiguration, all with FeeBlockIdFixed=false, FeeBlockIsCritical=false, FeeImmediateData=false, FeeNumberOfWriteCycles=10000, FeePartition=FeePartitionConfiguration, FeeDeviceIndex=Fls/FlsGeneral:
      FeeConfigBlock: FeeNumberOfChunkInstances=3, FeeBlockNumber=208, FeeBlockSize=4, FeeNumberOfDatasets=2, FeeBlockId=0
      FeeCpApMySwcSnNvMPimLightOnOffCounter: FeeNumberOfChunkInstances=1, FeeBlockNumber=176, FeeBlockSize=6, FeeNumberOfDatasets=1, FeeBlockId=11
      FeeCpApMySwcSnNvM_PimOdometer: FeeNumberOfChunkInstances=1, FeeBlockNumber=192, FeeBlockSize=6, FeeNumberOfDatasets=1, FeeBlockId=12
      FeeDemAdminDataBlock: FeeNumberOfChunkInstances=1, FeeBlockNumber=16, FeeBlockSize=12, FeeNumberOfDatasets=1, FeeBlockId=1
      FeeDemPrimaryDataBlock0: FeeNumberOfChunkInstances=1, FeeBlockNumber=32, FeeBlockSize=22, FeeNumberOfDatasets=1, FeeBlockId=2
      FeeDemPrimaryDataBlock1: FeeNumberOfChunkInstances=1, FeeBlockNumber=48, FeeBlockSize=22, FeeNumberOfDatasets=1, FeeBlockId=3
      FeeDemPrimaryDataBlock2: FeeNumberOfChunkInstances=1, FeeBlockNumber=64, FeeBlockSize=22, FeeNumberOfDatasets=1, FeeBlockId=4
      FeeDemPrimaryDataBlock3: FeeNumberOfChunkInstances=1, FeeBlockNumber=80, FeeBlockSize=22, FeeNumberOfDatasets=1, FeeBlockId=5
      FeeDemPrimaryDataBlock4: FeeNumberOfChunkInstances=1, FeeBlockNumber=96, FeeBlockSize=22, FeeNumberOfDatasets=1, FeeBlockId=6
      FeeDemPrimaryDataBlock5: FeeNumberOfChunkInstances=1, FeeBlockNumber=112, FeeBlockSize=22, FeeNumberOfDatasets=1, FeeBlockId=7
      FeeDemPrimaryDataBlock6: FeeNumberOfChunkInstances=1, FeeBlockNumber=128, FeeBlockSize=22, FeeNumberOfDatasets=1, FeeBlockId=8
      FeeDemPrimaryDataBlock7: FeeNumberOfChunkInstances=1, FeeBlockNumber=144, FeeBlockSize=22, FeeNumberOfDatasets=1, FeeBlockId=9
      FeeDemStatusDataBlock: FeeNumberOfChunkInstances=1, FeeBlockNumber=160, FeeBlockSize=24, FeeNumberOfDatasets=1, FeeBlockId=10
  module config Fls: implementation-config-variant=VARIANT-PRE-COMPILE, module-description=Fls_Impl
    FlsConfigSet: FlsMaxReadFastMode=64, FlsMaxReadNormalMode=32, FlsMaxWriteFastMode=8, FlsMaxWriteNormalMode=8, FlsDefaultMode=MEMIF_MODE_SLOW, FlsCallCycle=0.01
      FlsSectorList
        128 x FlsSector, all with FlsNumberOfSectors=1, FlsSectorSize=1024, FlsPageSize=2:
          FlsSector000: FlsSectorStartaddress=0
          FlsSector001: FlsSectorStartaddress=1024
          FlsSector002: FlsSectorStartaddress=2048
          FlsSector003: FlsSectorStartaddress=3072
          FlsSector004: FlsSectorStartaddress=4096
          FlsSector005: FlsSectorStartaddress=5120
          FlsSector006: FlsSectorStartaddress=6144
          FlsSector007: FlsSectorStartaddress=7168
          FlsSector008: FlsSectorStartaddress=8192
          FlsSector009: FlsSectorStartaddress=9216
          FlsSector010: FlsSectorStartaddress=10240
          FlsSector011: FlsSectorStartaddress=11264
          FlsSector012: FlsSectorStartaddress=12288
          FlsSector013: FlsSectorStartaddress=13312
          FlsSector014: FlsSectorStartaddress=14336
          FlsSector015: FlsSectorStartaddress=15360
          FlsSector016: FlsSectorStartaddress=16384
          FlsSector017: FlsSectorStartaddress=17408
          FlsSector018: FlsSectorStartaddress=18432
          FlsSector019: FlsSectorStartaddress=19456
          FlsSector020: FlsSectorStartaddress=20480
          FlsSector021: FlsSectorStartaddress=21504
          FlsSector022: FlsSectorStartaddress=22528
          FlsSector023: FlsSectorStartaddress=23552
          FlsSector024: FlsSectorStartaddress=24576
          FlsSector025: FlsSectorStartaddress=25600
          FlsSector026: FlsSectorStartaddress=26624
          FlsSector027: FlsSectorStartaddress=27648
          FlsSector028: FlsSectorStartaddress=28672
          FlsSector029: FlsSectorStartaddress=29696
          FlsSector030: FlsSectorStartaddress=30720
          FlsSector031: FlsSectorStartaddress=31744
          FlsSector032: FlsSectorStartaddress=32768
          FlsSector033: FlsSectorStartaddress=33792
          FlsSector034: FlsSectorStartaddress=34816
          FlsSector035: FlsSectorStartaddress=35840
          FlsSector036: FlsSectorStartaddress=36864
          FlsSector037: FlsSectorStartaddress=37888
          FlsSector038: FlsSectorStartaddress=38912
          FlsSector039: FlsSectorStartaddress=39936
          FlsSector040: FlsSectorStartaddress=40960
          FlsSector041: FlsSectorStartaddress=41984
          FlsSector042: FlsSectorStartaddress=43008
          FlsSector043: FlsSectorStartaddress=44032
          FlsSector044: FlsSectorStartaddress=45056
          FlsSector045: FlsSectorStartaddress=46080
          FlsSector046: FlsSectorStartaddress=47104
          FlsSector047: FlsSectorStartaddress=48128
          FlsSector048: FlsSectorStartaddress=49152
          FlsSector049: FlsSectorStartaddress=50176
          FlsSector050: FlsSectorStartaddress=51200
          FlsSector051: FlsSectorStartaddress=52224
          FlsSector052: FlsSectorStartaddress=53248
          FlsSector053: FlsSectorStartaddress=54272
          FlsSector054: FlsSectorStartaddress=55296
          FlsSector055: FlsSectorStartaddress=56320
          FlsSector056: FlsSectorStartaddress=57344
          FlsSector057: FlsSectorStartaddress=58368
          FlsSector058: FlsSectorStartaddress=59392
          FlsSector059: FlsSectorStartaddress=60416
          FlsSector060: FlsSectorStartaddress=61440
          FlsSector061: FlsSectorStartaddress=62464
          FlsSector062: FlsSectorStartaddress=63488
          FlsSector063: FlsSectorStartaddress=64512
          FlsSector064: FlsSectorStartaddress=65536
          FlsSector065: FlsSectorStartaddress=66560
          FlsSector066: FlsSectorStartaddress=67584
          FlsSector067: FlsSectorStartaddress=68608
          FlsSector068: FlsSectorStartaddress=69632
          FlsSector069: FlsSectorStartaddress=70656
          FlsSector070: FlsSectorStartaddress=71680
          FlsSector071: FlsSectorStartaddress=72704
          FlsSector072: FlsSectorStartaddress=73728
          FlsSector073: FlsSectorStartaddress=74752
          FlsSector074: FlsSectorStartaddress=75776
          FlsSector075: FlsSectorStartaddress=76800
          FlsSector076: FlsSectorStartaddress=77824
          FlsSector077: FlsSectorStartaddress=78848
          FlsSector078: FlsSectorStartaddress=79872
          FlsSector079: FlsSectorStartaddress=80896
          FlsSector080: FlsSectorStartaddress=81920
          FlsSector081: FlsSectorStartaddress=82944
          FlsSector082: FlsSectorStartaddress=83968
          FlsSector083: FlsSectorStartaddress=84992
          FlsSector084: FlsSectorStartaddress=86016
          FlsSector085: FlsSectorStartaddress=87040
          FlsSector086: FlsSectorStartaddress=88064
          FlsSector087: FlsSectorStartaddress=89088
          FlsSector088: FlsSectorStartaddress=90112
          FlsSector089: FlsSectorStartaddress=91136
          FlsSector090: FlsSectorStartaddress=92160
          FlsSector091: FlsSectorStartaddress=93184
          FlsSector092: FlsSectorStartaddress=94208
          FlsSector093: FlsSectorStartaddress=95232
          FlsSector094: FlsSectorStartaddress=96256
          FlsSector095: FlsSectorStartaddress=97280
          FlsSector096: FlsSectorStartaddress=98304
          FlsSector097: FlsSectorStartaddress=99328
          FlsSector098: FlsSectorStartaddress=100352
          FlsSector099: FlsSectorStartaddress=101376
          FlsSector100: FlsSectorStartaddress=102400
          FlsSector101: FlsSectorStartaddress=103424
          FlsSector102: FlsSectorStartaddress=104448
          FlsSector103: FlsSectorStartaddress=105472
          FlsSector104: FlsSectorStartaddress=106496
          FlsSector105: FlsSectorStartaddress=107520
          FlsSector106: FlsSectorStartaddress=108544
          FlsSector107: FlsSectorStartaddress=109568
          FlsSector108: FlsSectorStartaddress=110592
          FlsSector109: FlsSectorStartaddress=111616
          FlsSector110: FlsSectorStartaddress=112640
          FlsSector111: FlsSectorStartaddress=113664
          FlsSector112: FlsSectorStartaddress=114688
          FlsSector113: FlsSectorStartaddress=115712
          FlsSector114: FlsSectorStartaddress=116736
          FlsSector115: FlsSectorStartaddress=117760
          FlsSector116: FlsSectorStartaddress=118784
          FlsSector117: FlsSectorStartaddress=119808
          FlsSector118: FlsSectorStartaddress=120832
          FlsSector119: FlsSectorStartaddress=121856
          FlsSector120: FlsSectorStartaddress=122880
          FlsSector121: FlsSectorStartaddress=123904
          FlsSector122: FlsSectorStartaddress=124928
          FlsSector123: FlsSectorStartaddress=125952
          FlsSector124: FlsSectorStartaddress=126976
          FlsSector125: FlsSectorStartaddress=128000
          FlsSector126: FlsSectorStartaddress=129024
          FlsSector127: FlsSectorStartaddress=130048
    FlsGeneral:
      FlsBaseAddress = 0
      FlsTotalSize = 131072
      FlsCancelApi = true
      FlsCompareApi = true
      FlsDevErrorDetect = true
      FlsDriverIndex = 0
      FlsGetJobResultApi = true
      FlsGetStatusApi = true
      FlsSetModeApi = true
      FlsVersionInfoApi = true
    FlsPublishedInformation: FlsErasedValue=255
  module config Mcu: implementation-config-variant=VARIANT-PRE-COMPILE, module-description=Mcu_Impl
    McuGeneralConfiguration: McuDevErrorDetect=true, McuGetRamStateApi=false, McuInitClock=true, McuNoPll=true, McuPerformResetApi=true, McuVersionInfoApi=true
    McuModuleConfiguration
      McuClockSettingConfig
        McuClockReferencePoint: McuClockReferencePointFrequency=80000000
      4 x McuModeSettingConf:
        NORMAL: McuMode=0, McuVttMode=VTTMCU_MODE_NORMAL
        SLEEP: McuMode=1, McuVttMode=VTTMCU_MODE_SLEEP
        RESET: McuMode=2, McuVttMode=VTTMCU_MODE_RESET
        POWER_OFF: McuMode=3, McuVttMode=VTTMCU_MODE_POWER_OFF
    McuPublishedInformation
      McuResetReasonConf: McuResetReason=0
  module config MemIf: implementation-config-variant=VARIANT-PRE-COMPILE, module-description=MemIf_Impl
    MemIfGeneral: MemIfDevErrorDetect=true, MemIfVersionInfoApi=true
      MemIfDevErrorChecks: MemIfCfgIncludeDet=Det.h, MemIfErrorhook=Det_ReportError, MemIfDevErrorReport=true
    MemIfMemHwA: MemIfMemHwAId=0, MemIfMemHwARef=FeeGeneral
  module config Nm: implementation-config-variant=VARIANT-PRE-COMPILE, module-description=Nm_Impl
    NmGlobalConfig
      NmGlobalFeatures:
        NmComUserDataSupport = false
        NmNodeIdEnabled = false
        NmUserDataEnabled = false
        NmBusSynchronizationEnabled = false
        NmCarWakeUpRxEnabled = false
        NmComControlEnabled = false
        NmCoordinatorSupportEnabled = false
        NmNodeDetectionEnabled = false
        NmPduRxIndicationEnabled = false
        NmRemoteSleepIndEnabled = false
        NmRepeatMsgIndEnabled = false
        NmStateChangeIndEnabled = false
        NmMacroLayerEnabled = false
        NmCoordinatorSyncSupport = false
        NmRuntimeMeasurementSupport = false
        NmCoordinatorRequestChannelsInBusSleep = false
        NmCoordinatorPassiveStartUpForwarding = false
      NmGlobalConstants: NmNumberOfChannels=1
      NmGlobalProperties: NmDevErrorDetect=true, NmVersionInfoApi=false, NmCycletimeMainFunction=0.01
      NmGeneration:
        NmOutOfBoundsWriteSanitizer = false
        NmOutOfBoundsReadSanitizer = false
        NmShortSymbols = false
        NmInterfacesForDeactivatedData = false
        NmReferringKeysInComments = false
    CAN00_f26020e5 (NmChannelConfig):
      NmChannelId = 0
      NmChannelSleepMaster = false
      NmStateReportEnabled = false
      NmSynchronizingNetwork = false
      NmPassiveModeEnabled = false
      NmComMChannelRef = ComMConfigSet/CAN00_f26020e5
      CAN00_CAN_17d0077e (NmBusType)
        NmStandardBusNmConfig: NmStandardBusType=NM_BUSNM_CANNM
  module config NvM: implementation-config-variant=VARIANT-PRE-COMPILE, module-description=NvM_Impl
    NvMConfigBlock (NvMBlockDescriptor):
      NvMBlockCrcType = NVM_CRC16
      NvMCalcRamBlockCrc = false
      NvMNvramBlockIdentifier = 1
      NvMBlockManagementType = NVM_BLOCK_REDUNDANT
      NvMNvBlockNum = 2
      NvMBlockUseCrc = true
      NvMNvBlockLength = 2
      NvMBlockJobPriority = 127
      NvMBlockUseSyncMechanism = false
      NvMBlockWriteProt = false
      NvMBswMBlockStatusInformation = false
      NvMInitBlockCallback = NULL_PTR
      NvMMaxNumOfReadRetries = 0
      NvMMaxNumOfWriteRetries = 0
      NvMRamBlockDataAddress = NULL_PTR
      NvMReadRamBlockFromNvCallback = NULL_PTR
      NvMResistantToChangedSw = true
      NvMRomBlockDataAddress = NULL_PTR
      NvMRomBlockNum = 0
      NvMSelectBlockForReadAll = true
      NvMSelectBlockForWriteAll = true
      NvMSingleBlockCallback = NULL_PTR
      NvMStaticBlockIDCheck = false
      NvMWriteBlockOnce = false
      NvMWriteRamBlockToNvCallback = NULL_PTR
      NvMWriteVerification = false
      NvMWriteVerificationDataSize = 1
      NvMUseServicePorts = true
      NvMUseJobendCallback = false
      NvMUseInitCallback = false
      NvMAutomaticBlockLength = false
      NvMBlockLengthCheck = false
      NvMBlockLengthCheckType = true
      NvMTargetBlockReference
        NvMFeeRef: NvMNameOfFeeBlock=FeeConfigBlock
    NvMCommon:
      NvMApiConfigClass = NVM_API_CONFIG_CLASS_3
      NvMBswMMultiBlockJobStatusInformation = true
      NvMCompiledConfigId = 1
      NvMCrcNumOfBytes = 64
      NvMDatasetSelectionBits = 4
      NvMDevErrorDetect = true
      NvMDrvModeSwitch = false
      NvMDynamicConfiguration = false
      NvMJobPrioritization = false
      NvMMultiBlockCallback = NULL_PTR
      NvMPollingMode = true
      NvMRepeatMirrorOperations = 0
      NvMSetRamBlockStatusApi = true
      NvMSizeStandardJobQueue = 2
      NvMVersionInfoApi = false
      NvMMaxNoOfWriteRetries = 1
      NvMMainFunctionPeriod = 0.01
      NvMUseBlockIdCheck = false
      NvMRepairRedundantBlocksApi = false
    NvMCommonVendorParams:
      NvMMultiblockId = MultiBlockRequest
      NvMCrcIntBuffer = true
      NvMKillWriteAllApi = true
      NvMCfgCbkIncludeList = main.h
      NvMSeterror = Dem_ReportErrorStatus
      NvMCfgIncludeDem = Dem.h
      NvMCfgCbkIncludeList = Dem.h
      NvMCfgCbkIncludeList = Dem_Cbk.h
      NvMDevErrorChecks: NvMDebugReporting=true, NvMErrorhook=Det_ReportError, NvMCfgIncludeDet=Det.h
    NvmDemEventParameterRefs:
      NVM_E_INTEGRITY_FAILED = AutoCreatedDemEvent_NVM_E_INTEGRITY_FAILED
      NVM_E_LOSS_OF_REDUNDANCY = AutoCreatedDemEvent_NVM_E_LOSS_OF_REDUNDANCY
      NVM_E_QUEUE_OVERFLOW = AutoCreatedDemEvent_NVM_E_QUEUE_OVERFLOW
      NVM_E_REQ_FAILED = AutoCreatedDemEvent_NVM_E_REQ_FAILED
      NVM_E_VERIFY_FAILED = AutoCreatedDemEvent_NVM_E_VERIFY_FAILED
      NVM_E_WRITE_PROTECTED = AutoCreatedDemEvent_NVM_E_WRITE_PROTECTED
      NVM_E_WRONG_BLOCK_ID = AutoCreatedDemEvent_NVM_E_WRONG_BLOCK_ID
    12 x NvMBlockDescriptor, all with NvMBlockCrcType=NVM_CRC16, NvMBlockManagementType=NVM_BLOCK_NATIVE, NvMSelectBlockForReadAll=true, NvMSelectBlockForWriteAll=true, NvMWriteRamBlockToNvCallback=NULL_PTR, NvMBswMBlockStatusInformation=false, NvMBlockUseCrc=true, NvMBlockUseSyncMechanism=false, NvMCalcRamBlockCrc=false, NvMBlockJobPriority=127, NvMBlockWriteProt=false, NvMNvBlockNum=1, NvMReadRamBlockFromNvCallback=NULL_PTR, NvMWriteBlockOnce=false, NvMBlockLengthCheck=true, NvMBlockLengthCheckType=true:
      CpApMySwcSnNvMPimLightOnOffCounter: NvMInitBlockCallback=NULL_PTR, NvMResistantToChangedSw=false, NvMUseInitCallback=false, NvMUseJobendCallback=false, NvMSingleBlockCallback=NULL_PTR, NvMNvBlockLength=4, NvMNvramBlockIdentifier=2, NvMRamBlockDataAddress=Rte_CpApMySwc_PimLightOnOffCounter, NvMRomBlockDataAddress=NULL_PTR, NvMUseServicePorts=true, NvMAutomaticBlockLength=true  # UC:Derived from NvBlockNeeds
        NvMTargetBlockReference
          NvMFeeRef: NvMNameOfFeeBlock=FeeCpApMySwcSnNvMPimLightOnOffCounter
      CpApMySwcSnNvM_PimOdometer: NvMInitBlockCallback=NULL_PTR, NvMResistantToChangedSw=false, NvMUseInitCallback=false, NvMUseJobendCallback=true, NvMSingleBlockCallback=NULL_PTR, NvMNvBlockLength=4, NvMNvramBlockIdentifier=13, NvMRamBlockDataAddress=Rte_CpApMySwc_PimOdometer, NvMRomBlockDataAddress=Rte_CtApMySwc_CalOdometer, NvMUseServicePorts=true, NvMAutomaticBlockLength=true  # UC:Derived from NvBlockNeeds
        NvMTargetBlockReference
          NvMFeeRef: NvMNameOfFeeBlock=FeeCpApMySwcSnNvM_PimOdometer
      DemAdminDataBlock: NvMInitBlockCallback=Dem_NvM_InitAdminData, NvMResistantToChangedSw=true, NvMUseInitCallback=true, NvMUseJobendCallback=false, NvMSingleBlockCallback=Dem_NvM_JobFinished, NvMNvBlockLength=10, NvMNvramBlockIdentifier=3, NvMRamBlockDataAddress=Dem_Cfg_AdminData, NvMRomBlockDataAddress=NULL_PTR, NvMUseServicePorts=false, NvMAutomaticBlockLength=false
        NvMTargetBlockReference
          NvMFeeRef: NvMNameOfFeeBlock=FeeDemAdminDataBlock
      DemStatusDataBlock: NvMInitBlockCallback=Dem_NvM_InitStatusData, NvMResistantToChangedSw=true, NvMUseInitCallback=true, NvMUseJobendCallback=false, NvMSingleBlockCallback=Dem_NvM_JobFinished, NvMNvBlockLength=22, NvMNvramBlockIdentifier=4, NvMRamBlockDataAddress=Dem_Cfg_StatusData, NvMRomBlockDataAddress=NULL_PTR, NvMUseServicePorts=false, NvMAutomaticBlockLength=false
        NvMTargetBlockReference
          NvMFeeRef: NvMNameOfFeeBlock=FeeDemStatusDataBlock
      DemPrimaryDataBlock0: NvMInitBlockCallback=NULL_PTR, NvMResistantToChangedSw=true, NvMUseInitCallback=false, NvMUseJobendCallback=false, NvMSingleBlockCallback=Dem_NvM_JobFinished, NvMNvBlockLength=20, NvMNvramBlockIdentifier=5, NvMRamBlockDataAddress=Dem_PrimaryEntry_0, NvMRomBlockDataAddress=Dem_MemoryEntryInit, NvMUseServicePorts=false, NvMAutomaticBlockLength=false
        NvMTargetBlockReference
          NvMFeeRef: NvMNameOfFeeBlock=FeeDemPrimaryDataBlock0
      DemPrimaryDataBlock1: NvMInitBlockCallback=NULL_PTR, NvMResistantToChangedSw=true, NvMUseInitCallback=false, NvMUseJobendCallback=false, NvMSingleBlockCallback=Dem_NvM_JobFinished, NvMNvBlockLength=20, NvMNvramBlockIdentifier=6, NvMRamBlockDataAddress=Dem_PrimaryEntry_1, NvMRomBlockDataAddress=Dem_MemoryEntryInit, NvMUseServicePorts=false, NvMAutomaticBlockLength=false
        NvMTargetBlockReference
          NvMFeeRef: NvMNameOfFeeBlock=FeeDemPrimaryDataBlock1
      DemPrimaryDataBlock2: NvMInitBlockCallback=NULL_PTR, NvMResistantToChangedSw=true, NvMUseInitCallback=false, NvMUseJobendCallback=false, NvMSingleBlockCallback=Dem_NvM_JobFinished, NvMNvBlockLength=20, NvMNvramBlockIdentifier=7, NvMRamBlockDataAddress=Dem_PrimaryEntry_2, NvMRomBlockDataAddress=Dem_MemoryEntryInit, NvMUseServicePorts=false, NvMAutomaticBlockLength=false
        NvMTargetBlockReference
          NvMFeeRef: NvMNameOfFeeBlock=FeeDemPrimaryDataBlock2
      DemPrimaryDataBlock3: NvMInitBlockCallback=NULL_PTR, NvMResistantToChangedSw=true, NvMUseInitCallback=false, NvMUseJobendCallback=false, NvMSingleBlockCallback=Dem_NvM_JobFinished, NvMNvBlockLength=20, NvMNvramBlockIdentifier=8, NvMRamBlockDataAddress=Dem_PrimaryEntry_3, NvMRomBlockDataAddress=Dem_MemoryEntryInit, NvMUseServicePorts=false, NvMAutomaticBlockLength=false
        NvMTargetBlockReference
          NvMFeeRef: NvMNameOfFeeBlock=FeeDemPrimaryDataBlock3
      DemPrimaryDataBlock4: NvMInitBlockCallback=NULL_PTR, NvMResistantToChangedSw=true, NvMUseInitCallback=false, NvMUseJobendCallback=false, NvMSingleBlockCallback=Dem_NvM_JobFinished, NvMNvBlockLength=20, NvMNvramBlockIdentifier=9, NvMRamBlockDataAddress=Dem_PrimaryEntry_4, NvMRomBlockDataAddress=Dem_MemoryEntryInit, NvMUseServicePorts=false, NvMAutomaticBlockLength=false
        NvMTargetBlockReference
          NvMFeeRef: NvMNameOfFeeBlock=FeeDemPrimaryDataBlock4
      DemPrimaryDataBlock5: NvMInitBlockCallback=NULL_PTR, NvMResistantToChangedSw=true, NvMUseInitCallback=false, NvMUseJobendCallback=false, NvMSingleBlockCallback=Dem_NvM_JobFinished, NvMNvBlockLength=20, NvMNvramBlockIdentifier=10, NvMRamBlockDataAddress=Dem_PrimaryEntry_5, NvMRomBlockDataAddress=Dem_MemoryEntryInit, NvMUseServicePorts=false, NvMAutomaticBlockLength=false
        NvMTargetBlockReference
          NvMFeeRef: NvMNameOfFeeBlock=FeeDemPrimaryDataBlock5
      DemPrimaryDataBlock6: NvMInitBlockCallback=NULL_PTR, NvMResistantToChangedSw=true, NvMUseInitCallback=false, NvMUseJobendCallback=false, NvMSingleBlockCallback=Dem_NvM_JobFinished, NvMNvBlockLength=20, NvMNvramBlockIdentifier=11, NvMRamBlockDataAddress=Dem_PrimaryEntry_6, NvMRomBlockDataAddress=Dem_MemoryEntryInit, NvMUseServicePorts=false, NvMAutomaticBlockLength=false
        NvMTargetBlockReference
          NvMFeeRef: NvMNameOfFeeBlock=FeeDemPrimaryDataBlock6
      DemPrimaryDataBlock7: NvMInitBlockCallback=NULL_PTR, NvMResistantToChangedSw=true, NvMUseInitCallback=false, NvMUseJobendCallback=false, NvMSingleBlockCallback=Dem_NvM_JobFinished, NvMNvBlockLength=20, NvMNvramBlockIdentifier=12, NvMRamBlockDataAddress=Dem_PrimaryEntry_7, NvMRomBlockDataAddress=Dem_MemoryEntryInit, NvMUseServicePorts=false, NvMAutomaticBlockLength=false
        NvMTargetBlockReference
          NvMFeeRef: NvMNameOfFeeBlock=FeeDemPrimaryDataBlock7
  module config Os: implementation-config-variant=VARIANT-PRE-COMPILE, module-description=Os_Impl
    OsOS:
      OsStackMonitoring = true
      OsOSStackUsageMeasurement = AUTO
      OsStatus = EXTENDED
      OsUseGetServiceId = false
      OsUseParameterAccess = false
      OsUseResScheduler = false
      OsOSCallISRHooks = false
      OsOSEnumeratedUnhandledISRs = false
      OsOSTypeHeaderInclude = true
      OsOSUserConfigurationVersion = 1
      OsOSCompiler = MicrosoftVisualC
      OsScalabilityClass = SC1
      OsOSSCHEDULE
        AUTO
      OsOSCC
        AUTO
      OsOSProtectionHookReaction
        ALL
      OsOSSystemTimer
        Standard: OsOSEnableNesting=false, OsOSTickTime=1000, OsOSInterruptPriority=1
      OsOSTimingMeasurement
        TRUE: OsOSGlobalConfig=AsSelected
      OsOSAPIOptimization
        Automatic
      OsOSInternalTrace
        FALSE
      OsHooks: OsErrorHook=false, OsPostTaskHook=false, OsPreTaskHook=false, OsShutdownHook=true, OsStartupHook=false
    OsResource: OsResourceProperty=STANDARD
    VectorCommonData: BswmdVersion=5.01.04
    OsImplementationInformation: OsVectorOilVersion=4.0, OsVectorImplementationName=CANoeOsekEmu.i40, OsBswmdStyleVersion=2
    OSDEFAULTAPPMODE (OsAppMode)
    SystemTimer (OsCounter): OsCounterMaxAllowedValue=2147483647, OsCounterTicksPerBase=1, OsCounterMinCycle=1, OsSecondsPerTick=1234567890, OsCounterType=SOFTWARE
    4 x OsTask, all with OsTaskActivation=1, OsTaskComputationTime=0, OsTaskPeriod=0, OsTaskDeadline=0:
      SchM_Task: OsTaskPriority=6, OsTaskSchedule=FULL, OsTaskTYPE=EXTENDED, OsTaskEventRef=Os/Rte_Ev_Cyclic2_SchM_Task_0_10ms, OsTaskEventRef=Os/Rte_Ev_Cyclic2_SchM_Task_0_20ms, OsTaskEventRef=Os/Rte_Ev_Cyclic2_SchM_Task_0_5ms
      Init_Task: OsTaskPriority=4, OsTaskSchedule=NON, OsTaskTYPE=BASIC
        OsTaskAutostart: OsTaskAppModeRef=Os/OSDEFAULTAPPMODE
      My_Task: OsTaskPriority=2, OsTaskSchedule=FULL, OsTaskTYPE=EXTENDED, OsTaskEventRef=Os/Rte_Ev_Run_CpApMySwc_RCtApMySwcCode, OsTaskEventRef=Os/Rte_Ev_Run_CpApMySwc_RCtApMySwcComM_ModeChange_FULL_COMM_Entry, OsTaskEventRef=Os/Rte_Ev_Run_CpApMySwc_RCtApMySwcComM_ModeChange_FULL_COMM_Exit
      IO_Task: OsTaskPriority=3, OsTaskSchedule=FULL, OsTaskTYPE=EXTENDED, OsTaskEventRef=Os/Rte_Ev_Cyclic_IO_Task_0_200ms, OsTaskEventRef=Os/Rte_Ev_Run_CpSaDisplay_RCtApDisplayBusStateHandling, OsTaskEventRef=Os/Rte_Ev_Run_CpSaDisplay_RCtApDisplayLightOnOffHandling, OsTaskEventRef=Os/Rte_Ev_Run_CpSaDisplay_RCtApDisplayOdometerValue, OsTaskEventRef=Os/Rte_Ev_Run_CpSaDisplay_RCtApDisplayOdometerWriteRequestPending, OsTaskEventRef=Os/Rte_Ev_Run_CpSaInteriorLightFront_RCtSaInteriorLightSwitchLight
    Rte_Al_TE2_SchM_Task_0_10ms (OsAlarm): OsAlarmCounterRef=Os/SystemTimer
      OsAlarmAction
        OsAlarmSetEvent: OsAlarmSetEventRef=Os/Rte_Ev_Cyclic2_SchM_Task_0_10ms, OsAlarmSetEventTaskRef=Os/SchM_Task
    Rte_Ev_Cyclic2_SchM_Task_0_10ms (OsEvent)
    Rte_Al_TE2_SchM_Task_0_20ms (OsAlarm): OsAlarmCounterRef=Os/SystemTimer
      OsAlarmAction
        OsAlarmSetEvent: OsAlarmSetEventRef=Os/Rte_Ev_Cyclic2_SchM_Task_0_20ms, OsAlarmSetEventTaskRef=Os/SchM_Task
    6 x OsEvent:
      Rte_Ev_Cyclic2_SchM_Task_0_20ms
      Rte_Ev_Run_CpSaDisplay_RCtApDisplayBusStateHandling
      Rte_Ev_Run_CpSaDisplay_RCtApDisplayLightOnOffHandling
      Rte_Ev_Run_CpSaDisplay_RCtApDisplayOdometerValue
      Rte_Ev_Run_CpSaDisplay_RCtApDisplayOdometerWriteRequestPending
      Rte_Ev_Run_CpSaInteriorLightFront_RCtSaInteriorLightSwitchLight
    Rte_Al_TE_IO_Task_0_200ms (OsAlarm): OsAlarmCounterRef=Os/SystemTimer
      OsAlarmAction
        OsAlarmSetEvent: OsAlarmSetEventRef=Os/Rte_Ev_Cyclic_IO_Task_0_200ms, OsAlarmSetEventTaskRef=Os/IO_Task
    Rte_Al_TE_CpApMySwc_RCtApMySwcCode (OsAlarm): OsAlarmCounterRef=Os/SystemTimer
      OsAlarmAction
        OsAlarmSetEvent: OsAlarmSetEventRef=Os/Rte_Ev_Run_CpApMySwc_RCtApMySwcCode, OsAlarmSetEventTaskRef=Os/My_Task
    4 x OsEvent:
      Rte_Ev_Cyclic_IO_Task_0_200ms
      Rte_Ev_Run_CpApMySwc_RCtApMySwcCode
      Rte_Ev_Run_CpApMySwc_RCtApMySwcComM_ModeChange_FULL_COMM_Entry
      Rte_Ev_Run_CpApMySwc_RCtApMySwcComM_ModeChange_FULL_COMM_Exit
    Rte_Al_TE2_SchM_Task_0_5ms (OsAlarm): OsAlarmCounterRef=Os/SystemTimer
      OsAlarmAction
        OsAlarmSetEvent: OsAlarmSetEventRef=Os/Rte_Ev_Cyclic2_SchM_Task_0_5ms, OsAlarmSetEventTaskRef=Os/SchM_Task
    Rte_Ev_Cyclic2_SchM_Task_0_5ms (OsEvent)
  module config PduR: implementation-config-variant=VARIANT-PRE-COMPILE, module-description=PduR_Impl
    Com (PduRBswModules):
      PduRCancelReceive = false
      PduRCancelTransmit = false
      PduRChangeParameterRequestApi = false
      PduRCommunicationInterface = true
      PduRLowerModule = false
      PduRTransportProtocol = false
      PduRTriggertransmit = false
      PduRTxConfirmation = false
      PduRUpperModule = true
      PduRUseTag = false
      PduRBswModuleRef = Com
    PduRRoutingTables: PduRConfigurationId=0
      PduRRoutingTable
        5 x PduRRoutingPath:
          Can_PT_msg_Receive_0fb271d2_In: PduRRoutingPathCommunicationType=COMMUNICATION_INTERFACE
            SRC_Can_PT_msg_Receive_0fb271d2_In (PduRSrcPdu): PduRSourcePduHandleId=0, PduRSrcPduDirection=RECEIVE, PduRSrcPduRef=msg_Receive_ff2f8fca, PduRSrcPduPduRBswModulesRef=PduR/CanIf
            DST_Can_PT_msg_Receive_0fb271d2_In (PduRDestPdu):
              PduRDestPduHandleId = 0
              PduRDestPduDirection = RECEIVE
              PduRDestPduRoutingType = API_FORWARDING
              PduRTransmissionConfirmation = false
              PduRDestPduRef = msg_Receive_ff2f8fca
              PduRDestPduPduRBswModulesRef = PduR/Com
          Can_PT_msg_Transmit_0fb271d2_Out: PduRRoutingPathCommunicationType=COMMUNICATION_INTERFACE
            SRC_Can_PT_msg_Transmit_0fb271d2_Out (PduRSrcPdu): PduRSourcePduHandleId=0, PduRSrcPduDirection=TRANSMIT, PduRSrcPduRef=msg_Transmit_ca20852c, PduRSrcPduPduRBswModulesRef=PduR/Com
            DST_Can_PT_msg_Transmit_0fb271d2_Out (PduRDestPdu):
              PduRDestPduHandleId = 0
              PduRDestPduDirection = TRANSMIT
              PduRDestPduRoutingType = API_FORWARDING
              PduRTransmissionConfirmation = false
              PduRDestPduDataProvision = PDUR_DIRECT
              PduRDestPduRef = msg_Transmit_ca20852c
              PduRDestPduPduRBswModulesRef = PduR/CanIf
          Can_PT_msg_diag_RequestGlobal_0fb271d2_In: PduRRoutingPathCommunicationType=TRANSPORT_PROTOCOL
            SRC_Can_PT_msg_diag_RequestGlobal_0fb271d2_In (PduRSrcPdu):
              PduRSourcePduHandleId = 0
              PduRSrcPduDirection = RECEIVE
              PduRSrcPduRef = EcucPduCollection/PT_msg_diag_RequestGlobal_PP_msg_diag_RequestGlobal_Rx_0fb271d2_5e566ad9
              PduRSrcPduPduRBswModulesRef = PduR/CanTp
            DST_Can_PT_msg_diag_RequestGlobal_0fb271d2_In (PduRDestPdu):
              PduRDestPduHandleId = 0
              PduRDestPduDirection = RECEIVE
              PduRDestPduRoutingType = API_FORWARDING
              PduRDestPduRef = EcucPduCollection/PT_msg_diag_RequestGlobal_PP_msg_diag_RequestGlobal_Rx_0fb271d2_5e566ad9
              PduRDestPduPduRBswModulesRef = PduR/Dcm
          Can_PT_msg_diag_Response_MyECU_0fb271d2_Out: PduRRoutingPathCommunicationType=TRANSPORT_PROTOCOL
            SRC_Can_PT_msg_diag_Response_MyECU_0fb271d2_Out (PduRSrcPdu):
              PduRSourcePduHandleId = 1
              PduRSrcPduDirection = TRANSMIT
              PduRSrcPduRef = EcucPduCollection/PT_msg_diag_Response_MyECU_PP_msg_diag_Response_MyECU_Tx_0fb271d2_5e566ad9
              PduRSrcPduPduRBswModulesRef = PduR/Dcm
            DST_Can_PT_msg_diag_Response_MyECU_0fb271d2_Out (PduRDestPdu):
              PduRDestPduHandleId = 0
              PduRDestPduDirection = TRANSMIT
              PduRDestPduRoutingType = API_FORWARDING
              PduRDestPduRef = EcucPduCollection/PT_msg_diag_Response_MyECU_PP_msg_diag_Response_MyECU_Tx_0fb271d2_5e566ad9
              PduRDestPduPduRBswModulesRef = PduR/CanTp
          Can_PT_msg_diag_Request_MyECU_0fb271d2_In: PduRRoutingPathCommunicationType=TRANSPORT_PROTOCOL
            SRC_Can_PT_msg_diag_Request_MyECU_0fb271d2_In (PduRSrcPdu):
              PduRSourcePduHandleId = 1
              PduRSrcPduDirection = RECEIVE
              PduRSrcPduRef = EcucPduCollection/PT_msg_diag_Request_MyECU_PP_msg_diag_Request_MyECU_Rx_0fb271d2_5e566ad9
              PduRSrcPduPduRBswModulesRef = PduR/CanTp
            DST_Can_PT_msg_diag_Request_MyECU_0fb271d2_In (PduRDestPdu):
              PduRDestPduHandleId = 1
              PduRDestPduDirection = RECEIVE
              PduRDestPduRoutingType = API_FORWARDING
              PduRDestPduRef = EcucPduCollection/PT_msg_diag_Request_MyECU_PP_msg_diag_Request_MyECU_Rx_0fb271d2_5e566ad9
              PduRDestPduPduRBswModulesRef = PduR/Dcm
    CanIf (PduRBswModules):
      PduRCancelReceive = false
      PduRCancelTransmit = false
      PduRChangeParameterRequestApi = false
      PduRCommunicationInterface = true
      PduRLowerModule = true
      PduRTransportProtocol = false
      PduRTriggertransmit = false
      PduRTxConfirmation = false
      PduRUpperModule = false
      PduRUseTag = false
      PduRBswModuleRef = CanIf
    PduRGeneral: PduRDevErrorDetect=true, PduRVersionInfoApi=false, PduRMetaDataSupport=false, PduRPduCallback=false
      PduRGeneration:
        PduROutOfBoundsWriteProtectionStrategy = NONE
        PduROutOfBoundsWriteSanitizer = false
        PduROutOfBoundsReadSanitizer = false
        PduRNumericalDataTypeMinimizationStrategy = WITH_CAST
        PduRReduceConstantData2Define = false
        PduRBoolDataInArrayOfStructStrategy = BITMASKING
        PduRDeduplicateIndirectedData = true
        PduRDataDeduplicationStrategy = WITH_CAST
        PduRReduceBoolDataByNegationThreshold = 2
        PduRReduceBoolDataByNumericalComparisonThreshold = 2
        PduRReduceBoolDataByNumericalRelationThreshold = 2
        PduRReduceBoolDataByNumericalOperandStrategy = WITH_ANY_VALUE
        PduRReduceNumericalDataByOffsetThreshold = 2
        PduRReduceNumericalDataByArraySubtractionThreshold = 2
        PduRReduceDataByStreaming = false
        PduRShortSymbols = false
        PduRInterfacesForDeactivatedData = false
        PduRReferringKeysInComments = false
    CanTp (PduRBswModules):
      PduRCancelReceive = false
      PduRCancelTransmit = false
      PduRChangeParameterRequestApi = false
      PduRCommunicationInterface = false
      PduRLowerModule = true
      PduRTransportProtocol = true
      PduRTriggertransmit = false
      PduRTxConfirmation = true
      PduRUpperModule = false
      PduRUseTag = false
      PduRBswModuleRef = CanTp
    Dcm (PduRBswModules):
      PduRCancelReceive = false
      PduRCancelTransmit = false
      PduRChangeParameterRequestApi = false
      PduRCommunicationInterface = false
      PduRLowerModule = false
      PduRTransportProtocol = true
      PduRTriggertransmit = false
      PduRTxConfirmation = true
      PduRUpperModule = true
      PduRUseTag = true
      PduRBswModuleRef = Dcm

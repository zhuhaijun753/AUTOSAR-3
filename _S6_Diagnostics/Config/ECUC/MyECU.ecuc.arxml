[part 2 of 2: package /ActiveEcuC]
AUTOSAR XML (schema 4-2-1)
package /ActiveEcuC  (continued)
  module config Rte: implementation-config-variant=VARIANT-PRE-COMPILE, module-description=Rte_Impl
    CanSM (RteBswModuleInstance): RteBswImplementationRef=CanSM_Impl, RteBswModuleConfigurationRef=CanSM
      5 x RteBswExclusiveAreaImpl, all with RteExclusiveAreaImplMechanism=ALL_INTERRUPT_BLOCKING:
        CANSM_EXCLUSIVE_AREA_{1..5}: RteBswExclusiveAreaRef=CANSM_EXCLUSIVE_AREA_{1..5}
      CanSM_MainFunctionTimingEvent0 (RteBswEventToTaskMapping):
        RteBswImmediateRestart = false
        RteBswPositionInTask = 1
        RteBswEventRef = CanSM_MainFunctionTimingEvent0
        RteBswMappedToTaskRef = Os/SchM_Task
        RteBswUsedOsEventRef = Os/Rte_Ev_Cyclic2_SchM_Task_0_10ms
        RteBswUsedOsAlarmRef = Os/Rte_Al_TE2_SchM_Task_0_10ms
    RteGeneration:
      RteCalibrationSupport = NONE
      RteCodeVendorId = 30
      RteDevErrorDetect = true
      RteDevErrorDetectUninit = false
      RteGenerationMode = COMPATIBILITY_MODE
      RteIocInteractionReturnValue = RTE_IOC
      RteMeasurementSupport = false
      RteOptimizationMode = RUNTIME
      RteValueRangeCheckEnabled = false
      RteVfbTraceEnabled = false
    Det (RteBswModuleInstance): RteBswImplementationRef=Det_Impl, RteBswModuleConfigurationRef=Det
      DET_EXCLUSIVE_AREA_0 (RteBswExclusiveAreaImpl): RteExclusiveAreaImplMechanism=ALL_INTERRUPT_BLOCKING, RteBswExclusiveAreaRef=DET_EXCLUSIVE_AREA_0
    CanIf (RteBswModuleInstance): RteBswImplementationRef=CanIf_Impl, RteBswModuleConfigurationRef=CanIf
      8 x RteBswExclusiveAreaImpl, all with RteExclusiveAreaImplMechanism=ALL_INTERRUPT_BLOCKING:
        CANIF_EXCLUSIVE_AREA_{0..7}: RteBswExclusiveAreaRef=CANIF_EXCLUSIVE_AREA_{0..7}
    RteBswGeneral: RteSchMVersionInfoApi=false, RteUseComShadowSignalApi=false
    7 x RteBswModuleInstance:
      Nm: RteBswImplementationRef=Nm_Impl, RteBswModuleConfigurationRef=Nm
        NM_EXCLUSIVE_AREA_0 (RteBswExclusiveAreaImpl): RteExclusiveAreaImplMechanism=ALL_INTERRUPT_BLOCKING, RteBswExclusiveAreaRef=NM_EXCLUSIVE_AREA_0
        NM_EXCLUSIVE_AREA_1 (RteBswExclusiveAreaImpl): RteExclusiveAreaImplMechanism=ALL_INTERRUPT_BLOCKING, RteBswExclusiveAreaRef=NM_EXCLUSIVE_AREA_1
      PduR: RteBswImplementationRef=PduR_Impl, RteBswModuleConfigurationRef=PduR
        PDUR_EXCLUSIVE_AREA_0 (RteBswExclusiveAreaImpl): RteExclusiveAreaImplMechanism=ALL_INTERRUPT_BLOCKING, RteBswExclusiveAreaRef=PDUR_EXCLUSIVE_AREA_0
        PDUR_EXCLUSIVE_AREA_1 (RteBswExclusiveAreaImpl): RteExclusiveAreaImplMechanism=ALL_INTERRUPT_BLOCKING, RteBswExclusiveAreaRef=PDUR_EXCLUSIVE_AREA_1
      Com: RteBswImplementationRef=Com_Impl, RteBswModuleConfigurationRef=Com
        Com_MainFunctionRxTimingEvent0 (RteBswEventToTaskMapping):
          RteBswImmediateRestart = false
          RteBswPositionInTask = 3
          RteBswEventRef = Com_MainFunctionRxTimingEvent0
          RteBswMappedToTaskRef = Os/SchM_Task
          RteBswUsedOsEventRef = Os/Rte_Ev_Cyclic2_SchM_Task_0_10ms
          RteBswUsedOsAlarmRef = Os/Rte_Al_TE2_SchM_Task_0_10ms
        Com_MainFunctionTxTimingEvent0 (RteBswEventToTaskMapping):
          RteBswImmediateRestart = false
          RteBswPositionInTask = 5
          RteBswEventRef = Com_MainFunctionTxTimingEvent0
          RteBswMappedToTaskRef = Os/SchM_Task
          RteBswUsedOsEventRef = Os/Rte_Ev_Cyclic2_SchM_Task_0_10ms
          RteBswUsedOsAlarmRef = Os/Rte_Al_TE2_SchM_Task_0_10ms
        4 x RteBswExclusiveAreaImpl, all with RteExclusiveAreaImplMechanism=ALL_INTERRUPT_BLOCKING:
          COM_EXCLUSIVE_AREA_COMMON: RteBswExclusiveAreaRef=COM_EXCLUSIVE_AREA_COMMON
          COM_EXCLUSIVE_AREA_TX: RteBswExclusiveAreaRef=COM_EXCLUSIVE_AREA_TX
          COM_EXCLUSIVE_AREA_RX: RteBswExclusiveAreaRef=COM_EXCLUSIVE_AREA_RX
          COM_EXCLUSIVE_AREA_ROUTE: RteBswExclusiveAreaRef=COM_EXCLUSIVE_AREA_ROUTE
      Can: RteBswImplementationRef=Can_Impl, RteBswModuleConfigurationRef=Can
        7 x RteBswExclusiveAreaImpl, all with RteExclusiveAreaImplMechanism=ALL_INTERRUPT_BLOCKING:
          CAN_EXCLUSIVE_AREA_{0..6}: RteBswExclusiveAreaRef=CAN_EXCLUSIVE_AREA_{0..6}
        3 x RteBswEventToTaskMapping, all with RteBswImmediateRestart=false, RteBswMappedToTaskRef=Os/SchM_Task, RteBswUsedOsEventRef=Os/Rte_Ev_Cyclic2_SchM_Task_0_10ms, RteBswUsedOsAlarmRef=Os/Rte_Al_TE2_SchM_Task_0_10ms:
          Can_MainFunction_ModeTimingEvent0: RteBswPositionInTask=9, RteBswEventRef=Can_MainFunction_ModeTimingEvent0
          Can_MainFunction_BusOffTimingEvent0: RteBswPositionInTask=11, RteBswEventRef=Can_MainFunction_BusOffTimingEvent0
          Can_MainFunction_WakeupTimingEvent0: RteBswPositionInTask=12, RteBswEventRef=Can_MainFunction_WakeupTimingEvent0
      EcuM: RteBswImplementationRef=EcuM_Impl, RteBswModuleConfigurationRef=EcuM
        ECUM_EXCLUSIVE_AREA_0 (RteBswExclusiveAreaImpl): RteExclusiveAreaImplMechanism=ALL_INTERRUPT_BLOCKING, RteBswExclusiveAreaRef=ECUM_EXCLUSIVE_AREA_0
        EcuM_MainFunctionTimingEvent0 (RteBswEventToTaskMapping):
          RteBswImmediateRestart = false
          RteBswPositionInTask = 7
          RteBswEventRef = EcuM_MainFunctionTimingEvent0
          RteBswMappedToTaskRef = Os/SchM_Task
          RteBswUsedOsEventRef = Os/Rte_Ev_Cyclic2_SchM_Task_0_10ms
          RteBswUsedOsAlarmRef = Os/Rte_Al_TE2_SchM_Task_0_10ms
        ECUM_EXCLUSIVE_AREA_1 (RteBswExclusiveAreaImpl): RteExclusiveAreaImplMechanism=ALL_INTERRUPT_BLOCKING, RteBswExclusiveAreaRef=ECUM_EXCLUSIVE_AREA_1
        ECUM_EXCLUSIVE_AREA_2 (RteBswExclusiveAreaImpl): RteExclusiveAreaImplMechanism=ALL_INTERRUPT_BLOCKING, RteBswExclusiveAreaRef=ECUM_EXCLUSIVE_AREA_2
      CanNm: RteBswImplementationRef=CanNm_Impl, RteBswModuleConfigurationRef=CanNm
        6 x RteBswExclusiveAreaImpl, all with RteExclusiveAreaImplMechanism=ALL_INTERRUPT_BLOCKING:
          CANNM_EXCLUSIVE_AREA_{0..5}: RteBswExclusiveAreaRef=CANNM_EXCLUSIVE_AREA_{0..5}
        CanNm_MainFunctionTimingEvent0 (RteBswEventToTaskMapping):
          RteBswImmediateRestart = false
          RteBswPositionInTask = 2
          RteBswEventRef = CanNm_MainFunctionTimingEvent0
          RteBswMappedToTaskRef = Os/SchM_Task
          RteBswUsedOsEventRef = Os/Rte_Ev_Cyclic2_SchM_Task_0_10ms
          RteBswUsedOsAlarmRef = Os/Rte_Al_TE2_SchM_Task_0_10ms
      ComM: RteBswImplementationRef=ComM_Impl, RteBswModuleConfigurationRef=ComM
        COMM_EXCLUSIVE_AREA_0 (RteBswExclusiveAreaImpl): RteExclusiveAreaImplMechanism=ALL_INTERRUPT_BLOCKING, RteBswExclusiveAreaRef=COMM_EXCLUSIVE_AREA_0
        COMM_EXCLUSIVE_AREA_1 (RteBswExclusiveAreaImpl): RteExclusiveAreaImplMechanism=ALL_INTERRUPT_BLOCKING, RteBswExclusiveAreaRef=COMM_EXCLUSIVE_AREA_1
        ComM_MainFunction_0TimingEvent0 (RteBswEventToTaskMapping):
          RteBswImmediateRestart = false
          RteBswPositionInTask = 0
          RteBswEventRef = ComM_MainFunction_0TimingEvent0
          RteBswMappedToTaskRef = Os/SchM_Task
          RteBswUsedOsEventRef = Os/Rte_Ev_Cyclic2_SchM_Task_0_20ms
          RteBswUsedOsAlarmRef = Os/Rte_Al_TE2_SchM_Task_0_20ms
    RteInitializationBehavior: RteInitializationStrategy=RTE_INITIALIZATION_STRATEGY_AT_DATA_DECLARATION, RteSectionInitializationPolicy=, RteSectionInitializationPolicy=INIT
    RteOsInteraction
      5 x RteUsedOsActivation, all with RteExpectedActivationOffset=0, RteExpectedTickDuration=0:
        Rte_Al_TE2_SchM_Task_0_10ms: RteActivationOsAlarmRef=Os/Rte_Al_TE2_SchM_Task_0_10ms, RteActivationOsTaskRef=Os/SchM_Task
        Rte_Al_TE2_SchM_Task_0_20ms: RteActivationOsAlarmRef=Os/Rte_Al_TE2_SchM_Task_0_20ms, RteActivationOsTaskRef=Os/SchM_Task
        Rte_Al_TE_IO_Task_0_200ms: RteActivationOsAlarmRef=Os/Rte_Al_TE_IO_Task_0_200ms, RteActivationOsTaskRef=Os/IO_Task
        Rte_Al_TE_CpApMySwc_RCtApMySwcCode: RteActivationOsAlarmRef=Os/Rte_Al_TE_CpApMySwc_RCtApMySwcCode, RteActivationOsTaskRef=Os/My_Task
        Rte_Al_TE2_SchM_Task_0_5ms: RteActivationOsAlarmRef=Os/Rte_Al_TE2_SchM_Task_0_5ms, RteActivationOsTaskRef=Os/SchM_Task
    5 x RteBswModuleInstance:
      Fee: RteBswImplementationRef=Fee_Impl, RteBswModuleConfigurationRef=Fee
        FEE_EXCLUSIVE_AREA_0 (RteBswExclusiveAreaImpl): RteExclusiveAreaImplMechanism=ALL_INTERRUPT_BLOCKING, RteBswExclusiveAreaRef=FEE_EXCLUSIVE_AREA_0
        Fee_MainFunctionTimingEvent0 (RteBswEventToTaskMapping):
          RteBswImmediateRestart = false
          RteBswPositionInTask = 13
          RteBswEventRef = Fee_MainFunctionTimingEvent0
          RteBswMappedToTaskRef = Os/SchM_Task
          RteBswUsedOsEventRef = Os/Rte_Ev_Cyclic2_SchM_Task_0_5ms
          RteBswUsedOsAlarmRef = Os/Rte_Al_TE2_SchM_Task_0_5ms
      NvM: RteBswImplementationRef=NvM_Impl, RteBswModuleConfigurationRef=NvM
        NvM_MainFunctionTimingEvent0 (RteBswEventToTaskMapping):
          RteBswImmediateRestart = false
          RteBswPositionInTask = 8
          RteBswEventRef = NvM_MainFunctionTimingEvent0
          RteBswMappedToTaskRef = Os/SchM_Task
          RteBswUsedOsEventRef = Os/Rte_Ev_Cyclic2_SchM_Task_0_10ms
          RteBswUsedOsAlarmRef = Os/Rte_Al_TE2_SchM_Task_0_10ms
        NVM_EXCLUSIVE_AREA_0 (RteBswExclusiveAreaImpl): RteExclusiveAreaImplMechanism=ALL_INTERRUPT_BLOCKING, RteBswExclusiveAreaRef=NVM_EXCLUSIVE_AREA_0
      Fls: RteBswImplementationRef=Fls_Impl, RteBswModuleConfigurationRef=Fls
        Fls_MainFunctionTimingEvent0 (RteBswEventToTaskMapping):
          RteBswImmediateRestart = false
          RteBswPositionInTask = 14
          RteBswEventRef = Fls_MainFunctionTimingEvent0
          RteBswMappedToTaskRef = Os/SchM_Task
          RteBswUsedOsEventRef = Os/Rte_Ev_Cyclic2_SchM_Task_0_10ms
          RteBswUsedOsAlarmRef = Os/Rte_Al_TE2_SchM_Task_0_10ms
      BswM: RteBswImplementationRef=BswM_Impl, RteBswModuleConfigurationRef=BswM
        BswM_MainFunctionTimingEvent0 (RteBswEventToTaskMapping):
          RteBswImmediateRestart = false
          RteBswPositionInTask = 10
          RteBswEventRef = BswM_MainFunctionTimingEvent0
          RteBswMappedToTaskRef = Os/SchM_Task
          RteBswUsedOsEventRef = Os/Rte_Ev_Cyclic2_SchM_Task_0_10ms
          RteBswUsedOsAlarmRef = Os/Rte_Al_TE2_SchM_Task_0_10ms
        BSWM_EXCLUSIVE_AREA_0 (RteBswExclusiveAreaImpl): RteExclusiveAreaImplMechanism=ALL_INTERRUPT_BLOCKING, RteBswExclusiveAreaRef=BSWM_EXCLUSIVE_AREA_0
      Rte: RteBswImplementationRef=Rte_Impl, RteBswModuleConfigurationRef=Rte
    5 x RteSwComponentInstance:
      BswM_EcuSwComposition: RteSoftwareComponentInstanceRef=BswM
        Timer_BswM_MainFunction (RteEventToTaskMapping):
          RteImmediateRestart = false
          RtePositionInTask = 10
          RteEventRef = Timer_BswM_MainFunction
          RteMappedToTaskRef = Os/SchM_Task
          RteUsedOsEventRef = Os/Rte_Ev_Cyclic2_SchM_Task_0_10ms
          RteUsedOsAlarmRef = Os/Rte_Al_TE2_SchM_Task_0_10ms
      Det_EcuSwComposition: RteSoftwareComponentInstanceRef=Det
      EcuM_EcuSwComposition: RteSoftwareComponentInstanceRef=EcuM
        8 x RteEventToTaskMapping, all with RteImmediateRestart=false:
          Timer_EcuM_MainFunction: RtePositionInTask=7, RteEventRef=Timer_EcuM_MainFunction, RteMappedToTaskRef=Os/SchM_Task, RteUsedOsEventRef=Os/Rte_Ev_Cyclic2_SchM_Task_0_10ms, RteUsedOsAlarmRef=Os/Rte_Al_TE2_SchM_Task_0_10ms
          OpEventSelectShutdownTarget_SelectShutdownTarget_EcuM_ShutdownTarget: RteEventRef=OpEventSelectShutdownTarget_SelectShutdownTarget_EcuM_ShutdownTarget
          OpEventGetShutdownTarget_GetShutdownTarget_EcuM_ShutdownTarget: RteEventRef=OpEventGetShutdownTarget_GetShutdownTarget_EcuM_ShutdownTarget
          OpEventGetLastShutdownTarget_GetLastShutdownTarget_EcuM_ShutdownTarget: RteEventRef=OpEventGetLastShutdownTarget_GetLastShutdownTarget_EcuM_ShutdownTarget
          OpEventSelectShutdownCause_SelectShutdownCause_EcuM_ShutdownTarget: RteEventRef=OpEventSelectShutdownCause_SelectShutdownCause_EcuM_ShutdownTarget
          OpEventGetShutdownCause_GetShutdownCause_EcuM_ShutdownTarget: RteEventRef=OpEventGetShutdownCause_GetShutdownCause_EcuM_ShutdownTarget
          OpEventSelectBootTarget_SelectBootTarget_EcuM_BootTarget: RteEventRef=OpEventSelectBootTarget_SelectBootTarget_EcuM_BootTarget
          OpEventGetBootTarget_GetBootTarget_EcuM_BootTarget: RteEventRef=OpEventGetBootTarget_GetBootTarget_EcuM_BootTarget
      Dem_EcuSwComposition: RteSoftwareComponentInstanceRef=Dem
        140 x RteEventToTaskMapping, all with RteImmediateRestart=false:
          Timer_Dem_MainFunction: RtePositionInTask=6, RteEventRef=Timer_Dem_MainFunction, RteMappedToTaskRef=Os/SchM_Task, RteUsedOsEventRef=Os/Rte_Ev_Cyclic2_SchM_Task_0_10ms, RteUsedOsAlarmRef=Os/Rte_Al_TE2_SchM_Task_0_10ms
          OpEventClearDTC_ClearDTC_Cdd: RteEventRef=OpEventClearDTC_ClearDTC_Cdd
          OpEventPostRunRequested_GetPostRunRequested_DemServices: RteEventRef=OpEventPostRunRequested_GetPostRunRequested_DemServices
          OpEventGetDTCStatusAvailabilityMask_GetDTCStatusAvailabilityMask_DemServices: RteEventRef=OpEventGetDTCStatusAvailabilityMask_GetDTCStatusAvailabilityMask_DemServices
          OpEventGetEventMemoryOverflow_GetEventMemoryOverflow_OverflowIndPrimaryMemory: RteEventRef=OpEventGetEventMemoryOverflow_GetEventMemoryOverflow_OverflowIndPrimaryMemory
          OpEventGetNumberOfEventMemoryEntries_GetNumberOfEventMemoryEntries_OverflowIndPrimaryMemory: RteEventRef=OpEventGetNumberOfEventMemoryEntries_GetNumberOfEventMemoryEntries_OverflowIndPrimaryMemory
          OpEventDcmClearDTC_DcmClearDTC_Dcm: RteEventRef=OpEventDcmClearDTC_DcmClearDTC_Dcm
          OpEventDcmGetNextFilteredDTCAndFDC_DcmGetNextFilteredDTCAndFDC_Dcm: RteEventRef=OpEventDcmGetNextFilteredDTCAndFDC_DcmGetNextFilteredDTCAndFDC_Dcm
          OpEventDcmEnableDTCSetting_DcmEnableDTCSetting_Dcm: RteEventRef=OpEventDcmEnableDTCSetting_DcmEnableDTCSetting_Dcm
          OpEventDcmGetFreezeFrameDataByDTC_DcmGetFreezeFrameDataByDTC_Dcm: RteEventRef=OpEventDcmGetFreezeFrameDataByDTC_DcmGetFreezeFrameDataByDTC_Dcm
          OpEventDcmGetExtendedDataRecordByDTC_DcmGetExtendedDataRecordByDTC_Dcm: RteEventRef=OpEventDcmGetExtendedDataRecordByDTC_DcmGetExtendedDataRecordByDTC_Dcm
          OpEventSetOperationCycleState_SetOperationCycleState_OpCycle_IgnitionCycle: RteEventRef=OpEventSetOperationCycleState_SetOperationCycleState_OpCycle_IgnitionCycle
          OpEventSetOperationCycleState_SetOperationCycleState_OpCycle_PowerCycle: RteEventRef=OpEventSetOperationCycleState_SetOperationCycleState_OpCycle_PowerCycle
          OpEventGetEventStatus_GetEventStatus_EvtInfo_AutoCreatedDemEvent_NVM_E_QUEUE_OVERFLOW: RteEventRef=OpEventGetEventStatus_GetEventStatus_EvtInfo_AutoCreatedDemEvent_NVM_E_QUEUE_OVERFLOW
          OpEventGetEventEnableCondition_GetEventEnableCondition_EvtInfo_AutoCreatedDemEvent_NVM_E_WRONG_BLOCK_ID: RteEventRef=OpEventGetEventEnableCondition_GetEventEnableCondition_EvtInfo_AutoCreatedDemEvent_NVM_E_WRONG_BLOCK_ID
          OpEventGetDTCOfEvent_GetDTCOfEvent_EvtInfo_AutoCreatedDemEvent_NVM_E_INTEGRITY_FAILED: RteEventRef=OpEventGetDTCOfEvent_GetDTCOfEvent_EvtInfo_AutoCreatedDemEvent_NVM_E_INTEGRITY_FAILED
          OpEventGetEventFailed_GetEventFailed_GeneralEventInfo: RteEventRef=OpEventGetEventFailed_GetEventFailed_GeneralEventInfo
          OpEventGetEventFailed_GetEventFailed_EvtInfo_AutoCreatedDemEvent_NVM_E_QUEUE_OVERFLOW: RteEventRef=OpEventGetEventFailed_GetEventFailed_EvtInfo_AutoCreatedDemEvent_NVM_E_QUEUE_OVERFLOW
          OpEventGetEventTested_GetEventTested_GeneralEventInfo: RteEventRef=OpEventGetEventTested_GetEventTested_GeneralEventInfo
          OpEventGetEventFreezeFrameData_GetEventFreezeFrameData_EvtInfo_AutoCreatedDemEvent_NVM_E_WRITE_PROTECTED: RteEventRef=OpEventGetEventFreezeFrameData_GetEventFreezeFrameData_EvtInfo_AutoCreatedDemEvent_NVM_E_WRITE_PROTECTED
          OpEventGetEventTested_GetEventTested_EvtInfo_AutoCreatedDemEvent_NVM_E_VERIFY_FAILED: RteEventRef=OpEventGetEventTested_GetEventTested_EvtInfo_AutoCreatedDemEvent_NVM_E_VERIFY_FAILED
          OpEventGetEventStatus_GetEventStatus_EvtInfo_AutoCreatedDemEvent_NVM_E_INTEGRITY_FAILED: RteEventRef=OpEventGetEventStatus_GetEventStatus_EvtInfo_AutoCreatedDemEvent_NVM_E_INTEGRITY_FAILED
          OpEventGetEventFreezeFrameData_GetEventFreezeFrameData_EvtInfo_AutoCreatedDemEvent_NVM_E_REQ_FAILED: RteEventRef=OpEventGetEventFreezeFrameData_GetEventFreezeFrameData_EvtInfo_AutoCreatedDemEvent_NVM_E_REQ_FAILED
          OpEventGetDTCOfEvent_GetDTCOfEvent_EvtInfo_AutoCreatedDemEvent_NVM_E_WRONG_BLOCK_ID: RteEventRef=OpEventGetDTCOfEvent_GetDTCOfEvent_EvtInfo_AutoCreatedDemEvent_NVM_E_WRONG_BLOCK_ID
          OpEventGetEventExtendedDataRecord_GetEventExtendedDataRecord_EvtInfo_AutoCreatedDemEvent_NVM_E_QUEUE_OVERFLOW: RteEventRef=OpEventGetEventExtendedDataRecord_GetEventExtendedDataRecord_EvtInfo_AutoCreatedDemEvent_NVM_E_QUEUE_OVERFLOW
          OpEventGetFaultDetectionCounter_GetFaultDetectionCounter_EvtInfo_AutoCreatedDemEvent_NVM_E_VERIFY_FAILED: RteEventRef=OpEventGetFaultDetectionCounter_GetFaultDetectionCounter_EvtInfo_AutoCreatedDemEvent_NVM_E_VERIFY_FAILED
          OpEventGetEventEnableCondition_GetEventEnableCondition_EvtInfo_AutoCreatedDemEvent_NVM_E_REQ_FAILED: RteEventRef=OpEventGetEventEnableCondition_GetEventEnableCondition_EvtInfo_AutoCreatedDemEvent_NVM_E_REQ_FAILED
          OpEventGetDebouncingOfEvent_GetDebouncingOfEvent_EvtInfo_AutoCreatedDemEvent_NVM_E_WRONG_BLOCK_ID: RteEventRef=OpEventGetDebouncingOfEvent_GetDebouncingOfEvent_EvtInfo_AutoCreatedDemEvent_NVM_E_WRONG_BLOCK_ID
          OpEventGetFaultDetectionCounter_GetFaultDetectionCounter_GeneralEventInfo: RteEventRef=OpEventGetFaultDetectionCounter_GetFaultDetectionCounter_GeneralEventInfo
          OpEventGetEventExtendedDataRecord_GetEventExtendedDataRecord_GeneralEventInfo: RteEventRef=OpEventGetEventExtendedDataRecord_GetEventExtendedDataRecord_GeneralEventInfo
          OpEventGetDTCOfEvent_GetDTCOfEvent_GeneralEventInfo: RteEventRef=OpEventGetDTCOfEvent_GetDTCOfEvent_GeneralEventInfo
          OpEventGetEventStatus_GetEventStatus_EvtInfo_AutoCreatedDemEvent_NVM_E_REQ_FAILED: RteEventRef=OpEventGetEventStatus_GetEventStatus_EvtInfo_AutoCreatedDemEvent_NVM_E_REQ_FAILED
          OpEventGetEventTested_GetEventTested_EvtInfo_AutoCreatedDemEvent_NVM_E_WRONG_BLOCK_ID: RteEventRef=OpEventGetEventTested_GetEventTested_EvtInfo_AutoCreatedDemEvent_NVM_E_WRONG_BLOCK_ID
          OpEventGetEventEnableCondition_GetEventEnableCondition_EvtInfo_AutoCreatedDemEvent_NVM_E_VERIFY_FAILED: RteEventRef=OpEventGetEventEnableCondition_GetEventEnableCondition_EvtInfo_AutoCreatedDemEvent_NVM_E_VERIFY_FAILED
          OpEventGetEventFailed_GetEventFailed_EvtInfo_AutoCreatedDemEvent_NVM_E_VERIFY_FAILED: RteEventRef=OpEventGetEventFailed_GetEventFailed_EvtInfo_AutoCreatedDemEvent_NVM_E_VERIFY_FAILED
          OpEventGetEventEnableCondition_GetEventEnableCondition_EvtInfo_AutoCreatedDemEvent_NVM_E_WRITE_PROTECTED: RteEventRef=OpEventGetEventEnableCondition_GetEventEnableCondition_EvtInfo_AutoCreatedDemEvent_NVM_E_WRITE_PROTECTED
          OpEventGetDebouncingOfEvent_GetDebouncingOfEvent_EvtInfo_AutoCreatedDemEvent_NVM_E_WRITE_PROTECTED: RteEventRef=OpEventGetDebouncingOfEvent_GetDebouncingOfEvent_EvtInfo_AutoCreatedDemEvent_NVM_E_WRITE_PROTECTED
          OpEventGetEventFreezeFrameData_GetEventFreezeFrameData_GeneralEventInfo: RteEventRef=OpEventGetEventFreezeFrameData_GetEventFreezeFrameData_GeneralEventInfo
          OpEventGetEventExtendedDataRecord_GetEventExtendedDataRecord_EvtInfo_AutoCreatedDemEvent_NVM_E_INTEGRITY_FAILED: RteEventRef=OpEventGetEventExtendedDataRecord_GetEventExtendedDataRecord_EvtInfo_AutoCreatedDemEvent_NVM_E_INTEGRITY_FAILED
          OpEventGetEventExtendedDataRecord_GetEventExtendedDataRecord_EvtInfo_AutoCreatedDemEvent_NVM_E_LOSS_OF_REDUNDANCY: RteEventRef=OpEventGetEventExtendedDataRecord_GetEventExtendedDataRecord_EvtInfo_AutoCreatedDemEvent_NVM_E_LOSS_OF_REDUNDANCY
          OpEventGetDebouncingOfEvent_GetDebouncingOfEvent_EvtInfo_AutoCreatedDemEvent_NVM_E_QUEUE_OVERFLOW: RteEventRef=OpEventGetDebouncingOfEvent_GetDebouncingOfEvent_EvtInfo_AutoCreatedDemEvent_NVM_E_QUEUE_OVERFLOW
          OpEventGetFaultDetectionCounter_GetFaultDetectionCounter_EvtInfo_AutoCreatedDemEvent_NVM_E_REQ_FAILED: RteEventRef=OpEventGetFaultDetectionCounter_GetFaultDetectionCounter_EvtInfo_AutoCreatedDemEvent_NVM_E_REQ_FAILED
          OpEventGetEventFailed_GetEventFailed_EvtInfo_AutoCreatedDemEvent_NVM_E_INTEGRITY_FAILED: RteEventRef=OpEventGetEventFailed_GetEventFailed_EvtInfo_AutoCreatedDemEvent_NVM_E_INTEGRITY_FAILED
          OpEventGetFaultDetectionCounter_GetFaultDetectionCounter_EvtInfo_AutoCreatedDemEvent_NVM_E_WRITE_PROTECTED: RteEventRef=OpEventGetFaultDetectionCounter_GetFaultDetectionCounter_EvtInfo_AutoCreatedDemEvent_NVM_E_WRITE_PROTECTED
          OpEventGetEventStatus_GetEventStatus_EvtInfo_AutoCreatedDemEvent_NVM_E_LOSS_OF_REDUNDANCY: RteEventRef=OpEventGetEventStatus_GetEventStatus_EvtInfo_AutoCreatedDemEvent_NVM_E_LOSS_OF_REDUNDANCY
          OpEventGetDebouncingOfEvent_GetDebouncingOfEvent_EvtInfo_AutoCreatedDemEvent_NVM_E_LOSS_OF_REDUNDANCY: RteEventRef=OpEventGetDebouncingOfEvent_GetDebouncingOfEvent_EvtInfo_AutoCreatedDemEvent_NVM_E_LOSS_OF_REDUNDANCY
          OpEventGetDebouncingOfEvent_GetDebouncingOfEvent_EvtInfo_AutoCreatedDemEvent_NVM_E_REQ_FAILED: RteEventRef=OpEventGetDebouncingOfEvent_GetDebouncingOfEvent_EvtInfo_AutoCreatedDemEvent_NVM_E_REQ_FAILED
          OpEventGetFaultDetectionCounter_GetFaultDetectionCounter_EvtInfo_AutoCreatedDemEvent_NVM_E_LOSS_OF_REDUNDANCY: RteEventRef=OpEventGetFaultDetectionCounter_GetFaultDetectionCounter_EvtInfo_AutoCreatedDemEvent_NVM_E_LOSS_OF_REDUNDANCY
          OpEventGetEventEnableCondition_GetEventEnableCondition_EvtInfo_AutoCreatedDemEvent_NVM_E_LOSS_OF_REDUNDANCY: RteEventRef=OpEventGetEventEnableCondition_GetEventEnableCondition_EvtInfo_AutoCreatedDemEvent_NVM_E_LOSS_OF_REDUNDANCY
          OpEventGetEventFreezeFrameData_GetEventFreezeFrameData_EvtInfo_AutoCreatedDemEvent_NVM_E_INTEGRITY_FAILED: RteEventRef=OpEventGetEventFreezeFrameData_GetEventFreezeFrameData_EvtInfo_AutoCreatedDemEvent_NVM_E_INTEGRITY_FAILED
          OpEventGetEventFailed_GetEventFailed_EvtInfo_AutoCreatedDemEvent_NVM_E_LOSS_OF_REDUNDANCY: RteEventRef=OpEventGetEventFailed_GetEventFailed_EvtInfo_AutoCreatedDemEvent_NVM_E_LOSS_OF_REDUNDANCY
          OpEventGetEventTested_GetEventTested_EvtInfo_AutoCreatedDemEvent_NVM_E_WRITE_PROTECTED: RteEventRef=OpEventGetEventTested_GetEventTested_EvtInfo_AutoCreatedDemEvent_NVM_E_WRITE_PROTECTED
          OpEventGetEventTested_GetEventTested_EvtInfo_AutoCreatedDemEvent_NVM_E_QUEUE_OVERFLOW: RteEventRef=OpEventGetEventTested_GetEventTested_EvtInfo_AutoCreatedDemEvent_NVM_E_QUEUE_OVERFLOW
          OpEventGetEventTested_GetEventTested_EvtInfo_AutoCreatedDemEvent_NVM_E_LOSS_OF_REDUNDANCY: RteEventRef=OpEventGetEventTested_GetEventTested_EvtInfo_AutoCreatedDemEvent_NVM_E_LOSS_OF_REDUNDANCY
          OpEventGetEventFreezeFrameData_GetEventFreezeFrameData_EvtInfo_AutoCreatedDemEvent_NVM_E_QUEUE_OVERFLOW: RteEventRef=OpEventGetEventFreezeFrameData_GetEventFreezeFrameData_EvtInfo_AutoCreatedDemEvent_NVM_E_QUEUE_OVERFLOW
          OpEventGetEventExtendedDataRecord_GetEventExtendedDataRecord_EvtInfo_AutoCreatedDemEvent_NVM_E_VERIFY_FAILED: RteEventRef=OpEventGetEventExtendedDataRecord_GetEventExtendedDataRecord_EvtInfo_AutoCreatedDemEvent_NVM_E_VERIFY_FAILED
          OpEventGetDebouncingOfEvent_GetDebouncingOfEvent_EvtInfo_AutoCreatedDemEvent_NVM_E_INTEGRITY_FAILED: RteEventRef=OpEventGetDebouncingOfEvent_GetDebouncingOfEvent_EvtInfo_AutoCreatedDemEvent_NVM_E_INTEGRITY_FAILED
          OpEventGetEventStatus_GetEventStatus_EvtInfo_AutoCreatedDemEvent_NVM_E_VERIFY_FAILED: RteEventRef=OpEventGetEventStatus_GetEventStatus_EvtInfo_AutoCreatedDemEvent_NVM_E_VERIFY_FAILED
          OpEventGetDTCOfEvent_GetDTCOfEvent_EvtInfo_AutoCreatedDemEvent_NVM_E_VERIFY_FAILED: RteEventRef=OpEventGetDTCOfEvent_GetDTCOfEvent_EvtInfo_AutoCreatedDemEvent_NVM_E_VERIFY_FAILED
          OpEventGetDTCOfEvent_GetDTCOfEvent_EvtInfo_AutoCreatedDemEvent_NVM_E_REQ_FAILED: RteEventRef=OpEventGetDTCOfEvent_GetDTCOfEvent_EvtInfo_AutoCreatedDemEvent_NVM_E_REQ_FAILED
          OpEventGetEventExtendedDataRecord_GetEventExtendedDataRecord_EvtInfo_AutoCreatedDemEvent_NVM_E_WRITE_PROTECTED: RteEventRef=OpEventGetEventExtendedDataRecord_GetEventExtendedDataRecord_EvtInfo_AutoCreatedDemEvent_NVM_E_WRITE_PROTECTED
          OpEventGetEventEnableCondition_GetEventEnableCondition_GeneralEventInfo: RteEventRef=OpEventGetEventEnableCondition_GetEventEnableCondition_GeneralEventInfo
          OpEventGetEventStatus_GetEventStatus_EvtInfo_AutoCreatedDemEvent_NVM_E_WRITE_PROTECTED: RteEventRef=OpEventGetEventStatus_GetEventStatus_EvtInfo_AutoCreatedDemEvent_NVM_E_WRITE_PROTECTED
          OpEventGetEventEnableCondition_GetEventEnableCondition_EvtInfo_AutoCreatedDemEvent_NVM_E_INTEGRITY_FAILED: RteEventRef=OpEventGetEventEnableCondition_GetEventEnableCondition_EvtInfo_AutoCreatedDemEvent_NVM_E_INTEGRITY_FAILED
          OpEventGetDebouncingOfEvent_GetDebouncingOfEvent_EvtInfo_AutoCreatedDemEvent_NVM_E_VERIFY_FAILED: RteEventRef=OpEventGetDebouncingOfEvent_GetDebouncingOfEvent_EvtInfo_AutoCreatedDemEvent_NVM_E_VERIFY_FAILED
          OpEventGetEventStatus_GetEventStatus_EvtInfo_AutoCreatedDemEvent_NVM_E_WRONG_BLOCK_ID: RteEventRef=OpEventGetEventStatus_GetEventStatus_EvtInfo_AutoCreatedDemEvent_NVM_E_WRONG_BLOCK_ID
          OpEventGetEventStatus_GetEventStatus_GeneralEventInfo: RteEventRef=OpEventGetEventStatus_GetEventStatus_GeneralEventInfo
          OpEventGetEventFreezeFrameData_GetEventFreezeFrameData_EvtInfo_AutoCreatedDemEvent_NVM_E_LOSS_OF_REDUNDANCY: RteEventRef=OpEventGetEventFreezeFrameData_GetEventFreezeFrameData_EvtInfo_AutoCreatedDemEvent_NVM_E_LOSS_OF_REDUNDANCY
          OpEventGetEventFreezeFrameData_GetEventFreezeFrameData_EvtInfo_AutoCreatedDemEvent_NVM_E_WRONG_BLOCK_ID: RteEventRef=OpEventGetEventFreezeFrameData_GetEventFreezeFrameData_EvtInfo_AutoCreatedDemEvent_NVM_E_WRONG_BLOCK_ID
          OpEventGetEventFailed_GetEventFailed_EvtInfo_AutoCreatedDemEvent_NVM_E_WRITE_PROTECTED: RteEventRef=OpEventGetEventFailed_GetEventFailed_EvtInfo_AutoCreatedDemEvent_NVM_E_WRITE_PROTECTED
          OpEventGetEventFailed_GetEventFailed_EvtInfo_AutoCreatedDemEvent_NVM_E_WRONG_BLOCK_ID: RteEventRef=OpEventGetEventFailed_GetEventFailed_EvtInfo_AutoCreatedDemEvent_NVM_E_WRONG_BLOCK_ID
          OpEventGetFaultDetectionCounter_GetFaultDetectionCounter_EvtInfo_AutoCreatedDemEvent_NVM_E_INTEGRITY_FAILED: RteEventRef=OpEventGetFaultDetectionCounter_GetFaultDetectionCounter_EvtInfo_AutoCreatedDemEvent_NVM_E_INTEGRITY_FAILED
          OpEventGetEventTested_GetEventTested_EvtInfo_AutoCreatedDemEvent_NVM_E_REQ_FAILED: RteEventRef=OpEventGetEventTested_GetEventTested_EvtInfo_AutoCreatedDemEvent_NVM_E_REQ_FAILED
          OpEventGetEventEnableCondition_GetEventEnableCondition_EvtInfo_AutoCreatedDemEvent_NVM_E_QUEUE_OVERFLOW: RteEventRef=OpEventGetEventEnableCondition_GetEventEnableCondition_EvtInfo_AutoCreatedDemEvent_NVM_E_QUEUE_OVERFLOW
          OpEventGetEventFreezeFrameData_GetEventFreezeFrameData_EvtInfo_AutoCreatedDemEvent_NVM_E_VERIFY_FAILED: RteEventRef=OpEventGetEventFreezeFrameData_GetEventFreezeFrameData_EvtInfo_AutoCreatedDemEvent_NVM_E_VERIFY_FAILED
          OpEventGetEventExtendedDataRecord_GetEventExtendedDataRecord_EvtInfo_AutoCreatedDemEvent_NVM_E_WRONG_BLOCK_ID: RteEventRef=OpEventGetEventExtendedDataRecord_GetEventExtendedDataRecord_EvtInfo_AutoCreatedDemEvent_NVM_E_WRONG_BLOCK_ID
          OpEventGetEventFailed_GetEventFailed_EvtInfo_AutoCreatedDemEvent_NVM_E_REQ_FAILED: RteEventRef=OpEventGetEventFailed_GetEventFailed_EvtInfo_AutoCreatedDemEvent_NVM_E_REQ_FAILED
          OpEventGetDTCOfEvent_GetDTCOfEvent_EvtInfo_AutoCreatedDemEvent_NVM_E_LOSS_OF_REDUNDANCY: RteEventRef=OpEventGetDTCOfEvent_GetDTCOfEvent_EvtInfo_AutoCreatedDemEvent_NVM_E_LOSS_OF_REDUNDANCY
          OpEventGetFaultDetectionCounter_GetFaultDetectionCounter_EvtInfo_AutoCreatedDemEvent_NVM_E_QUEUE_OVERFLOW: RteEventRef=OpEventGetFaultDetectionCounter_GetFaultDetectionCounter_EvtInfo_AutoCreatedDemEvent_NVM_E_QUEUE_OVERFLOW
          OpEventGetDebouncingOfEvent_GetDebouncingOfEvent_GeneralEventInfo: RteEventRef=OpEventGetDebouncingOfEvent_GetDebouncingOfEvent_GeneralEventInfo
          OpEventGetEventTested_GetEventTested_EvtInfo_AutoCreatedDemEvent_NVM_E_INTEGRITY_FAILED: RteEventRef=OpEventGetEventTested_GetEventTested_EvtInfo_AutoCreatedDemEvent_NVM_E_INTEGRITY_FAILED
          OpEventGetEventExtendedDataRecord_GetEventExtendedDataRecord_EvtInfo_AutoCreatedDemEvent_NVM_E_REQ_FAILED: RteEventRef=OpEventGetEventExtendedDataRecord_GetEventExtendedDataRecord_EvtInfo_AutoCreatedDemEvent_NVM_E_REQ_FAILED
          OpEventGetFaultDetectionCounter_GetFaultDetectionCounter_EvtInfo_AutoCreatedDemEvent_NVM_E_WRONG_BLOCK_ID: RteEventRef=OpEventGetFaultDetectionCounter_GetFaultDetectionCounter_EvtInfo_AutoCreatedDemEvent_NVM_E_WRONG_BLOCK_ID
          OpEventGetDTCOfEvent_GetDTCOfEvent_EvtInfo_AutoCreatedDemEvent_NVM_E_QUEUE_OVERFLOW: RteEventRef=OpEventGetDTCOfEvent_GetDTCOfEvent_EvtInfo_AutoCreatedDemEvent_NVM_E_QUEUE_OVERFLOW
          OpEventGetDTCOfEvent_GetDTCOfEvent_EvtInfo_AutoCreatedDemEvent_NVM_E_WRITE_PROTECTED: RteEventRef=OpEventGetDTCOfEvent_GetDTCOfEvent_EvtInfo_AutoCreatedDemEvent_NVM_E_WRITE_PROTECTED
          OpEventGetDTCOfEvent_GetDTCOfEvent_EvtInfo_AutoCreatedDemEvent_EcuMConfiguration_ECUM_E_RAM_CHECK_FAILED: RteEventRef=OpEventGetDTCOfEvent_GetDTCOfEvent_EvtInfo_AutoCreatedDemEvent_EcuMConfiguration_ECUM_E_RAM_CHECK_FAILED
          OpEventGetFaultDetectionCounter_GetFaultDetectionCounter_EvtInfo_AutoCreatedDemEvent_EcuMConfiguration_ECUM_E_CONFIGURA_55d3b4f6: RteEventRef=OpEventGetFaultDetectionCounter_GetFaultDetectionCounter_EvtInfo_AutoCreatedDemEvent_EcuMConfiguration_ECUM_E_CONFIGURA_55d3b4f6
          OpEventGetEventTested_GetEventTested_EvtInfo_AutoCreatedDemEvent_EcuMConfiguration_ECUM_E_CONFIGURATION_DATA_INCONSISTENT: RteEventRef=OpEventGetEventTested_GetEventTested_EvtInfo_AutoCreatedDemEvent_EcuMConfiguration_ECUM_E_CONFIGURATION_DATA_INCONSISTENT
          OpEventGetFaultDetectionCounter_GetFaultDetectionCounter_EvtInfo_AutoCreatedDemEvent_EcuMConfiguration_ECUM_E_RAM_CHECK_FAILED: RteEventRef=OpEventGetFaultDetectionCounter_GetFaultDetectionCounter_EvtInfo_AutoCreatedDemEvent_EcuMConfiguration_ECUM_E_RAM_CHECK_FAILED
          OpEventGetEventFreezeFrameData_GetEventFreezeFrameData_EvtInfo_AutoCreatedDemEvent_EcuMConfiguration_ECUM_E_CONFIGURATI_d69bc229: RteEventRef=OpEventGetEventFreezeFrameData_GetEventFreezeFrameData_EvtInfo_AutoCreatedDemEvent_EcuMConfiguration_ECUM_E_CONFIGURATI_d69bc229
          OpEventGetEventFailed_GetEventFailed_EvtInfo_AutoCreatedDemEvent_EcuMConfiguration_ECUM_E_CONFIGURATION_DATA_INCONSISTENT: RteEventRef=OpEventGetEventFailed_GetEventFailed_EvtInfo_AutoCreatedDemEvent_EcuMConfiguration_ECUM_E_CONFIGURATION_DATA_INCONSISTENT
          OpEventGetDebouncingOfEvent_GetDebouncingOfEvent_EvtInfo_AutoCreatedDemEvent_EcuMConfiguration_ECUM_E_CONFIGURATION_DAT_7642b2c3: RteEventRef=OpEventGetDebouncingOfEvent_GetDebouncingOfEvent_EvtInfo_AutoCreatedDemEvent_EcuMConfiguration_ECUM_E_CONFIGURATION_DAT_7642b2c3
          OpEventGetDebouncingOfEvent_GetDebouncingOfEvent_EvtInfo_AutoCreatedDemEvent_EcuMConfiguration_ECUM_E_RAM_CHECK_FAILED: RteEventRef=OpEventGetDebouncingOfEvent_GetDebouncingOfEvent_EvtInfo_AutoCreatedDemEvent_EcuMConfiguration_ECUM_E_RAM_CHECK_FAILED
          OpEventGetEventExtendedDataRecord_GetEventExtendedDataRecord_EvtInfo_AutoCreatedDemEvent_EcuMConfiguration_ECUM_E_CONFI_ee61c66d: RteEventRef=OpEventGetEventExtendedDataRecord_GetEventExtendedDataRecord_EvtInfo_AutoCreatedDemEvent_EcuMConfiguration_ECUM_E_CONFI_ee61c66d
          OpEventGetDTCOfEvent_GetDTCOfEvent_EvtInfo_AutoCreatedDemEvent_EcuMConfiguration_ECUM_E_CONFIGURATION_DATA_INCONSISTENT: RteEventRef=OpEventGetDTCOfEvent_GetDTCOfEvent_EvtInfo_AutoCreatedDemEvent_EcuMConfiguration_ECUM_E_CONFIGURATION_DATA_INCONSISTENT
          OpEventGetEventStatus_GetEventStatus_EvtInfo_AutoCreatedDemEvent_EcuMConfiguration_ECUM_E_RAM_CHECK_FAILED: RteEventRef=OpEventGetEventStatus_GetEventStatus_EvtInfo_AutoCreatedDemEvent_EcuMConfiguration_ECUM_E_RAM_CHECK_FAILED
          OpEventGetEventTested_GetEventTested_EvtInfo_AutoCreatedDemEvent_EcuMConfiguration_ECUM_E_RAM_CHECK_FAILED: RteEventRef=OpEventGetEventTested_GetEventTested_EvtInfo_AutoCreatedDemEvent_EcuMConfiguration_ECUM_E_RAM_CHECK_FAILED
          OpEventGetEventEnableCondition_GetEventEnableCondition_EvtInfo_AutoCreatedDemEvent_EcuMConfiguration_ECUM_E_RAM_CHECK_FAILED: RteEventRef=OpEventGetEventEnableCondition_GetEventEnableCondition_EvtInfo_AutoCreatedDemEvent_EcuMConfiguration_ECUM_E_RAM_CHECK_FAILED
          OpEventGetEventExtendedDataRecord_GetEventExtendedDataRecord_EvtInfo_AutoCreatedDemEvent_EcuMConfiguration_ECUM_E_RAM_C_3cc81dd0: RteEventRef=OpEventGetEventExtendedDataRecord_GetEventExtendedDataRecord_EvtInfo_AutoCreatedDemEvent_EcuMConfiguration_ECUM_E_RAM_C_3cc81dd0
          OpEventGetEventFreezeFrameData_GetEventFreezeFrameData_EvtInfo_AutoCreatedDemEvent_EcuMConfiguration_ECUM_E_RAM_CHECK_FAILED: RteEventRef=OpEventGetEventFreezeFrameData_GetEventFreezeFrameData_EvtInfo_AutoCreatedDemEvent_EcuMConfiguration_ECUM_E_RAM_CHECK_FAILED
          OpEventGetEventStatus_GetEventStatus_EvtInfo_AutoCreatedDemEvent_EcuMConfiguration_ECUM_E_CONFIGURATION_DATA_INCONSISTENT: RteEventRef=OpEventGetEventStatus_GetEventStatus_EvtInfo_AutoCreatedDemEvent_EcuMConfiguration_ECUM_E_CONFIGURATION_DATA_INCONSISTENT
          OpEventGetEventEnableCondition_GetEventEnableCondition_EvtInfo_AutoCreatedDemEvent_EcuMConfiguration_ECUM_E_CONFIGURATI_06f5d14c: RteEventRef=OpEventGetEventEnableCondition_GetEventEnableCondition_EvtInfo_AutoCreatedDemEvent_EcuMConfiguration_ECUM_E_CONFIGURATI_06f5d14c
          OpEventGetEventFailed_GetEventFailed_EvtInfo_AutoCreatedDemEvent_EcuMConfiguration_ECUM_E_RAM_CHECK_FAILED: RteEventRef=OpEventGetEventFailed_GetEventFailed_EvtInfo_AutoCreatedDemEvent_EcuMConfiguration_ECUM_E_RAM_CHECK_FAILED
          OpEventGetEventStatus_GetEventStatus_EvtInfo_AutoCreatedDemEvent_EcuMConfiguration_ECUM_E_ALL_RUN_REQUESTS_KILLED: RteEventRef=OpEventGetEventStatus_GetEventStatus_EvtInfo_AutoCreatedDemEvent_EcuMConfiguration_ECUM_E_ALL_RUN_REQUESTS_KILLED
          OpEventGetDTCOfEvent_GetDTCOfEvent_EvtInfo_AutoCreatedDemEvent_EcuMConfiguration_ECUM_E_ALL_RUN_REQUESTS_KILLED: RteEventRef=OpEventGetDTCOfEvent_GetDTCOfEvent_EvtInfo_AutoCreatedDemEvent_EcuMConfiguration_ECUM_E_ALL_RUN_REQUESTS_KILLED
          OpEventGetEventFailed_GetEventFailed_EvtInfo_AutoCreatedDemEvent_EcuMConfiguration_ECUM_E_ALL_RUN_REQUESTS_KILLED: RteEventRef=OpEventGetEventFailed_GetEventFailed_EvtInfo_AutoCreatedDemEvent_EcuMConfiguration_ECUM_E_ALL_RUN_REQUESTS_KILLED
          OpEventGetDebouncingOfEvent_GetDebouncingOfEvent_EvtInfo_AutoCreatedDemEvent_EcuMConfiguration_ECUM_E_ALL_RUN_REQUESTS_KILLED: RteEventRef=OpEventGetDebouncingOfEvent_GetDebouncingOfEvent_EvtInfo_AutoCreatedDemEvent_EcuMConfiguration_ECUM_E_ALL_RUN_REQUESTS_KILLED
          OpEventGetEventEnableCondition_GetEventEnableCondition_EvtInfo_AutoCreatedDemEvent_EcuMConfiguration_ECUM_E_ALL_RUN_REQ_5b1f807c: RteEventRef=OpEventGetEventEnableCondition_GetEventEnableCondition_EvtInfo_AutoCreatedDemEvent_EcuMConfiguration_ECUM_E_ALL_RUN_REQ_5b1f807c
          OpEventGetEventTested_GetEventTested_EvtInfo_AutoCreatedDemEvent_EcuMConfiguration_ECUM_E_ALL_RUN_REQUESTS_KILLED: RteEventRef=OpEventGetEventTested_GetEventTested_EvtInfo_AutoCreatedDemEvent_EcuMConfiguration_ECUM_E_ALL_RUN_REQUESTS_KILLED
          OpEventGetEventExtendedDataRecord_GetEventExtendedDataRecord_EvtInfo_AutoCreatedDemEvent_EcuMConfiguration_ECUM_E_ALL_R_fd46dfea: RteEventRef=OpEventGetEventExtendedDataRecord_GetEventExtendedDataRecord_EvtInfo_AutoCreatedDemEvent_EcuMConfiguration_ECUM_E_ALL_R_fd46dfea
          OpEventGetEventFreezeFrameData_GetEventFreezeFrameData_EvtInfo_AutoCreatedDemEvent_EcuMConfiguration_ECUM_E_ALL_RUN_REQ_dff3eed8: RteEventRef=OpEventGetEventFreezeFrameData_GetEventFreezeFrameData_EvtInfo_AutoCreatedDemEvent_EcuMConfiguration_ECUM_E_ALL_RUN_REQ_dff3eed8
          OpEventGetFaultDetectionCounter_GetFaultDetectionCounter_EvtInfo_AutoCreatedDemEvent_EcuMConfiguration_ECUM_E_ALL_RUN_R_5c1d7bad: RteEventRef=OpEventGetFaultDetectionCounter_GetFaultDetectionCounter_EvtInfo_AutoCreatedDemEvent_EcuMConfiguration_ECUM_E_ALL_RUN_R_5c1d7bad
          OpEventGetEventFailed_GetEventFailed_EvtInfo_AutoCreatedDemEvent_EcuMConfiguration_ECUM_E_IMPROPER_CALLER: RteEventRef=OpEventGetEventFailed_GetEventFailed_EvtInfo_AutoCreatedDemEvent_EcuMConfiguration_ECUM_E_IMPROPER_CALLER
          OpEventGetDTCOfEvent_GetDTCOfEvent_EvtInfo_AutoCreatedDemEvent_EcuMConfiguration_ECUM_E_IMPROPER_CALLER: RteEventRef=OpEventGetDTCOfEvent_GetDTCOfEvent_EvtInfo_AutoCreatedDemEvent_EcuMConfiguration_ECUM_E_IMPROPER_CALLER
          OpEventGetEventFreezeFrameData_GetEventFreezeFrameData_EvtInfo_AutoCreatedDemEvent_EcuMConfiguration_ECUM_E_IMPROPER_CALLER: RteEventRef=OpEventGetEventFreezeFrameData_GetEventFreezeFrameData_EvtInfo_AutoCreatedDemEvent_EcuMConfiguration_ECUM_E_IMPROPER_CALLER
          OpEventGetFaultDetectionCounter_GetFaultDetectionCounter_EvtInfo_AutoCreatedDemEvent_EcuMConfiguration_ECUM_E_IMPROPER_CALLER: RteEventRef=OpEventGetFaultDetectionCounter_GetFaultDetectionCounter_EvtInfo_AutoCreatedDemEvent_EcuMConfiguration_ECUM_E_IMPROPER_CALLER
          OpEventGetDebouncingOfEvent_GetDebouncingOfEvent_EvtInfo_AutoCreatedDemEvent_EcuMConfiguration_ECUM_E_IMPROPER_CALLER: RteEventRef=OpEventGetDebouncingOfEvent_GetDebouncingOfEvent_EvtInfo_AutoCreatedDemEvent_EcuMConfiguration_ECUM_E_IMPROPER_CALLER
          OpEventGetEventEnableCondition_GetEventEnableCondition_EvtInfo_AutoCreatedDemEvent_EcuMConfiguration_ECUM_E_IMPROPER_CALLER: RteEventRef=OpEventGetEventEnableCondition_GetEventEnableCondition_EvtInfo_AutoCreatedDemEvent_EcuMConfiguration_ECUM_E_IMPROPER_CALLER
          OpEventGetEventTested_GetEventTested_EvtInfo_AutoCreatedDemEvent_EcuMConfiguration_ECUM_E_IMPROPER_CALLER: RteEventRef=OpEventGetEventTested_GetEventTested_EvtInfo_AutoCreatedDemEvent_EcuMConfiguration_ECUM_E_IMPROPER_CALLER
          OpEventGetEventExtendedDataRecord_GetEventExtendedDataRecord_EvtInfo_AutoCreatedDemEvent_EcuMConfiguration_ECUM_E_IMPRO_6413fe6b: RteEventRef=OpEventGetEventExtendedDataRecord_GetEventExtendedDataRecord_EvtInfo_AutoCreatedDemEvent_EcuMConfiguration_ECUM_E_IMPRO_6413fe6b
          OpEventGetEventStatus_GetEventStatus_EvtInfo_AutoCreatedDemEvent_EcuMConfiguration_ECUM_E_IMPROPER_CALLER: RteEventRef=OpEventGetEventStatus_GetEventStatus_EvtInfo_AutoCreatedDemEvent_EcuMConfiguration_ECUM_E_IMPROPER_CALLER
          OpEventGetEventTested_GetEventTested_EvtInfo_DTC_0x000002: RteEventRef=OpEventGetEventTested_GetEventTested_EvtInfo_DTC_0x000002
          OpEventGetEventEnableCondition_GetEventEnableCondition_EvtInfo_DTC_0x000002: RteEventRef=OpEventGetEventEnableCondition_GetEventEnableCondition_EvtInfo_DTC_0x000002
          OpEventGetEventFailed_GetEventFailed_Event_DTC_0x000002: RteEventRef=OpEventGetEventFailed_GetEventFailed_Event_DTC_0x000002
          OpEventGetEventFreezeFrameData_GetEventFreezeFrameData_EvtInfo_DTC_0x000002: RteEventRef=OpEventGetEventFreezeFrameData_GetEventFreezeFrameData_EvtInfo_DTC_0x000002
          OpEventGetEventExtendedDataRecord_GetEventExtendedDataRecord_Event_DTC_0x000002: RteEventRef=OpEventGetEventExtendedDataRecord_GetEventExtendedDataRecord_Event_DTC_0x000002
          OpEventResetEventStatus_ResetEventStatus_Event_DTC_0x000002: RteEventRef=OpEventResetEventStatus_ResetEventStatus_Event_DTC_0x000002
          OpEventGetEventStatus_GetEventStatus_EvtInfo_DTC_0x000002: RteEventRef=OpEventGetEventStatus_GetEventStatus_EvtInfo_DTC_0x000002
          OpEventGetEventFreezeFrameData_GetEventFreezeFrameData_Event_DTC_0x000002: RteEventRef=OpEventGetEventFreezeFrameData_GetEventFreezeFrameData_Event_DTC_0x000002
          OpEventGetDTCOfEvent_GetDTCOfEvent_Event_DTC_0x000002: RteEventRef=OpEventGetDTCOfEvent_GetDTCOfEvent_Event_DTC_0x000002
          OpEventResetEventDebounceStatus_ResetEventDebounceStatus_Event_DTC_0x000002: RteEventRef=OpEventResetEventDebounceStatus_ResetEventDebounceStatus_Event_DTC_0x000002
          OpEventGetEventTested_GetEventTested_Event_DTC_0x000002: RteEventRef=OpEventGetEventTested_GetEventTested_Event_DTC_0x000002
          OpEventGetEventExtendedDataRecord_GetEventExtendedDataRecord_EvtInfo_DTC_0x000002: RteEventRef=OpEventGetEventExtendedDataRecord_GetEventExtendedDataRecord_EvtInfo_DTC_0x000002
          OpEventGetFaultDetectionCounter_GetFaultDetectionCounter_EvtInfo_DTC_0x000002: RteEventRef=OpEventGetFaultDetectionCounter_GetFaultDetectionCounter_EvtInfo_DTC_0x000002
          OpEventGetDebouncingOfEvent_GetDebouncingOfEvent_EvtInfo_DTC_0x000002: RteEventRef=OpEventGetDebouncingOfEvent_GetDebouncingOfEvent_EvtInfo_DTC_0x000002
          OpEventGetFaultDetectionCounter_GetFaultDetectionCounter_Event_DTC_0x000002: RteEventRef=OpEventGetFaultDetectionCounter_GetFaultDetectionCounter_Event_DTC_0x000002
          OpEventGetEventStatus_GetEventStatus_Event_DTC_0x000002: RteEventRef=OpEventGetEventStatus_GetEventStatus_Event_DTC_0x000002
          OpEventSetEventStatus_SetEventStatus_Event_DTC_0x000002: RteEventRef=OpEventSetEventStatus_SetEventStatus_Event_DTC_0x000002
          OpEventGetDTCOfEvent_GetDTCOfEvent_EvtInfo_DTC_0x000002: RteEventRef=OpEventGetDTCOfEvent_GetDTCOfEvent_EvtInfo_DTC_0x000002
          OpEventGetEventFailed_GetEventFailed_EvtInfo_DTC_0x000002: RteEventRef=OpEventGetEventFailed_GetEventFailed_EvtInfo_DTC_0x000002
      NvM_EcuSwComposition: RteSoftwareComponentInstanceRef=NvM
        23 x RteEventToTaskMapping, all with RteImmediateRestart=false:
          Timer_NvM_MainFunction: RtePositionInTask=8, RteEventRef=Timer_NvM_MainFunction, RteMappedToTaskRef=Os/SchM_Task, RteUsedOsEventRef=Os/Rte_Ev_Cyclic2_SchM_Task_0_10ms, RteUsedOsAlarmRef=Os/Rte_Al_TE2_SchM_Task_0_10ms
          OpEventGetErrorStatus_GetErrorStatus_PS_NvMConfigBlock: RteEventRef=OpEventGetErrorStatus_GetErrorStatus_PS_NvMConfigBlock
          OpEventSetRamBlockStatus_SetRamBlockStatus_PS_NvMConfigBlock: RteEventRef=OpEventSetRamBlockStatus_SetRamBlockStatus_PS_NvMConfigBlock
          OpEventReadBlock_ReadBlock_PS_NvMConfigBlock: RteEventRef=OpEventReadBlock_ReadBlock_PS_NvMConfigBlock
          OpEventWriteBlock_WriteBlock_PS_NvMConfigBlock: RteEventRef=OpEventWriteBlock_WriteBlock_PS_NvMConfigBlock
          OpEventInvalidateNvBlock_InvalidateNvBlock_PS_NvMConfigBlock: RteEventRef=OpEventInvalidateNvBlock_InvalidateNvBlock_PS_NvMConfigBlock
          OpEventEraseBlock_EraseBlock_PS_NvMConfigBlock: RteEventRef=OpEventEraseBlock_EraseBlock_PS_NvMConfigBlock
          OpEventSetBlockProtection_SetBlockProtection_PAdmin_NvMConfigBlock: RteEventRef=OpEventSetBlockProtection_SetBlockProtection_PAdmin_NvMConfigBlock
          OpEventInvalidateNvBlock_InvalidateNvBlock_PS_CpApMySwcSnNvMPimLightOnOffCounter: RteEventRef=OpEventInvalidateNvBlock_InvalidateNvBlock_PS_CpApMySwcSnNvMPimLightOnOffCounter
          OpEventSetRamBlockStatus_SetRamBlockStatus_PS_CpApMySwcSnNvMPimLightOnOffCounter: RteEventRef=OpEventSetRamBlockStatus_SetRamBlockStatus_PS_CpApMySwcSnNvMPimLightOnOffCounter
          OpEventGetErrorStatus_GetErrorStatus_PS_CpApMySwcSnNvMPimLightOnOffCounter: RteEventRef=OpEventGetErrorStatus_GetErrorStatus_PS_CpApMySwcSnNvMPimLightOnOffCounter
          OpEventSetBlockProtection_SetBlockProtection_PAdmin_CpApMySwcSnNvMPimLightOnOffCounter: RteEventRef=OpEventSetBlockProtection_SetBlockProtection_PAdmin_CpApMySwcSnNvMPimLightOnOffCounter
          OpEventWriteBlock_WriteBlock_PS_CpApMySwcSnNvMPimLightOnOffCounter: RteEventRef=OpEventWriteBlock_WriteBlock_PS_CpApMySwcSnNvMPimLightOnOffCounter
          OpEventEraseBlock_EraseBlock_PS_CpApMySwcSnNvMPimLightOnOffCounter: RteEventRef=OpEventEraseBlock_EraseBlock_PS_CpApMySwcSnNvMPimLightOnOffCounter
          OpEventReadBlock_ReadBlock_PS_CpApMySwcSnNvMPimLightOnOffCounter: RteEventRef=OpEventReadBlock_ReadBlock_PS_CpApMySwcSnNvMPimLightOnOffCounter
          OpEventSetBlockProtection_SetBlockProtection_PAdmin_CpApMySwcSnNvM_PimOdometer: RteEventRef=OpEventSetBlockProtection_SetBlockProtection_PAdmin_CpApMySwcSnNvM_PimOdometer
          OpEventEraseBlock_EraseBlock_PS_CpApMySwcSnNvM_PimOdometer: RteEventRef=OpEventEraseBlock_EraseBlock_PS_CpApMySwcSnNvM_PimOdometer
          OpEventSetRamBlockStatus_SetRamBlockStatus_PS_CpApMySwcSnNvM_PimOdometer: RteEventRef=OpEventSetRamBlockStatus_SetRamBlockStatus_PS_CpApMySwcSnNvM_PimOdometer
          OpEventReadBlock_ReadBlock_PS_CpApMySwcSnNvM_PimOdometer: RteEventRef=OpEventReadBlock_ReadBlock_PS_CpApMySwcSnNvM_PimOdometer
          OpEventRestoreBlockDefaults_RestoreBlockDefaults_PS_CpApMySwcSnNvM_PimOdometer: RteEventRef=OpEventRestoreBlockDefaults_RestoreBlockDefaults_PS_CpApMySwcSnNvM_PimOdometer
          OpEventInvalidateNvBlock_InvalidateNvBlock_PS_CpApMySwcSnNvM_PimOdometer: RteEventRef=OpEventInvalidateNvBlock_InvalidateNvBlock_PS_CpApMySwcSnNvM_PimOdometer
          OpEventWriteBlock_WriteBlock_PS_CpApMySwcSnNvM_PimOdometer: RteEventRef=OpEventWriteBlock_WriteBlock_PS_CpApMySwcSnNvM_PimOdometer
          OpEventGetErrorStatus_GetErrorStatus_PS_CpApMySwcSnNvM_PimOdometer: RteEventRef=OpEventGetErrorStatus_GetErrorStatus_PS_CpApMySwcSnNvM_PimOdometer
    4 x RteSwComponentType:
      CtApMySwc: RteComponentTypeRef=CtApMySwc, RteImplementationRef=CtApMySwc_Implementation
        ComponentTypeCalibration (RteComponentTypeCalibration): RteCalibrationSupportEnabled=false
      CtSaDisplay: RteComponentTypeRef=CtSaDisplay, RteImplementationRef=CtSaDisplay_Implementation
        ComponentTypeCalibration (RteComponentTypeCalibration): RteCalibrationSupportEnabled=false
      CtSaDoor: RteComponentTypeRef=CtSaDoor, RteImplementationRef=CtSaDoor_Implementation
        ComponentTypeCalibration (RteComponentTypeCalibration): RteCalibrationSupportEnabled=false
      CtSaInteriorLight: RteComponentTypeRef=CtSaInteriorLight, RteImplementationRef=CtSaInteriorLight_Implementation
        ComponentTypeCalibration (RteComponentTypeCalibration): RteCalibrationSupportEnabled=false
    5 x RteSwComponentInstance:
      CpApMySwc_EcuSwComposition: RteSoftwareComponentInstanceRef=CpApMySwc
        ExArLightOnOffCounter (RteExclusiveAreaImplementation): RteExclusiveAreaImplMechanism=OS_INTERRUPT_BLOCKING, RteExclusiveAreaRef=ExArLightOnOffCounter
        ExArOdometer (RteExclusiveAreaImplementation): RteExclusiveAreaImplMechanism=OS_INTERRUPT_BLOCKING, RteExclusiveAreaRef=ExArOdometer
        NvmBlock_CpApMySwc_SnNvMPimLightOnOffCounter (RteNvRamAllocation):
          RteNvmRamBlockLocationSymbol = Rte_CpApMySwc_PimLightOnOffCounter
          RteNvmBlockRef = CpApMySwcSnNvMPimLightOnOffCounter
          RteSwNvRamMappingRef = SnNvMPimLightOnOffCounter
        NvmBlock_CpApMySwc_SnNvM_PimOdometer (RteNvRamAllocation):
          RteNvmRamBlockLocationSymbol = Rte_CpApMySwc_PimOdometer
          RteNvmRomBlockLocationSymbol = Rte_CtApMySwc_CalOdometer
          RteNvmBlockRef = CpApMySwcSnNvM_PimOdometer
          RteSwNvRamMappingRef = SnNvM_PimOdometer
        10 x RteEventToTaskMapping, all with RteImmediateRestart=false:
          CtApMySwc_InitEvent: RtePositionInTask=1, RteEventRef=CtApMySwc_InitEvent, RteMappedToTaskRef=Os/My_Task
          TMT_RCtApMySwcCode: RtePositionInTask=0, RteEventRef=TMT_RCtApMySwcCode, RteMappedToTaskRef=Os/My_Task, RteUsedOsEventRef=Os/Rte_Ev_Run_CpApMySwc_RCtApMySwcCode, RteUsedOsAlarmRef=Os/Rte_Al_TE_CpApMySwc_RCtApMySwcCode
          MST_RCtApMySwcComM_ModeChange_FULL_COMM_Exit_0: RtePositionInTask=2, RteEventRef=MST_RCtApMySwcComM_ModeChange_FULL_COMM_Exit_0, RteMappedToTaskRef=Os/My_Task, RteUsedOsEventRef=Os/Rte_Ev_Run_CpApMySwc_RCtApMySwcComM_ModeChange_FULL_COMM_Exit
          MST_RCtApMySwcComM_ModeChange_FULL_COMM_Entry_0: RtePositionInTask=3, RteEventRef=MST_RCtApMySwcComM_ModeChange_FULL_COMM_Entry_0, RteMappedToTaskRef=Os/My_Task, RteUsedOsEventRef=Os/Rte_Ev_Run_CpApMySwc_RCtApMySwcComM_ModeChange_FULL_COMM_Entry
          OIT_NvM_RpNotifyJobEnd_CpApMySwcSnNvMPimLightOnOffCounter_JobFinished_NvM_RpNotifyJobEnd_CpApMySwcSnNvMPimLightOnOffCoun0E0D6B8B: RteEventRef=OIT_NvM_RpNotifyJobEnd_CpApMySwcSnNvMPimLightOnOffCounter_JobFinished_NvM_RpNotifyJobEnd_CpApMySwcSnNvMPimLightOnOffCoun0E0D6B8B
          OIT_DataServices_Diag_RWDI_LightOnOffCounter_LightOnOffCounter_Value_ReadData_DataServices_Diag_RWDI_LightOnOffCounter_LBCB6C10A: RteEventRef=OIT_DataServices_Diag_RWDI_LightOnOffCounter_LightOnOffCounter_Value_ReadData_DataServices_Diag_RWDI_LightOnOffCounter_LBCB6C10A
          OIT_DataServices_Diag_RWDI_LightOnOffCounter_LightOnOffCounter_Value_WriteData_DataServices_Diag_RWDI_LightOnOffCounter_9798F8A6: RteEventRef=OIT_DataServices_Diag_RWDI_LightOnOffCounter_LightOnOffCounter_Value_WriteData_DataServices_Diag_RWDI_LightOnOffCounter_9798F8A6
          OIT_DataServices_Diag_RWDI_LightOnOffCounter_LightOnOffCounter_Value_ConditionCheckRead_DataServices_Diag_RWDI_LightOnOf2065F94A: RteEventRef=OIT_DataServices_Diag_RWDI_LightOnOffCounter_LightOnOffCounter_Value_ConditionCheckRead_DataServices_Diag_RWDI_LightOnOf2065F94A
          OIT_CBReadData_OdometerValue_OdometerValue_ReadData_CBReadData_OdometerValue_OdometerValue_ReadData: RteEventRef=OIT_CBReadData_OdometerValue_OdometerValue_ReadData_CBReadData_OdometerValue_OdometerValue_ReadData
          OIT_CBReadData_OccurrenceCounter_OccurenceCounter_ReadData_CBReadData_OccurrenceCounter_OccurenceCounter_ReadData: RteEventRef=OIT_CBReadData_OccurrenceCounter_OccurenceCounter_ReadData_CBReadData_OccurrenceCounter_OccurenceCounter_ReadData
      CpSaDisplay_EcuSwComposition: RteSoftwareComponentInstanceRef=CpSaDisplay
        5 x RteEventToTaskMapping, all with RteImmediateRestart=false, RteMappedToTaskRef=Os/IO_Task:
          DRT_RCtApDisplayBusStateHandling_PpDisplayState_DeDisplayBusState: RtePositionInTask=4, RteEventRef=DRT_RCtApDisplayBusStateHandling_PpDisplayState_DeDisplayBusState, RteUsedOsEventRef=Os/Rte_Ev_Run_CpSaDisplay_RCtApDisplayBusStateHandling
          DRT_RCtApDisplayLightOnOffHandling_PpDisplayState_DeLightOnOffCounter: RtePositionInTask=5, RteEventRef=DRT_RCtApDisplayLightOnOffHandling_PpDisplayState_DeLightOnOffCounter, RteUsedOsEventRef=Os/Rte_Ev_Run_CpSaDisplay_RCtApDisplayLightOnOffHandling
          DRT_RCtApDisplayOdometerValue_PpDisplayState_DeOdometerValue: RtePositionInTask=6, RteEventRef=DRT_RCtApDisplayOdometerValue_PpDisplayState_DeOdometerValue, RteUsedOsEventRef=Os/Rte_Ev_Run_CpSaDisplay_RCtApDisplayOdometerValue
          DRT_RCtApDisplayOdometerWriteRequestPending_PpDisplayState_DeOdometerWriteRequrestPending: RtePositionInTask=7, RteEventRef=DRT_RCtApDisplayOdometerWriteRequestPending_PpDisplayState_DeOdometerWriteRequrestPending, RteUsedOsEventRef=Os/Rte_Ev_Run_CpSaDisplay_RCtApDisplayOdometerWriteRequestPending
          TMT_RCtApDisplayReadIgnitionSignal: RtePositionInTask=0, RteEventRef=TMT_RCtApDisplayReadIgnitionSignal, RteUsedOsEventRef=Os/Rte_Ev_Cyclic_IO_Task_0_200ms, RteUsedOsAlarmRef=Os/Rte_Al_TE_IO_Task_0_200ms
      CpSaDoorFrontLeft_EcuSwComposition: RteSoftwareComponentInstanceRef=CpSaDoorFrontLeft
        TMT_RCtSaDoorReadDoor (RteEventToTaskMapping):
          RteImmediateRestart = false
          RtePositionInTask = 3
          RteEventRef = TMT_RCtSaDoorReadDoor
          RteMappedToTaskRef = Os/IO_Task
          RteUsedOsEventRef = Os/Rte_Ev_Cyclic_IO_Task_0_200ms
          RteUsedOsAlarmRef = Os/Rte_Al_TE_IO_Task_0_200ms
      CpSaDoorFrontRight_EcuSwComposition: RteSoftwareComponentInstanceRef=CpSaDoorFrontRight
        TMT_RCtSaDoorReadDoor (RteEventToTaskMapping):
          RteImmediateRestart = false
          RtePositionInTask = 2
          RteEventRef = TMT_RCtSaDoorReadDoor
          RteMappedToTaskRef = Os/IO_Task
          RteUsedOsEventRef = Os/Rte_Ev_Cyclic_IO_Task_0_200ms
          RteUsedOsAlarmRef = Os/Rte_Al_TE_IO_Task_0_200ms
      CpSaInteriorLightFront_EcuSwComposition: RteSoftwareComponentInstanceRef=CpSaInteriorLightFront
        DRT_RCtSaInteriorLightSwitchLight_PpLightState_Element (RteEventToTaskMapping):
          RteImmediateRestart = false
          RtePositionInTask = 8
          RteEventRef = DRT_RCtSaInteriorLightSwitchLight_PpLightState_Element
          RteMappedToTaskRef = Os/IO_Task
          RteUsedOsEventRef = Os/Rte_Ev_Run_CpSaInteriorLightFront_RCtSaInteriorLightSwitchLight
    CtCddIoHwAb (RteSwComponentType): RteComponentTypeRef=CtCddIoHwAb, RteImplementationRef=CtCddIoHwAb_Implementation
      ComponentTypeCalibration (RteComponentTypeCalibration): RteCalibrationSupportEnabled=false
    CtCddIoHwAb_EcuSwComposition (RteSwComponentInstance): RteSoftwareComponentInstanceRef=CpCddIoHwAb
      8 x RteEventToTaskMapping, all with RteImmediateRestart=false:
        OIT_RCtCddIoHwAb_PpDisplayState_ReadChannel_PpDisplayState_ReadChannel: RtePositionInTask=0, RteEventRef=OIT_RCtCddIoHwAb_PpDisplayState_ReadChannel_PpDisplayState_ReadChannel
        OIT_RCtCddIoHwAb_PpDisplayState_WriteChannel_PpDisplayState_WriteChannel: RtePositionInTask=1, RteEventRef=OIT_RCtCddIoHwAb_PpDisplayState_WriteChannel_PpDisplayState_WriteChannel
        OIT_RCtCddIoHwAb_PpDoorFrontLeft_ReadChannel_PpDoorFrontLeft_ReadChannel: RtePositionInTask=2, RteEventRef=OIT_RCtCddIoHwAb_PpDoorFrontLeft_ReadChannel_PpDoorFrontLeft_ReadChannel
        OIT_RCtCddIoHwAb_PpDoorFrontRight_ReadChannel_PpDoorFrontRight_ReadChannel: RtePositionInTask=4, RteEventRef=OIT_RCtCddIoHwAb_PpDoorFrontRight_ReadChannel_PpDoorFrontRight_ReadChannel
        OIT_RCtCddIoHwAb_PpInteriorLightFront_WriteChannel_PpInteriorLightFront_WriteChannel: RtePositionInTask=9, RteEventRef=OIT_RCtCddIoHwAb_PpInteriorLightFront_WriteChannel_PpInteriorLightFront_WriteChannel
        OIT_RCtCddIoHwAb_PpInteriorLightFrontDEFECT_ReadChannel_PpInteriorLightFrontDEFECT_ReadChannel: RtePositionInTask=6, RteEventRef=OIT_RCtCddIoHwAb_PpInteriorLightFrontDEFECT_ReadChannel_PpInteriorLightFrontDEFECT_ReadChannel
        OIT_RCtCddIoHwAb_PpLocalClamp15_ReadChannel_PpLocalClamp15_ReadChannel: RtePositionInTask=10, RteEventRef=OIT_RCtCddIoHwAb_PpLocalClamp15_ReadChannel_PpLocalClamp15_ReadChannel
        OIT_RCtCddIoHwAb_PpLocalClamp15_WriteChannel_PpLocalClamp15_WriteChannel: RtePositionInTask=11, RteEventRef=OIT_RCtCddIoHwAb_PpLocalClamp15_WriteChannel_PpLocalClamp15_WriteChannel
    ComM_EcuSwComposition (RteSwComponentInstance): RteSoftwareComponentInstanceRef=ComM
      12 x RteEventToTaskMapping, all with RteImmediateRestart=false:
        Timer_ComM_MainFunction_0: RtePositionInTask=0, RteEventRef=Timer_ComM_MainFunction_0, RteMappedToTaskRef=Os/SchM_Task, RteUsedOsEventRef=Os/Rte_Ev_Cyclic2_SchM_Task_0_20ms, RteUsedOsAlarmRef=Os/Rte_Al_TE2_SchM_Task_0_20ms
        OpEventGetInhibitionStatus_GetInhibitionStatus_CL_CAN00_f26020e5: RteEventRef=OpEventGetInhibitionStatus_GetInhibitionStatus_CL_CAN00_f26020e5
        OpEventLimitECUToNoComMode_LimitECUToNoComMode_modeLimitation: RteEventRef=OpEventLimitECUToNoComMode_LimitECUToNoComMode_modeLimitation
        OpEventReadInhibitCounter_ReadInhibitCounter_modeLimitation: RteEventRef=OpEventReadInhibitCounter_ReadInhibitCounter_modeLimitation
        OpEventResetInhibitCounter_ResetInhibitCounter_modeLimitation: RteEventRef=OpEventResetInhibitCounter_ResetInhibitCounter_modeLimitation
        OpEventSetECUGroupClassification_SetECUGroupClassification_modeLimitation: RteEventRef=OpEventSetECUGroupClassification_SetECUGroupClassification_modeLimitation
        OpEventLimitChannelToNoComMode_LimitChannelToNoComMode_CL_CAN00_f26020e5: RteEventRef=OpEventLimitChannelToNoComMode_LimitChannelToNoComMode_CL_CAN00_f26020e5
        OpEventPreventWakeUp_PreventWakeUp_CW_CAN00_f26020e5: RteEventRef=OpEventPreventWakeUp_PreventWakeUp_CW_CAN00_f26020e5
        OpEventRequestComMode_RequestComMode_UR_USR_CHNL_CAN00: RteEventRef=OpEventRequestComMode_RequestComMode_UR_USR_CHNL_CAN00
        OpEventGetMaxComMode_GetMaxComMode_UR_USR_CHNL_CAN00: RteEventRef=OpEventGetMaxComMode_GetMaxComMode_UR_USR_CHNL_CAN00
        OpEventGetRequestedComMode_GetRequestedComMode_UR_USR_CHNL_CAN00: RteEventRef=OpEventGetRequestedComMode_GetRequestedComMode_UR_USR_CHNL_CAN00
        OpEventGetCurrentComMode_GetCurrentComMode_UR_USR_CHNL_CAN00: RteEventRef=OpEventGetCurrentComMode_GetCurrentComMode_UR_USR_CHNL_CAN00
    3 x RteBswModuleInstance:
      Dem: RteBswImplementationRef=Dem_Impl, RteBswModuleConfigurationRef=Dem
        Dem_MainFunctionTimingEvent0 (RteBswEventToTaskMapping):
          RteBswImmediateRestart = false
          RteBswPositionInTask = 6
          RteBswEventRef = Dem_MainFunctionTimingEvent0
          RteBswMappedToTaskRef = Os/SchM_Task
          RteBswUsedOsEventRef = Os/Rte_Ev_Cyclic2_SchM_Task_0_10ms
          RteBswUsedOsAlarmRef = Os/Rte_Al_TE2_SchM_Task_0_10ms
        3 x RteBswExclusiveAreaImpl, all with RteExclusiveAreaImplMechanism=ALL_INTERRUPT_BLOCKING:
          DEM_EXCLUSIVE_AREA_{0..2}: RteBswExclusiveAreaRef=DEM_EXCLUSIVE_AREA_{0..2}
      CanTp: RteBswImplementationRef=CanTp_Impl, RteBswModuleConfigurationRef=CanTp
        CanTp_MainFunctionTimingEvent0 (RteBswEventToTaskMapping):
          RteBswImmediateRestart = false
          RteBswPositionInTask = 4
          RteBswEventRef = CanTp_MainFunctionTimingEvent0
          RteBswMappedToTaskRef = Os/SchM_Task
          RteBswUsedOsEventRef = Os/Rte_Ev_Cyclic2_SchM_Task_0_5ms
          RteBswUsedOsAlarmRef = Os/Rte_Al_TE2_SchM_Task_0_5ms
        CANTP_EXCLUSIVE_AREA_0 (RteBswExclusiveAreaImpl): RteExclusiveAreaImplMechanism=ALL_INTERRUPT_BLOCKING, RteBswExclusiveAreaRef=CANTP_EXCLUSIVE_AREA_0
      Dcm: RteBswImplementationRef=Dcm_Impl, RteBswModuleConfigurationRef=Dcm
        Dcm_MainFunctionTimingEvent0 (RteBswEventToTaskMapping):
          RteBswImmediateRestart = false
          RteBswPositionInTask = 15
          RteBswEventRef = Dcm_MainFunctionTimingEvent0
          RteBswMappedToTaskRef = Os/SchM_Task
          RteBswUsedOsEventRef = Os/Rte_Ev_Cyclic2_SchM_Task_0_10ms
          RteBswUsedOsAlarmRef = Os/Rte_Al_TE2_SchM_Task_0_10ms
        DCM_EXCLUSIVE_AREA_0 (RteBswExclusiveAreaImpl): RteExclusiveAreaImplMechanism=ALL_INTERRUPT_BLOCKING, RteBswExclusiveAreaRef=DCM_EXCLUSIVE_AREA_0
    Dcm_EcuSwComposition (RteSwComponentInstance): RteSoftwareComponentInstanceRef=Dcm
      6 x RteEventToTaskMapping, all with RteImmediateRestart=false:
        Timer_Dcm_MainFunction: RtePositionInTask=15, RteEventRef=Timer_Dcm_MainFunction, RteMappedToTaskRef=Os/SchM_Task, RteUsedOsEventRef=Os/Rte_Ev_Cyclic2_SchM_Task_0_10ms, RteUsedOsAlarmRef=Os/Rte_Al_TE2_SchM_Task_0_10ms
        OpEventGetActiveProtocol_GetActiveProtocol_DCMServices: RteEventRef=OpEventGetActiveProtocol_GetActiveProtocol_DCMServices
        OpEventGetSesCtrlType_GetSesCtrlType_DCMServices: RteEventRef=OpEventGetSesCtrlType_GetSesCtrlType_DCMServices
        OpEventResetToDefaultSession_ResetToDefaultSession_DCMServices: RteEventRef=OpEventResetToDefaultSession_ResetToDefaultSession_DCMServices
        OpEventGetSecurityLevel_GetSecurityLevel_DCMServices: RteEventRef=OpEventGetSecurityLevel_GetSecurityLevel_DCMServices
        OpEventSetActiveDiagnostic_SetActiveDiagnostic_DCMServices: RteEventRef=OpEventSetActiveDiagnostic_SetActiveDiagnostic_DCMServices
  module config VTTCan: implementation-config-variant=VARIANT-PRE-COMPILE, module-description=VTTCan_Impl
    CanTest: CanHwLayout=STANDARD, CanHwMailboxMax=250, CanHwFullCanTxSize=1, CanHwFullCanRxSize=1, CanHwBasicCanTxSize=1, CanHwBasicCanRxSize=1
    CanConfigSet
      CT_CAN00_e98c47e6 (CanController):
        CanBusoffProcessing = INTERRUPT
        CanControllerActivation = true
        CanControllerBaseAddress = 0
        CanControllerId = 0
        CanRxProcessing = INTERRUPT
        CanTxProcessing = INTERRUPT
        CanWakeupProcessing = INTERRUPT
        CanWakeupSupport = true
        CanWakeupSourceId = 32
        CanBusName = CAN
        CanControllerDefaultBaudrate = CT_CAN00_e98c47e6/CanControllerBaudrateConfig
        CanWakeupSourceRef = ECUM_WKSOURCE_CAN
        CanFilterMask: CanFilterMaskValue=448, CanFilterCodeValue=0, IsLocked=false
        CanControllerBaudrateConfig:
          CanControllerBaudRate = 500
          CanControllerBaudRateConfigID = 0
          CanControllerPropSeg = 9
          CanControllerSeg1 = 3
          CanControllerSeg2 = 3
          CanControllerSyncJumpWidth = 2
          CanBaudrateClock = 8000
          CanBaudratePrescaler = 1
          CanSamplingMode = OneSample
      CN_CAN00_e98c47e6_Rx_Std (CanHardwareObject):
        CanHandleType = BASIC
        CanIdType = STANDARD
        CanIdValue = 0
        CanObjectId = 1
        CanObjectType = RECEIVE
        CanHwProcessing = false
        CanObjectHwSize = 1
        CanObjectHwHandle = 1
        CanMaxDataLen = 8
        CanFdPaddingValue = 0
        CanControllerRef = CanConfigSet/CT_CAN00_e98c47e6
        CanFilterMaskRef = CT_CAN00_e98c47e6/CanFilterMask
      CN_CAN00_e98c47e6_Tx_Std (CanHardwareObject):
        CanHandleType = BASIC
        CanIdType = STANDARD
        CanIdValue = 0
        CanObjectId = 0
        CanObjectType = TRANSMIT
        CanHwProcessing = false
        CanObjectHwSize = 1
        CanObjectHwHandle = 0
        CanMaxDataLen = 8
        CanFdPaddingValue = 0
        CanControllerRef = CanConfigSet/CT_CAN00_e98c47e6
    CanGeneral:
      CanChangeBaudrateApi = false
      CanDevErrorDetection = true
      CanHardwareCancellation = false
      CanIdenticalIdCancellation = false
      CanMainFunctionBusoffPeriod = 0.01
      CanMainFunctionModePeriod = 0.01
      CanMainFunctionWakeupPeriod = 0.01
      CanMultiplexedTransmission = false
      CanSetBaudrateApi = false
      CanTimeoutDuration = 0.01
      CanVersionInfoApi = false
      CanGenericPrecopy = false
      CanHardwareLoopCheck = false
      CanSecureTempBuffer = false
      CanRxFullCANSupport = false
      CanTxFullCANSupport = false
      CanRxBasicCANSupport = true
      CanUseNestedCANInterrupts = false
      CanHardwareCancelByAppl = false
      CanIndividualProcessing = false
      CanGenericConfirmation = false
      CanRxQueue = false
      CanSupportMixedID = false
      CanRxQueueSize = 1
      CanMultipleBasicCANObjects = false
      CanHardwareHandleType = UINT8
      CanOptimizeOneController = true
      CanInterruptCategory = CATEGORY2
      CanGetStatus = false
      CanInterruptLock = DRIVER
      CanWakeupSupport = true
      CanRamCheck = None
      CanOverrunNotification = DET
      CanReinitStart = true
      CanGenericPreTransmit = false
      CanFdSupport = NONE
      CanRuntimeMeasurementSupport = false
      CanIndex = 0
      CanMaxRxDataLen = 8
      CanMaxTxDataLen = 8
      CanUsePeripheralAccessApi = false
      CanMirrorModeSupport = false
      CanMainFunctionRWPeriods
  module config VTTCntrl: implementation-config-variant=VARIANT-PRE-COMPILE, module-description=VTTCntrl_Impl
    VttGeneral:
      VttPreferredInputAsrVersion = 4.2.1
      VttRequiredEcucGeneratorVersion = 1.0
      VttEntryPointName = main
      VttHeaderFile = main.h
      VttUserCalloutOnStateChange = true
    VttSystemVariables
      3 x VttSysVarType:
        sint64
        float64
        uint64
  module config VTTDio: implementation-config-variant=VARIANT-PRE-COMPILE, module-description=VTTDio_Impl
    DioGeneral: DioDevErrorDetect=true, DioFlipChannelApi=false, DioVersionInfoApi=true
    DioConfig
      DioPort: DioPortId=0
        6 x DioChannel:
          env_DisplayBusAwake: DioChannelId=4
          env_DoorFrontLeft: DioChannelId=1
          env_DoorFrontRight: DioChannelId=2
          env_InteriorLightFront: DioChannelId=0
          env_InteriorLightFrontDEFECT: DioChannelId=3
          env_LocalClamp15: DioChannelId=5
        DioChannelGroup: DioPortMask=1, DioPortOffset=0
  module config VTTEcuC: implementation-config-variant=VARIANT-PRE-COMPILE, module-description=VTTEcuC_Impl
    EcucGeneral:
      BitFieldDataType = INT
      BitOrder = LSB_to_MSB
      EcucBswImplementationCodeType = EcuCSourceCode
      SizeOfEnum = Size32Bit
      SizeOfRAMPointer = Size32Bit
      SizeOfROMPointer = Size32Bit
      ByteOrder = LITTLE_ENDIAN
      AtomicBitAccessInBitfield = false
      AtomicVariableAccess = Atomic32BitAccess
      CPUType = CPU32Bit
      SizeOfInt = Size32Bit
      StructAlignment = Auto
      ArrayAlignment = Auto
      StructInArrayAlignment = Auto
      DummyFunction = false
      EcuCSafeBswChecks = false
      DummyStatement = false
      DummyStatementKind = None
      ConditionalGenerating = true
      EcuCUseStdReturnTypeForRte = false
  module config VTTFls: implementation-config-variant=VARIANT-PRE-COMPILE, module-description=VTTFls_Impl
    FlsGeneral:
      FlsBaseAddress = 0
      FlsCancelApi = true
      FlsCompareApi = true
      FlsDevErrorDetect = true
      FlsDriverIndex = 0
      FlsGetJobResultApi = true
      FlsGetStatusApi = true
      FlsSetModeApi = true
      FlsTotalSize = 131072
      FlsVersionInfoApi = true
    FlsPublishedInformation: FlsErasedValue=255
    FlsConfigSet: FlsDefaultMode=MEMIF_MODE_SLOW, FlsMaxReadFastMode=64, FlsMaxReadNormalMode=32, FlsMaxWriteFastMode=8, FlsMaxWriteNormalMode=8, FlsCallCycle=0.01
      FlsSectorList
        128 x FlsSector, all with FlsNumberOfSectors=1, FlsPageSize=2, FlsSectorSize=1024:
          FlsSector000: FlsSectorStartaddress=0
          FlsSector001: FlsSectorStartaddress=1024
          FlsSector002: FlsSectorStartaddress=2048
          FlsSector003: FlsSectorStartaddress=3072
          FlsSector004: FlsSectorStartaddress=4096
          FlsSector005: FlsSectorStartaddress=5120
          FlsSector006: FlsSectorStartaddress=6144
          FlsSector007: FlsSectorStartaddress=7168
          FlsSector008: FlsSectorStartaddress=8192
          FlsSector009: FlsSectorStartaddress=9216
          FlsSector010: FlsSectorStartaddress=10240
          FlsSector011: FlsSectorStartaddress=11264
          FlsSector012: FlsSectorStartaddress=12288
          FlsSector013: FlsSectorStartaddress=13312
          FlsSector014: FlsSectorStartaddress=14336
          FlsSector015: FlsSectorStartaddress=15360
          FlsSector016: FlsSectorStartaddress=16384
          FlsSector017: FlsSectorStartaddress=17408
          FlsSector018: FlsSectorStartaddress=18432
          FlsSector019: FlsSectorStartaddress=19456
          FlsSector020: FlsSectorStartaddress=20480
          FlsSector021: FlsSectorStartaddress=21504
          FlsSector022: FlsSectorStartaddress=22528
          FlsSector023: FlsSectorStartaddress=23552
          FlsSector024: FlsSectorStartaddress=24576
          FlsSector025: FlsSectorStartaddress=25600
          FlsSector026: FlsSectorStartaddress=26624
          FlsSector027: FlsSectorStartaddress=27648
          FlsSector028: FlsSectorStartaddress=28672
          FlsSector029: FlsSectorStartaddress=29696
          FlsSector030: FlsSectorStartaddress=30720
          FlsSector031: FlsSectorStartaddress=31744
          FlsSector032: FlsSectorStartaddress=32768
          FlsSector033: FlsSectorStartaddress=33792
          FlsSector034: FlsSectorStartaddress=34816
          FlsSector035: FlsSectorStartaddress=35840
          FlsSector036: FlsSectorStartaddress=36864
          FlsSector037: FlsSectorStartaddress=37888
          FlsSector038: FlsSectorStartaddress=38912
          FlsSector039: FlsSectorStartaddress=39936
          FlsSector040: FlsSectorStartaddress=40960
          FlsSector041: FlsSectorStartaddress=41984
          FlsSector042: FlsSectorStartaddress=43008
          FlsSector043: FlsSectorStartaddress=44032
          FlsSector044: FlsSectorStartaddress=45056
          FlsSector045: FlsSectorStartaddress=46080
          FlsSector046: FlsSectorStartaddress=47104
          FlsSector047: FlsSectorStartaddress=48128
          FlsSector048: FlsSectorStartaddress=49152
          FlsSector049: FlsSectorStartaddress=50176
          FlsSector050: FlsSectorStartaddress=51200
          FlsSector051: FlsSectorStartaddress=52224
          FlsSector052: FlsSectorStartaddress=53248
          FlsSector053: FlsSectorStartaddress=54272
          FlsSector054: FlsSectorStartaddress=55296
          FlsSector055: FlsSectorStartaddress=56320
          FlsSector056: FlsSectorStartaddress=57344
          FlsSector057: FlsSectorStartaddress=58368
          FlsSector058: FlsSectorStartaddress=59392
          FlsSector059: FlsSectorStartaddress=60416
          FlsSector060: FlsSectorStartaddress=61440
          FlsSector061: FlsSectorStartaddress=62464
          FlsSector062: FlsSectorStartaddress=63488
          FlsSector063: FlsSectorStartaddress=64512
          FlsSector064: FlsSectorStartaddress=65536
          FlsSector065: FlsSectorStartaddress=66560
          FlsSector066: FlsSectorStartaddress=67584
          FlsSector067: FlsSectorStartaddress=68608
          FlsSector068: FlsSectorStartaddress=69632
          FlsSector069: FlsSectorStartaddress=70656
          FlsSector070: FlsSectorStartaddress=71680
          FlsSector071: FlsSectorStartaddress=72704
          FlsSector072: FlsSectorStartaddress=73728
          FlsSector073: FlsSectorStartaddress=74752
          FlsSector074: FlsSectorStartaddress=75776
          FlsSector075: FlsSectorStartaddress=76800
          FlsSector076: FlsSectorStartaddress=77824
          FlsSector077: FlsSectorStartaddress=78848
          FlsSector078: FlsSectorStartaddress=79872
          FlsSector079: FlsSectorStartaddress=80896
          FlsSector080: FlsSectorStartaddress=81920
          FlsSector081: FlsSectorStartaddress=82944
          FlsSector082: FlsSectorStartaddress=83968
          FlsSector083: FlsSectorStartaddress=84992
          FlsSector084: FlsSectorStartaddress=86016
          FlsSector085: FlsSectorStartaddress=87040
          FlsSector086: FlsSectorStartaddress=88064
          FlsSector087: FlsSectorStartaddress=89088
          FlsSector088: FlsSectorStartaddress=90112
          FlsSector089: FlsSectorStartaddress=91136
          FlsSector090: FlsSectorStartaddress=92160
          FlsSector091: FlsSectorStartaddress=93184
          FlsSector092: FlsSectorStartaddress=94208
          FlsSector093: FlsSectorStartaddress=95232
          FlsSector094: FlsSectorStartaddress=96256
          FlsSector095: FlsSectorStartaddress=97280
          FlsSector096: FlsSectorStartaddress=98304
          FlsSector097: FlsSectorStartaddress=99328
          FlsSector098: FlsSectorStartaddress=100352
          FlsSector099: FlsSectorStartaddress=101376
          FlsSector100: FlsSectorStartaddress=102400
          FlsSector101: FlsSectorStartaddress=103424
          FlsSector102: FlsSectorStartaddress=104448
          FlsSector103: FlsSectorStartaddress=105472
          FlsSector104: FlsSectorStartaddress=106496
          FlsSector105: FlsSectorStartaddress=107520
          FlsSector106: FlsSectorStartaddress=108544
          FlsSector107: FlsSectorStartaddress=109568
          FlsSector108: FlsSectorStartaddress=110592
          FlsSector109: FlsSectorStartaddress=111616
          FlsSector110: FlsSectorStartaddress=112640
          FlsSector111: FlsSectorStartaddress=113664
          FlsSector112: FlsSectorStartaddress=114688
          FlsSector113: FlsSectorStartaddress=115712
          FlsSector114: FlsSectorStartaddress=116736
          FlsSector115: FlsSectorStartaddress=117760
          FlsSector116: FlsSectorStartaddress=118784
          FlsSector117: FlsSectorStartaddress=119808
          FlsSector118: FlsSectorStartaddress=120832
          FlsSector119: FlsSectorStartaddress=121856
          FlsSector120: FlsSectorStartaddress=122880
          FlsSector121: FlsSectorStartaddress=123904
          FlsSector122: FlsSectorStartaddress=124928
          FlsSector123: FlsSectorStartaddress=125952
          FlsSector124: FlsSectorStartaddress=126976
          FlsSector125: FlsSectorStartaddress=128000
          FlsSector126: FlsSectorStartaddress=129024
          FlsSector127: FlsSectorStartaddress=130048
  module config VTTMcu: implementation-config-variant=VARIANT-PRE-COMPILE, module-description=VTTMcu_Impl
    McuPublishedInformation
      McuResetReasonConf: McuResetReason=0
    McuGeneralConfiguration: McuDevErrorDetect=true, McuGetRamStateApi=false, McuInitClock=true, McuNoPll=true, McuPerformResetApi=true, McuVersionInfoApi=true
    McuModuleConfiguration
      McuClockSettingConfig
        McuClockReferencePoint: McuClockReferencePointFrequency=80000000
      4 x McuModeSettingConf:
        SLEEP: McuMode=1, McuVttMode=VTTMCU_MODE_SLEEP
        NORMAL: McuMode=0, McuVttMode=VTTMCU_MODE_NORMAL
        POWER_OFF: McuMode=3, McuVttMode=VTTMCU_MODE_POWER_OFF
        RESET: McuMode=2, McuVttMode=VTTMCU_MODE_RESET
  module config VTTOs: implementation-config-variant=VARIANT-PRE-COMPILE, module-description=Os_Impl
    OSDEFAULTAPPMODE (OsAppMode)
    OsImplementationInformation: OsBswmdStyleVersion=2, OsVectorImplementationName=CANoeOsekEmu.i40, OsVectorOilVersion=4.0
    OsOS:
      OsStackMonitoring = false
      OsOSStackUsageMeasurement = FALSE
      OsScalabilityClass = SC1
      OsOSTypeHeaderInclude = false
      OsStatus = EXTENDED
      OsUseGetServiceId = false
      OsUseParameterAccess = false
      OsUseResScheduler = false
      OsOSCallISRHooks = false
      OsOSEnumeratedUnhandledISRs = true
      OsOSUserConfigurationVersion = 1
      OsOSCompiler = MicrosoftVisualC
      OsOSCC
        AUTO
      OsOSInternalTrace
        FALSE
      OsHooks: OsProtectionHook=false, OsErrorHook=false, OsPostTaskHook=false, OsPreTaskHook=false, OsShutdownHook=true, OsStartupHook=false
      OsOSSCHEDULE
        NON_AUTO: OsOSSCHEDULE=MIXED
      OsOSAPIOptimization
        Automatic
      OsOSProtectionHookReaction
        Selected: OsOSKILLAPPL=false, OsOSKILLAPPL_RESTART=false, OsOSKILLTASKISR=false, OsOSSHUTDOWN=true
      OsOSTimingMeasurement
        FALSE
      OsOSSystemTimer
        Standard: OsOSEnableNesting=false, OsOSTickTime=1000, OsOSInterruptPriority=1, OsOSVttDivider=1
    VectorCommonData: BswmdVersion=5.01.04
    4 x OsIsr, all with OsIsrCategory=CATEGORY_2, OsIsrEnableNesting=false, OsIsrAnalysisPriority=0, OsIsrComputationTime=0, OsIsrPeriod=0, OsIsrDeadline=0, OsIsrInterruptLevel=31:
      CanIsrWakeup_0: OsIsrInterruptSource=CanIsrWakeup_0
        OsIsrUseSpecialFunctionName  # UB:Automatically generated by the OsIsrConfigurationService.
          FALSE  # UB:Automatically generated by the OsIsrConfigurationService.
      CanIsrTx_0: OsIsrInterruptSource=CanIsrTx_0
        OsIsrUseSpecialFunctionName  # UB:Automatically generated by the OsIsrConfigurationService.
          FALSE  # UB:Automatically generated by the OsIsrConfigurationService.
      CanIsrErr_0: OsIsrInterruptSource=CanIsrErr_0
        OsIsrUseSpecialFunctionName  # UB:Automatically generated by the OsIsrConfigurationService.
          FALSE  # UB:Automatically generated by the OsIsrConfigurationService.
      CanIsrRx_0: OsIsrInterruptSource=CanIsrRx_0
        OsIsrUseSpecialFunctionName  # UB:Automatically generated by the OsIsrConfigurationService.
          FALSE  # UB:Automatically generated by the OsIsrConfigurationService.
    SystemTimer (OsCounter): OsCounterMaxAllowedValue=2147483647, OsCounterMinCycle=1, OsCounterTicksPerBase=1, OsCounterType=SOFTWARE, OsSecondsPerTick=1234567890
    OsResource: OsResourceProperty=STANDARD
    4 x OsTask, all with OsTaskActivation=1, OsTaskComputationTime=0, OsTaskPeriod=0, OsTaskDeadline=0:
      SchM_Task: OsTaskPriority=6, OsTaskSchedule=FULL, OsTaskTYPE=EXTENDED, OsTaskEventRef=VTTOs/Rte_Ev_Cyclic2_SchM_Task_0_10ms, OsTaskEventRef=VTTOs/Rte_Ev_Cyclic2_SchM_Task_0_20ms, OsTaskEventRef=VTTOs/Rte_Ev_Cyclic2_SchM_Task_0_5ms
      Init_Task: OsTaskPriority=4, OsTaskSchedule=NON, OsTaskTYPE=BASIC
        OsTaskAutostart: OsTaskAppModeRef=VTTOs/OSDEFAULTAPPMODE
      My_Task: OsTaskPriority=2, OsTaskSchedule=FULL, OsTaskTYPE=EXTENDED, OsTaskEventRef=VTTOs/Rte_Ev_Run_CpApMySwc_RCtApMySwcCode, OsTaskEventRef=VTTOs/Rte_Ev_Run_CpApMySwc_RCtApMySwcComM_ModeChange_FULL_COMM_Entry, OsTaskEventRef=VTTOs/Rte_Ev_Run_CpApMySwc_RCtApMySwcComM_ModeChange_FULL_COMM_Exit
      IO_Task: OsTaskPriority=3, OsTaskSchedule=FULL, OsTaskTYPE=EXTENDED, OsTaskEventRef=VTTOs/Rte_Ev_Cyclic_IO_Task_0_200ms, OsTaskEventRef=VTTOs/Rte_Ev_Run_CpSaDisplay_RCtApDisplayBusStateHandling, OsTaskEventRef=VTTOs/Rte_Ev_Run_CpSaDisplay_RCtApDisplayLightOnOffHandling, OsTaskEventRef=VTTOs/Rte_Ev_Run_CpSaDisplay_RCtApDisplayOdometerValue, OsTaskEventRef=VTTOs/Rte_Ev_Run_CpSaDisplay_RCtApDisplayOdometerWriteRequestPending, OsTaskEventRef=VTTOs/Rte_Ev_Run_CpSaInteriorLightFront_RCtSaInteriorLightSwitchLight
    Rte_Al_TE2_SchM_Task_0_10ms (OsAlarm): OsAlarmCounterRef=VTTOs/SystemTimer
      OsAlarmAction
        OsAlarmSetEvent: OsAlarmSetEventRef=VTTOs/Rte_Ev_Cyclic2_SchM_Task_0_10ms, OsAlarmSetEventTaskRef=VTTOs/SchM_Task
    Rte_Ev_Cyclic2_SchM_Task_0_10ms (OsEvent)
    Rte_Al_TE2_SchM_Task_0_20ms (OsAlarm): OsAlarmCounterRef=VTTOs/SystemTimer
      OsAlarmAction
        OsAlarmSetEvent: OsAlarmSetEventRef=VTTOs/Rte_Ev_Cyclic2_SchM_Task_0_20ms, OsAlarmSetEventTaskRef=VTTOs/SchM_Task
    6 x OsEvent:
      Rte_Ev_Cyclic2_SchM_Task_0_20ms
      Rte_Ev_Run_CpSaDisplay_RCtApDisplayBusStateHandling
      Rte_Ev_Run_CpSaDisplay_RCtApDisplayLightOnOffHandling
      Rte_Ev_Run_CpSaDisplay_RCtApDisplayOdometerValue
      Rte_Ev_Run_CpSaDisplay_RCtApDisplayOdometerWriteRequestPending
      Rte_Ev_Run_CpSaInteriorLightFront_RCtSaInteriorLightSwitchLight
    Rte_Al_TE2_SchM_Task_0_5ms (OsAlarm): OsAlarmCounterRef=VTTOs/SystemTimer
      OsAlarmAction
        OsAlarmSetEvent: OsAlarmSetEventRef=VTTOs/Rte_Ev_Cyclic2_SchM_Task_0_5ms, OsAlarmSetEventTaskRef=VTTOs/SchM_Task
    Rte_Ev_Cyclic2_SchM_Task_0_5ms (OsEvent)
    Rte_Al_TE_CpApMySwc_RCtApMySwcCode (OsAlarm): OsAlarmCounterRef=VTTOs/SystemTimer
      OsAlarmAction
        OsAlarmSetEvent: OsAlarmSetEventRef=VTTOs/Rte_Ev_Run_CpApMySwc_RCtApMySwcCode, OsAlarmSetEventTaskRef=VTTOs/My_Task
    Rte_Al_TE_IO_Task_0_200ms (OsAlarm): OsAlarmCounterRef=VTTOs/SystemTimer
      OsAlarmAction
        OsAlarmSetEvent: OsAlarmSetEventRef=VTTOs/Rte_Ev_Cyclic_IO_Task_0_200ms, OsAlarmSetEventTaskRef=VTTOs/IO_Task
    4 x OsEvent:
      Rte_Ev_Cyclic_IO_Task_0_200ms
      Rte_Ev_Run_CpApMySwc_RCtApMySwcCode
      Rte_Ev_Run_CpApMySwc_RCtApMySwcComM_ModeChange_FULL_COMM_Entry
      Rte_Ev_Run_CpApMySwc_RCtApMySwcComM_ModeChange_FULL_COMM_Exit
  module config Dem: implementation-config-variant=VARIANT-PRE-COMPILE, module-description=Dem_Impl
    DemGeneral:
      DemAgingCycleCounterProcessing = DEM_PROCESS_AGINGCTR_INTERN
      DemDebounceCounterBasedSupport = true
      DemDtcStatusAvailabilityMask = 121
      DemMaxNumberEventEntryMirror = 0
      DemPTOSupport = false
      DemTypeOfFreezeFrameRecordNumeration = DEM_FF_RECNUM_CALCULATED
      DemGeneralInterfaceSupport = false
      DemDataElementDefaultEndianness = LITTLE_ENDIAN
      DemAgingRequieresTestedCycle = false
      DemTriggerMonitorInitBeforeClearOk = true
      DemExtendedDataCapture = DEM_TRIGGER_EVENT_MEMORY_STORAGE
      DemFreezeFrameCapture = DEM_TRIGGER_EVENT_MEMORY_STORAGE
      DemOperationCycleProcessing = DEM_PROCESS_OPCYC_STATE
      DemMaxNumberTimeSeriesSnapshots = 0
      DemAvailabilitySupport = DEM_NO_AVAILABILITY
      DemAvailabilityStorage = false
      DemBswErrorBufferSize = 0
      DemClearDTCBehavior = DEM_CLRRESP_VOLATILE
      DemClearDTCLimitation = DEM_ALL_SUPPORTED_DTCS
      DemDebounceTimeBasedSupport = false
      DemDevErrorDetect = true
      DemEnableConditionSupport = false
      DemEventCombinationSupport = DEM_EVCOMB_DISABLED
      DemEventDisplacementStrategy = DEM_DISPLACEMENT_LEGACY_403
      DemEventMemoryEntryStorageTrigger = DEM_STORAGE_ON_TEST_FAILED
      DemMaxNumberEventEntryOBDFreezeFrame = 0
      DemMaxNumberEventEntryPermanent = 0
      DemMaxNumberEventEntryPrimary = 8
      DemMaxNumberEventEntrySecondary = 0
      DemMaxNumberPrestoredFF = 0
      DemOBDSupport = DEM_OBD_NO_OBD_SUPPORT
      DemOccurrenceCounterProcessing = DEM_PROCESS_OCCCTR_TF
      DemOperationCycleStatusStorage = false
      DemResetConfirmedBitOnOverflow = true
      DemStatusBitHandlingTestFailedSinceLastClear = DEM_STATUS_BIT_NORMAL
      DemStatusBitStorageTestFailed = true
      DemStorageConditionSupport = false
      DemSuppressionSupport = DEM_NO_SUPPRESSION
      DemTaskTime = 0.01
      DemTriggerDcmReports = false
      DemTriggerDltReports = false
      DemTriggerFiMReports = false
      DemTriggerMonitorInitForEnableConditions = false
      DemTypeOfDTCSupported = DEM_DTC_TRANSLATION_ISO14229_1
      DemVersionInfoApi = false
      DemBswApiVersion = DEM_BSW_API_4_XX_XX
      DemBswApiVersionNvM = DEM_BSW_API_4_XX_XX
      DemBswApiVersionFiM = DEM_BSW_API_4_XX_XX
      DemAgingAfterHealing = DEM_AGING_WHILE_HEALING
      DemAgingBehavior = DEM_AGING_TYPE_1
      DemAgingCounterBehavior = DEM_AGING_COUNT_ALWAYS
      DemAgingCounterReporting = DEM_AGING_NORMAL_REPORTING
      DemAgingRetainEnvironmentalData = false
      DemCompiledPostbuildCrc = 2064884157
      DemCompiledPostbuildCrcMode = DEM_POSTBUILD_CRC_AUTOMATIC
      DemEventDisplacementFallbackStrategy = DEM_FALLBACK_DISCARD_NEW_EVENT
      DemGeneralDiagnosticInfoSupport = true
      DemJ1939Support = false
      DemNvSynchronizeSupport = false
      DemPendingDtcProcessing = DEM_PROCESS_PDTC_STOREDONLY
      DemResetDebounceBehavior = DEM_RESET_DEBOUNCE_ON_DISABLE_ENABLE_CONDITIONS
      DemResetTestFailedOnOperationCycleStart = false
      DemRetryStorageSupport = false
      DemUseMemcopyMacros = false
      DemUseRte = true
      DemUserControlledWirBehavior = DEM_DISABLED_DURING_CONTROLDTCSETTING
      DemWarningIndicatorRequestedProcessing = DEM_PROCESS_WIR_STOREDONLY
      IgnitionCycle (DemOperationCycle): DemOperationCycleType=DEM_OPCYC_IGNITION, DemOperationCycleAutomaticEnd=false, DemOperationCycleAutostart=false
      DemPostbuild: DemEventAvailableDefaultSupport=true, DemMaxSizeFreezeFrame=0
      PowerCycle (DemOperationCycle): DemOperationCycleType=DEM_OPCYC_POWER, DemOperationCycleAutomaticEnd=false, DemOperationCycleAutostart=false
      10 x DemNvRamBlockId:
        Dem_AdminData: DemNvRamBlockIdType=DEM_NVBLOCK_ADMIN, DemNvRamBlockIdRef=DemAdminDataBlock
        Dem_StatusData: DemNvRamBlockIdType=DEM_NVBLOCK_STATUS, DemNvRamBlockIdRef=DemStatusDataBlock
        Dem_PrimaryEntry{0..7}: DemNvRamBlockIdType=DEM_NVBLOCK_PRIMARY, DemNvRamBlockIdIndex={0..7}, DemNvRamBlockIdRef=DemPrimaryDataBlock{0..7}
      OccurrenceCounter_OccurenceCounter (DemDataElementClass)
        OccurrenceCounter_OccurenceCounter (DemExternalCSDataElementClass): DemDataElementDataSize=4, DemUseEventIdArgumentForCallback=false, DemDataElementStoreNonVolatile=true, DemDataElementUsePort=true
      ExtendedDataClass_4f5344cd (DemExtendedDataClass): DemExtendedDataRecordClassRef=OccurrenceCounter, DemExtendedDataRecordClassRef=OdometerValue
      OccurrenceCounter (DemExtendedDataRecordClass): DemExtendedDataRecordNumber=1, DemDataElementClassRef=OccurrenceCounter_OccurenceCounter/OccurrenceCounter_OccurenceCounter
      OdometerValue (DemExtendedDataRecordClass): DemExtendedDataRecordNumber=2, DemDataElementClassRef=OdometerValue_OdometerValue/OdometerValue_OdometerValue
      OdometerValue_OdometerValue (DemDataElementClass)
        OdometerValue_OdometerValue (DemExternalCSDataElementClass): DemDataElementDataSize=4, DemUseEventIdArgumentForCallback=false, DemDataElementStoreNonVolatile=true, DemDataElementUsePort=true
    DemConfigSet
      12 x DemEventParameter, all with DemEventTimeSeries=DEM_TIMESERIES_SNAPSHOT_NONE, DemEventAvailable=true, DemEventAvailableInVariant=true, DemEventLatchTestFailed=false:
        AutoCreatedDemEvent_NVM_E_INTEGRITY_FAILED: DemEventId=1, DemEventKind=DEM_EVENT_KIND_BSW
          DemEventClass:
            DemAgingAllowed = false
            DemConsiderPtoStatus = false
            DemEventDestination = DEM_DTC_ORIGIN_PRIMARY_MEMORY
            DemEventPriority = 2
            DemFFPrestorageSupported = false
            DemOperationCycleRef = PowerCycle
            DemDebounceAlgorithmClass
              DemDebounceCounterBased:
                DemDebounceBehavior = DEM_DEBOUNCE_FREEZE
                DemDebounceCounterDecrementStepSize = 1
                DemDebounceCounterFailedThreshold = 127
                DemDebounceCounterIncrementStepSize = 1
                DemDebounceCounterJumpDown = true
                DemDebounceCounterJumpDownValue = 0
                DemDebounceCounterJumpUp = true
                DemDebounceCounterJumpUpValue = 0
                DemDebounceCounterPassedThreshold = -128
                DemDebounceCounterStorage = false
                DemDebounceContinuous = false
        AutoCreatedDemEvent_NVM_E_LOSS_OF_REDUNDANCY: DemEventId=3, DemEventKind=DEM_EVENT_KIND_BSW
          DemEventClass:
            DemAgingAllowed = false
            DemConsiderPtoStatus = false
            DemEventDestination = DEM_DTC_ORIGIN_PRIMARY_MEMORY
            DemEventPriority = 2
            DemFFPrestorageSupported = false
            DemOperationCycleRef = PowerCycle
            DemDebounceAlgorithmClass
              DemDebounceCounterBased:
                DemDebounceBehavior = DEM_DEBOUNCE_FREEZE
                DemDebounceCounterDecrementStepSize = 1
                DemDebounceCounterFailedThreshold = 127
                DemDebounceCounterIncrementStepSize = 1
                DemDebounceCounterJumpDown = true
                DemDebounceCounterJumpDownValue = 0
                DemDebounceCounterJumpUp = true
                DemDebounceCounterJumpUpValue = 0
                DemDebounceCounterPassedThreshold = -128
                DemDebounceCounterStorage = false
                DemDebounceContinuous = false
        AutoCreatedDemEvent_NVM_E_QUEUE_OVERFLOW: DemEventId=4, DemEventKind=DEM_EVENT_KIND_BSW
          DemEventClass:
            DemAgingAllowed = false
            DemConsiderPtoStatus = false
            DemEventDestination = DEM_DTC_ORIGIN_PRIMARY_MEMORY
            DemEventPriority = 2
            DemFFPrestorageSupported = false
            DemOperationCycleRef = PowerCycle
            DemDebounceAlgorithmClass
              DemDebounceCounterBased:
                DemDebounceBehavior = DEM_DEBOUNCE_FREEZE
                DemDebounceCounterDecrementStepSize = 1
                DemDebounceCounterFailedThreshold = 127
                DemDebounceCounterIncrementStepSize = 1
                DemDebounceCounterJumpDown = true
                DemDebounceCounterJumpDownValue = 0
                DemDebounceCounterJumpUp = true
                DemDebounceCounterJumpUpValue = 0
                DemDebounceCounterPassedThreshold = -128
                DemDebounceCounterStorage = false
                DemDebounceContinuous = false
        AutoCreatedDemEvent_NVM_E_REQ_FAILED: DemEventId=5, DemEventKind=DEM_EVENT_KIND_BSW
          DemEventClass:
            DemAgingAllowed = false
            DemConsiderPtoStatus = false
            DemEventDestination = DEM_DTC_ORIGIN_PRIMARY_MEMORY
            DemEventPriority = 2
            DemFFPrestorageSupported = false
            DemOperationCycleRef = PowerCycle
            DemDebounceAlgorithmClass
              DemDebounceCounterBased:
                DemDebounceBehavior = DEM_DEBOUNCE_FREEZE
                DemDebounceCounterDecrementStepSize = 1
                DemDebounceCounterFailedThreshold = 127
                DemDebounceCounterIncrementStepSize = 1
                DemDebounceCounterJumpDown = true
                DemDebounceCounterJumpDownValue = 0
                DemDebounceCounterJumpUp = true
                DemDebounceCounterJumpUpValue = 0
                DemDebounceCounterPassedThreshold = -128
                DemDebounceCounterStorage = false
                DemDebounceContinuous = false
        AutoCreatedDemEvent_NVM_E_VERIFY_FAILED: DemEventId=6, DemEventKind=DEM_EVENT_KIND_BSW
          DemEventClass:
            DemAgingAllowed = false
            DemConsiderPtoStatus = false
            DemEventDestination = DEM_DTC_ORIGIN_PRIMARY_MEMORY
            DemEventPriority = 2
            DemFFPrestorageSupported = false
            DemOperationCycleRef = PowerCycle
            DemDebounceAlgorithmClass
              DemDebounceCounterBased:
                DemDebounceBehavior = DEM_DEBOUNCE_FREEZE
                DemDebounceCounterDecrementStepSize = 1
                DemDebounceCounterFailedThreshold = 127
                DemDebounceCounterIncrementStepSize = 1
                DemDebounceCounterJumpDown = true
                DemDebounceCounterJumpDownValue = 0
                DemDebounceCounterJumpUp = true
                DemDebounceCounterJumpUpValue = 0
                DemDebounceCounterPassedThreshold = -128
                DemDebounceCounterStorage = false
                DemDebounceContinuous = false
        AutoCreatedDemEvent_NVM_E_WRITE_PROTECTED: DemEventId=7, DemEventKind=DEM_EVENT_KIND_BSW
          DemEventClass:
            DemAgingAllowed = false
            DemConsiderPtoStatus = false
            DemEventDestination = DEM_DTC_ORIGIN_PRIMARY_MEMORY
            DemEventPriority = 2
            DemFFPrestorageSupported = false
            DemOperationCycleRef = PowerCycle
            DemDebounceAlgorithmClass
              DemDebounceCounterBased:
                DemDebounceBehavior = DEM_DEBOUNCE_FREEZE
                DemDebounceCounterDecrementStepSize = 1
                DemDebounceCounterFailedThreshold = 127
                DemDebounceCounterIncrementStepSize = 1
                DemDebounceCounterJumpDown = true
                DemDebounceCounterJumpDownValue = 0
                DemDebounceCounterJumpUp = true
                DemDebounceCounterJumpUpValue = 0
                DemDebounceCounterPassedThreshold = -128
                DemDebounceCounterStorage = false
                DemDebounceContinuous = false
        AutoCreatedDemEvent_NVM_E_WRONG_BLOCK_ID: DemEventId=8, DemEventKind=DEM_EVENT_KIND_BSW
          DemEventClass:
            DemAgingAllowed = false
            DemConsiderPtoStatus = false
            DemEventDestination = DEM_DTC_ORIGIN_PRIMARY_MEMORY
            DemEventPriority = 2
            DemFFPrestorageSupported = false
            DemOperationCycleRef = PowerCycle
            DemDebounceAlgorithmClass
              DemDebounceCounterBased:
                DemDebounceBehavior = DEM_DEBOUNCE_FREEZE
                DemDebounceCounterDecrementStepSize = 1
                DemDebounceCounterFailedThreshold = 127
                DemDebounceCounterIncrementStepSize = 1
                DemDebounceCounterJumpDown = true
                DemDebounceCounterJumpDownValue = 0
                DemDebounceCounterJumpUp = true
                DemDebounceCounterJumpUpValue = 0
                DemDebounceCounterPassedThreshold = -128
                DemDebounceCounterStorage = false
                DemDebounceContinuous = false
        AutoCreatedDemEvent_EcuMConfiguration_ECUM_E_CONFIGURATION_DATA_INCONSISTENT: DemEventId=9, DemEventKind=DEM_EVENT_KIND_BSW
          DemEventClass:
            DemAgingAllowed = false
            DemConsiderPtoStatus = false
            DemEventDestination = DEM_DTC_ORIGIN_PRIMARY_MEMORY
            DemEventPriority = 2
            DemFFPrestorageSupported = false
            DemOperationCycleRef = PowerCycle
            DemDebounceAlgorithmClass
              DemDebounceCounterBased:
                DemDebounceBehavior = DEM_DEBOUNCE_FREEZE
                DemDebounceCounterDecrementStepSize = 1
                DemDebounceCounterFailedThreshold = 127
                DemDebounceCounterIncrementStepSize = 1
                DemDebounceCounterJumpDown = true
                DemDebounceCounterJumpDownValue = 0
                DemDebounceCounterJumpUp = true
                DemDebounceCounterJumpUpValue = 0
                DemDebounceCounterPassedThreshold = -128
                DemDebounceCounterStorage = false
                DemDebounceContinuous = false
        AutoCreatedDemEvent_EcuMConfiguration_ECUM_E_RAM_CHECK_FAILED: DemEventId=10, DemEventKind=DEM_EVENT_KIND_BSW
          DemEventClass:
            DemAgingAllowed = false
            DemConsiderPtoStatus = false
            DemEventDestination = DEM_DTC_ORIGIN_PRIMARY_MEMORY
            DemEventPriority = 2
            DemFFPrestorageSupported = false
            DemOperationCycleRef = PowerCycle
            DemDebounceAlgorithmClass
              DemDebounceCounterBased:
                DemDebounceBehavior = DEM_DEBOUNCE_FREEZE
                DemDebounceCounterDecrementStepSize = 1
                DemDebounceCounterFailedThreshold = 127
                DemDebounceCounterIncrementStepSize = 1
                DemDebounceCounterJumpDown = true
                DemDebounceCounterJumpDownValue = 0
                DemDebounceCounterJumpUp = true
                DemDebounceCounterJumpUpValue = 0
                DemDebounceCounterPassedThreshold = -128
                DemDebounceCounterStorage = false
                DemDebounceContinuous = false
        AutoCreatedDemEvent_EcuMConfiguration_ECUM_E_ALL_RUN_REQUESTS_KILLED: DemEventId=11, DemEventKind=DEM_EVENT_KIND_BSW
          DemEventClass:
            DemAgingAllowed = false
            DemConsiderPtoStatus = false
            DemEventDestination = DEM_DTC_ORIGIN_PRIMARY_MEMORY
            DemEventPriority = 2
            DemFFPrestorageSupported = false
            DemOperationCycleRef = PowerCycle
            DemDebounceAlgorithmClass
              DemDebounceCounterBased:
                DemDebounceBehavior = DEM_DEBOUNCE_FREEZE
                DemDebounceCounterDecrementStepSize = 1
                DemDebounceCounterFailedThreshold = 127
                DemDebounceCounterIncrementStepSize = 1
                DemDebounceCounterJumpDown = true
                DemDebounceCounterJumpDownValue = 0
                DemDebounceCounterJumpUp = true
                DemDebounceCounterJumpUpValue = 0
                DemDebounceCounterPassedThreshold = -128
                DemDebounceCounterStorage = false
                DemDebounceContinuous = false
        AutoCreatedDemEvent_EcuMConfiguration_ECUM_E_IMPROPER_CALLER: DemEventId=12, DemEventKind=DEM_EVENT_KIND_BSW
          DemEventClass:
            DemAgingAllowed = false
            DemConsiderPtoStatus = false
            DemEventDestination = DEM_DTC_ORIGIN_PRIMARY_MEMORY
            DemEventPriority = 2
            DemFFPrestorageSupported = false
            DemOperationCycleRef = PowerCycle
            DemDebounceAlgorithmClass
              DemDebounceCounterBased:
                DemDebounceBehavior = DEM_DEBOUNCE_FREEZE
                DemDebounceCounterDecrementStepSize = 1
                DemDebounceCounterFailedThreshold = 127
                DemDebounceCounterIncrementStepSize = 1
                DemDebounceCounterJumpDown = true
                DemDebounceCounterJumpDownValue = 0
                DemDebounceCounterJumpUp = true
                DemDebounceCounterJumpUpValue = 0
                DemDebounceCounterPassedThreshold = -128
                DemDebounceCounterStorage = false
                DemDebounceContinuous = false
        DTC_0x000002: DemEventKind=DEM_EVENT_KIND_SWC, DemEventId=2, DemMaxNumberFreezeFrameRecords=1, DemDTCClassRef=DTCClass_DTC_0x000002, DemExtendedDataClassRef=ExtendedDataClass_4f5344cd
          DemEventClass:
            DemAgingAllowed = false
            DemAgingCycleCounterThreshold = 1
            DemEventDestination = DEM_DTC_ORIGIN_PRIMARY_MEMORY
            DemEventPriority = 2
            DemConsiderPtoStatus = false
            DemFFPrestorageSupported = false
            DemAgingCycleRef = IgnitionCycle
            DemOperationCycleRef = IgnitionCycle
            DemDebounceAlgorithmClass
              DemDebounceCounterBased:
                DemDebounceCounterDecrementStepSize = 1
                DemDebounceCounterIncrementStepSize = 1
                DemDebounceCounterJumpDown = false
                DemDebounceCounterJumpUp = true
                DemDebounceBehavior = DEM_DEBOUNCE_FREEZE
                DemDebounceCounterFailedThreshold = 127
                DemDebounceCounterJumpDownValue = 0
                DemDebounceCounterJumpUpValue = 0
                DemDebounceCounterPassedThreshold = -128
                DemDebounceCounterStorage = false
                DemDebounceContinuous = false
      DTCClass_DTC_0x000002 (DemDTCClass): DemUdsDTC=2, DemImmediateNvStorage=false
  module config Dcm: implementation-config-variant=VARIANT-PRE-COMPILE, module-description=Dcm_Impl
    DcmConfigSet
      DcmDsl
        DcmDslProtocol
          DcmDslProtocolRow:
            DcmDslProtocolID = DCM_UDS_ON_CAN
            DcmDslProtocolPriority = 0
            DcmSendRespPendOnTransToBoot = true
            DcmTimStrP2ServerAdjust = 0
            DcmTimStrP2StarServerAdjust = 0
            DcmDslProtocolRxBufferID = DcmDslBuffer
            DcmDslProtocolSIDTable = DcmDsdServiceTable
            DcmDslProtocolTxBufferID = DcmDslBuffer
            TN_Tester_CAN00_CAN (DcmDslConnection)
              DcmDslMainConnection: DcmDslProtocolRxTesterSourceAddr=0
                PT_msg_diag_RequestGlobal_PP_msg_diag_RequestGlobal_Rx_0fb271d2_5e566ad9 (DcmDslProtocolRx):
                  DcmDslProtocolRxAddrType = DCM_FUNCTIONAL_TYPE
                  DcmDslProtocolRxPduId = 0
                  DcmDslProtocolRxComMChannelRef = ComMConfigSet/CAN00_f26020e5
                  DcmDslProtocolRxPduRef = EcucPduCollection/PT_msg_diag_RequestGlobal_PP_msg_diag_RequestGlobal_Rx_0fb271d2_5e566ad9
                PT_msg_diag_Response_MyECU_PP_msg_diag_Response_MyECU_Tx_0fb271d2_5e566ad9 (DcmDslProtocolTx):
                  DcmDslTxConfirmationPduId = 0
                  DcmDslProtocolTxPduRef = EcucPduCollection/PT_msg_diag_Response_MyECU_PP_msg_diag_Response_MyECU_Tx_0fb271d2_5e566ad9
                PT_msg_diag_Request_MyECU_PP_msg_diag_Request_MyECU_Rx_0fb271d2_5e566ad9 (DcmDslProtocolRx):
                  DcmDslProtocolRxAddrType = DCM_PHYSICAL_TYPE
                  DcmDslProtocolRxPduId = 1
                  DcmDslProtocolRxComMChannelRef = ComMConfigSet/CAN00_f26020e5
                  DcmDslProtocolRxPduRef = EcucPduCollection/PT_msg_diag_Request_MyECU_PP_msg_diag_Request_MyECU_Rx_0fb271d2_5e566ad9
        DcmDslDiagResp: DcmDslDiagRespOnSecondDeclinedRequest=false, DcmDslDiagRespMaxNumOfDeclinedRequests=3
        DcmDslBuffer: DcmDslBufferSize=50
      DcmGeneral:
        DcmDevErrorDetect = true
        DcmRequestManufacturerNotificationEnabled = false
        DcmRequestSupplierNotificationEnabled = false
        DcmRespondAllRequest = true
        DcmTaskTime = 0.01
        DcmVersionInfoApi = false
        DcmDspDataDefaultEndianness = LITTLE_ENDIAN
        DcmFinalResponseToFblEnabled = false
        DcmResetToFblAfterSessionFinalResposeEnabled = false
      DcmDsd
        DcmDsdServiceTable
          9 x DcmDsdService:
            ClearDiagInfo: DcmDsdSidTabServiceId=20, DcmDsdSidTabSubfuncAvail=false
            ReadDtcInfo: DcmDsdSidTabServiceId=25, DcmDsdSidTabSubfuncAvail=true
              3 x DcmDsdSubService:
                RDTCEDRBDN: DcmDsdSubServiceId=6
                RDTCBSM: DcmDsdSubServiceId=2
                RNODTCBSM: DcmDsdSubServiceId=1
            EcuReset: DcmDsdSidTabServiceId=17, DcmDsdSidTabSubfuncAvail=true
              Hard (DcmDsdSubService): DcmDsdSubServiceId=1
            WriteDataById: DcmDsdSidTabServiceId=46, DcmDsdSidTabSubfuncAvail=false
            TesterPresent: DcmDsdSidTabServiceId=62, DcmDsdSidTabSubfuncAvail=true
              TesterPresent (DcmDsdSubService): DcmDsdSubServiceId=0
            ControlDtcSetting: DcmDsdSidTabServiceId=133, DcmDsdSidTabSubfuncAvail=true
              Disable (DcmDsdSubService): DcmDsdSubServiceId=2
              Enable (DcmDsdSubService): DcmDsdSubServiceId=1
            ReadDataById: DcmDsdSidTabServiceId=34, DcmDsdSidTabSubfuncAvail=false
            SecurityAccess: DcmDsdSidTabServiceId=39, DcmDsdSidTabSubfuncAvail=true, DcmDsdSidTabSessionLevelRef=DcmDspSession/Programming, DcmDsdSidTabSessionLevelRef=DcmDspSession/Extended
              Seed_Level1_Request (DcmDsdSubService): DcmDsdSubServiceId=1, DcmDsdSubServiceSessionLevelRef=DcmDspSession/Programming, DcmDsdSubServiceSessionLevelRef=DcmDspSession/Extended
              Level1_1_Send (DcmDsdSubService): DcmDsdSubServiceId=2, DcmDsdSubServiceSessionLevelRef=DcmDspSession/Programming, DcmDsdSubServiceSessionLevelRef=DcmDspSession/Extended
            DiagSessionControl: DcmDsdSidTabServiceId=16, DcmDsdSidTabSubfuncAvail=true
              3 x DcmDsdSubService:
                Programming: DcmDsdSubServiceId=2, DcmDsdSubServiceSessionLevelRef=DcmDspSession/Programming, DcmDsdSubServiceSessionLevelRef=DcmDspSession/Extended
                Default: DcmDsdSubServiceId=1
                Extended: DcmDsdSubServiceId=3
      DcmDsp: DcmDspMaxDidToRead=5
        Diag_RWDI_LightOnOffCounter (DcmDspDid): DcmDspDidIdentifier=4096, DcmDspDidUsed=true, DcmDspDidInfoRef=DidInfo_Diag_RWDI_LightOnOffCounter
          LightOnOffCounter_Value (DcmDspDidSignal): DcmDspDidDataPos=0, DcmDspDidDataRef=Diag_RWDI_LightOnOffCounter_LightOnOffCounter_Value
        DidInfo_Diag_RWDI_LightOnOffCounter (DcmDspDidInfo)
          DcmDspDidAccess
            DcmDspDidWrite
            DcmDspDidRead
        DcmDspControlDTCSetting: DcmSupportDTCSettingControlOptionRecord=true
        DataInfo_Diag_RWDI_LightOnOffCounter_LightOnOffCounter_Value (DcmDspDataInfo): DcmDspDataFixedLength=true
        DcmDspSession
          3 x DcmDspSessionRow, all with DcmDspSessionP2ServerMax=0.05, DcmDspSessionP2StarServerMax=5, DcmDspSessionForBoot=DCM_NO_BOOT:
            Default: DcmDspSessionLevel=1
            Programming: DcmDspSessionLevel=2
            Extended: DcmDspSessionLevel=3
        Diag_RWDI_LightOnOffCounter_LightOnOffCounter_Value (DcmDspData):
          DcmDspDataSize = 32
          DcmDspDataType = UINT32
          DcmDspDataUsePort = USE_DATA_ASYNCH_CLIENT_SERVER
          DcmDspDataInfoRef = DataInfo_Diag_RWDI_LightOnOffCounter_LightOnOffCounter_Value
        DcmDspSecurity
          Level_01 (DcmDspSecurityRow):
            DcmDspSecurityDelayTime = 10
            DcmDspSecurityDelayTimeOnBoot = 0
            DcmDspSecurityKeySize = 2
            DcmDspSecurityLevel = 1
            DcmDspSecurityNumAttDelay = 3
            DcmDspSecuritySeedSize = 2
            DcmDspSecurityAttemptCounterEnabled = false
            DcmDspSecurityUsePort = USE_ASYNCH_CLIENT_SERVER
          Locked (DcmDspSecurityRow):
            DcmDspSecurityLevel = 0
            DcmDspSecurityAttemptCounterEnabled = false
            DcmDspSecurityDelayTime = 0
            DcmDspSecurityDelayTimeOnBoot = 0
            DcmDspSecurityKeySize = 4
            DcmDspSecurityNumAttDelay = 0
            DcmDspSecuritySeedSize = 4
            DcmDspSecurityUsePort = USE_ASYNCH_CLIENT_SERVER
      DcmPageBufferCfg: DcmPagedBufferEnabled=true
  module config CanTp: implementation-config-variant=VARIANT-PRE-COMPILE, module-description=CanTp_Impl
    CanTpGeneral:
      CanTpChangeParameterApi = false
      CanTpDevErrorDetect = true
      CanTpPaddingByte = 204
      CanTpReadParameterApi = false
      CanTpVersionInfoApi = false
      CanTpPaddingActive = true
      CanTpHavePaddingByte = false
      CanTpNumRxChannels = 0
      CanTpNumTxChannels = 0
      CanTpEnableSplitMainFunction = false
      CanTpSupportStandardAddressing = true
      CanTpSupportExtendedAddressing = false
      CanTpSupportMixed11Addressing = false
      CanTpOnlyNotifyInformedAppl = true
      CanTpRc = false
      CanTpTc = false
      CanTpEnableSynchronousTransmit = true
    CanTpConfig: CanTpMainFunctionPeriod=0.005
      TPCH_80c7e927 (CanTpChannel): CanTpChannelMode=CANTP_MODE_FULL_DUPLEX
        RxNSdu_80c7e927 (CanTpRxNSdu):
          CanTpRxAddressingFormat = CANTP_STANDARD
          CanTpRxDl = 8
          CanTpRxTaType = CANTP_FUNCTIONAL
          CanTpNbr = 0.1
          CanTpRxNSduId = 0
          CanTpRxPaddingActivation = CANTP_ON
          CanTpRxNSduRef = EcucPduCollection/PT_msg_diag_RequestGlobal_PP_msg_diag_RequestGlobal_Rx_0fb271d2_5e566ad9
          CanTpRxNPdu_f2ee9cdf (CanTpRxNPdu): CanTpRxNPduId=1, CanTpRxNPduRef=msg_diag_RequestGlobal_Tp_4e10fc23
      TPCH_6aef5f8e (CanTpChannel): CanTpChannelMode=CANTP_MODE_FULL_DUPLEX
        RxNSdu_bd8e3c3d (CanTpRxNSdu):
          CanTpRxAddressingFormat = CANTP_STANDARD
          CanTpRxDl = 8
          CanTpRxTaType = CANTP_PHYSICAL
          CanTpNbr = 0.1
          CanTpRxNSduId = 1
          CanTpRxPaddingActivation = CANTP_ON
          CanTpBs = 8
          CanTpNar = 0.1
          CanTpNcr = 0.5
          CanTpRxWftMax = 15
          CanTpSTmin = 0.02
          CanTpRxNSduRef = EcucPduCollection/PT_msg_diag_Request_MyECU_PP_msg_diag_Request_MyECU_Rx_0fb271d2_5e566ad9
          CanTpTxFcNPdu_f602b9fe (CanTpTxFcNPdu): CanTpTxFcNPduConfirmationPduId=0, CanTpTxFcNPduRef=msg_diag_Response_MyECU_Tp_4167da22
          CanTpRxNPdu_f602b9fe (CanTpRxNPdu): CanTpRxNPduId=0, CanTpRxNPduRef=msg_diag_Request_MyECU_Tp_fec7ea51
        TxNSdu_6aef5f8e (CanTpTxNSdu):
          CanTpTxAddressingFormat = CANTP_STANDARD
          CanTpTxDl = 8
          CanTpTxTaType = CANTP_PHYSICAL
          CanTpNas = 0.1
          CanTpNcs = 0.2
          CanTpTc = false
          CanTpTxNSduId = 0
          CanTpTxPaddingActivation = CANTP_ON
          CanTpNbs = 0.5
          CanTpTxNSduRef = EcucPduCollection/PT_msg_diag_Response_MyECU_PP_msg_diag_Response_MyECU_Tx_0fb271d2_5e566ad9
          CanTpTxNPdu_276b19be (CanTpTxNPdu): CanTpTxNPduConfirmationPduId=0, CanTpTxNPduRef=msg_diag_Response_MyECU_Tp_4167da22
          CanTpRxFcNPdu_276b19be (CanTpRxFcNPdu): CanTpRxFcNPduId=0, CanTpRxFcNPduRef=msg_diag_Request_MyECU_Tp_fec7ea51

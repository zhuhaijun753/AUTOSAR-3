AUTOSAR XML (schema 4-2-1)
package /InitialEcuC
  ecuc value collection InitialEcuC: ecuc-values=[Can, CanIf, CanNm, CanSM, CanTp, Com, ComM, Dcm, Dem, EcuC, EcuM, Nm, PduR]
  module config Can
    CanConfigSet
      CT_CAN00_e98c47e6 (CanController)
        CanControllerBaudrateConfig
    CanGeneral: CanIndex=0
  module config CanIf
    CanIfCtrlDrvCfg: CanIfCtrlDrvInitHohConfigRef=CanIfInitHohCfg, CanIfCtrlDrvNameRef=CanGeneral
      CT_CAN00_e98c47e6 (CanIfCtrlCfg): CanIfCtrlCanCtrlRef=CanConfigSet/CT_CAN00_e98c47e6
    CanIfInitCfg
      4 x CanIfRxPduCfg, all with CanIfRxPduCanIdType=STANDARD_CAN:
        MyECU_5faa4e95_NMCanIDRange: CanIfRxPduRef=MyECU_NmRxPdu_5faa4e95
          CHNL (CanIfRxPduCanIdRange): CanIfRxPduCanIdRangeLowerCanId=1024, CanIfRxPduCanIdRangeUpperCanId=1087
        msg_Receive_oCAN00_Rx_3abd61be: CanIfRxPduCanId=528, CanIfRxPduRef=msg_Receive_ff2f8fca
        msg_diag_RequestGlobal_Tp_oCAN00_Rx_3abd61be: CanIfRxPduCanId=1556, CanIfRxPduRef=msg_diag_RequestGlobal_Tp_4e10fc23
        msg_diag_Request_MyECU_Tp_oCAN00_Rx_3abd61be: CanIfRxPduCanId=1552, CanIfRxPduRef=msg_diag_Request_MyECU_Tp_fec7ea51
      3 x CanIfTxPduCfg, all with CanIfTxPduCanIdType=STANDARD_CAN:
        msg_Transmit_oCAN00_Tx_3abd61be: CanIfTxPduCanId=512, CanIfTxPduRef=msg_Transmit_ca20852c
        msg_diag_Response_MyECU_Tp_oCAN00_Tx_3abd61be: CanIfTxPduCanId=1554, CanIfTxPduRef=msg_diag_Response_MyECU_Tp_4167da22
        msg_nm_MyECU_oCAN00_Tx_3abd61be: CanIfTxPduCanId=1024, CanIfTxPduRef=msg_nm_MyECU_5fb848b3
    CanIfPrivateCfg
    CanIfPublicCfg: CanIfPublicPnSupport=false
  module config CanNm
    CanNmGlobalConfig: CanNmComUserDataSupport=false, CanNmPnEiraCalcEnabled=false, CanNmUserDataEnabled=true
      CAN00_CAN_17d0077e (CanNmChannelConfig):
        CanNmMsgCycleTime = 0.1
        CanNmMsgReducedTime = 0.05
        CanNmRepeatMessageTime = 0.4
        CanNmTimeoutTime = 1
        CanNmUserDataLength = 6
        CanNmWaitBusSleepTime = 0.75
        CanNmComMNetworkHandleRef = ComMConfigSet/CAN00_f26020e5
        CAN00_CAN_17d0077e_RxPdu_2d241a48 (CanNmRxPdu): CanNmRxPduRef=MyECU_NmRxPdu_5faa4e95
        msg_nm_MyECU_oCAN00_3abd61be (CanNmTxPdu): CanNmTxPduRef=msg_nm_MyECU_5fb848b3
  module config CanSM
    CanSMConfiguration
      CHNL_f276589c (CanSMManagerNetwork): CanSMComMNetworkHandleRef=ComMConfigSet/CAN00_f26020e5
        CT_CAN00_e98c47e6 (CanSMController): CanSMControllerId=CanIfCtrlDrvCfg/CT_CAN00_e98c47e6
  module config CanTp
    CanTpConfig: CanTpMainFunctionPeriod=0.005
      TPCH_6aef5f8e (CanTpChannel): CanTpChannelMode=CANTP_MODE_FULL_DUPLEX
        RxNSdu_bd8e3c3d (CanTpRxNSdu):
          CanTpRxAddressingFormat = CANTP_STANDARD
          CanTpRxDl = 8
          CanTpRxTaType = CANTP_PHYSICAL
          CanTpRxNSduRef = EcucPduCollection/PT_msg_diag_Request_MyECU_PP_msg_diag_Request_MyECU_Rx_0fb271d2_5e566ad9
          CanTpRxNPdu_f602b9fe (CanTpRxNPdu): CanTpRxNPduRef=msg_diag_Request_MyECU_Tp_fec7ea51
          CanTpTxFcNPdu_f602b9fe (CanTpTxFcNPdu): CanTpTxFcNPduRef=msg_diag_Response_MyECU_Tp_4167da22
        TxNSdu_6aef5f8e (CanTpTxNSdu):
          CanTpTxAddressingFormat = CANTP_STANDARD
          CanTpTxDl = 8
          CanTpTxTaType = CANTP_PHYSICAL
          CanTpTxNSduRef = EcucPduCollection/PT_msg_diag_Response_MyECU_PP_msg_diag_Response_MyECU_Tx_0fb271d2_5e566ad9
          CanTpRxFcNPdu_276b19be (CanTpRxFcNPdu): CanTpRxFcNPduRef=msg_diag_Request_MyECU_Tp_fec7ea51
          CanTpTxNPdu_276b19be (CanTpTxNPdu): CanTpTxNPduRef=msg_diag_Response_MyECU_Tp_4167da22
      TPCH_80c7e927 (CanTpChannel): CanTpChannelMode=CANTP_MODE_FULL_DUPLEX
        RxNSdu_80c7e927 (CanTpRxNSdu):
          CanTpRxAddressingFormat = CANTP_STANDARD
          CanTpRxDl = 8
          CanTpRxTaType = CANTP_FUNCTIONAL
          CanTpRxNSduRef = EcucPduCollection/PT_msg_diag_RequestGlobal_PP_msg_diag_RequestGlobal_Rx_0fb271d2_5e566ad9
          CanTpRxNPdu_f2ee9cdf (CanTpRxNPdu): CanTpRxNPduRef=msg_diag_RequestGlobal_Tp_4e10fc23
  module config Com
    ComConfig
      msg_Receive_oCAN00_In (ComIPdu):
        ComIPduDirection = RECEIVE
        ComIPduType = NORMAL
        ComIPduGroupRef = MyECU_oCAN00_Rx_fcef2243
        ComIPduSignalRef = sig_State_RearInteriorLight_In
        ComIPduSignalRef = sig_State_RearLeftDoor_In
        ComIPduSignalRef = sig_State_RearRightDoor_In
        ComPduIdRef = msg_Receive_ff2f8fca
      msg_Transmit_oCAN00_Out (ComIPdu):
        ComIPduDirection = SEND
        ComIPduType = NORMAL
        ComIPduGroupRef = MyECU_oCAN00_Tx_fcef2243
        ComIPduSignalRef = sig_RearInteriorLight_Out
        ComPduIdRef = msg_Transmit_ca20852c
        ComTxIPdu: ComMinimumDelayTime=0, ComTxIPduUnusedAreasDefault=0
          ComTxModeFalse
            ComTxMode: ComTxModeMode=PERIODIC, ComTxModeTimeOffset=0, ComTxModeTimePeriod=0.1
          ComTxModeTrue
            ComTxMode: ComTxModeMode=PERIODIC, ComTxModeTimeOffset=0, ComTxModeTimePeriod=0.1
      MyECU_oCAN00_Rx_fcef2243 (ComIPduGroup)
      MyECU_oCAN00_Tx_fcef2243 (ComIPduGroup)
      4 x ComSignal, all with ComBitSize=1, ComSignalEndianness=LITTLE_ENDIAN, ComSignalInitValue=0, ComTransferProperty=PENDING:
        sig_RearInteriorLight_Out: ComBitPosition=0, ComSystemTemplateSystemSignalRef=sig_RearInteriorLight
        sig_State_RearInteriorLight_In: ComBitPosition=2, ComSystemTemplateSystemSignalRef=sig_State_RearInteriorLight
        sig_State_RearLeftDoor_In: ComBitPosition=0, ComSystemTemplateSystemSignalRef=sig_State_RearLeftDoor
        sig_State_RearRightDoor_In: ComBitPosition=1, ComSystemTemplateSystemSignalRef=sig_State_RearRightDoor
    ComGeneral
  module config ComM
    ComMConfigSet
      CAN00_f26020e5 (ComMChannel): ComMBusType=COMM_BUS_TYPE_CAN
        ComMNetworkManagement
        CHNL_f276589c (ComMUserPerChannel)
    ComMGeneral: ComMPncIdCounting=COMM_PNC_ID_COUNT_FROM_NM_MESSAGE
  module config Dcm
    DcmConfigSet
      DcmDsl
        DcmDslProtocol
          DcmDslProtocolRow
            TN_Tester_CAN00_CAN (DcmDslConnection)
              DcmDslMainConnection
                PT_msg_diag_RequestGlobal_PP_msg_diag_RequestGlobal_Rx_0fb271d2_5e566ad9 (DcmDslProtocolRx):
                  DcmDslProtocolRxAddrType = DCM_FUNCTIONAL_TYPE
                  DcmDslProtocolRxComMChannelRef = ComMConfigSet/CAN00_f26020e5
                  DcmDslProtocolRxPduRef = EcucPduCollection/PT_msg_diag_RequestGlobal_PP_msg_diag_RequestGlobal_Rx_0fb271d2_5e566ad9
                PT_msg_diag_Request_MyECU_PP_msg_diag_Request_MyECU_Rx_0fb271d2_5e566ad9 (DcmDslProtocolRx):
                  DcmDslProtocolRxAddrType = DCM_PHYSICAL_TYPE
                  DcmDslProtocolRxComMChannelRef = ComMConfigSet/CAN00_f26020e5
                  DcmDslProtocolRxPduRef = EcucPduCollection/PT_msg_diag_Request_MyECU_PP_msg_diag_Request_MyECU_Rx_0fb271d2_5e566ad9
                PT_msg_diag_Response_MyECU_PP_msg_diag_Response_MyECU_Tx_0fb271d2_5e566ad9 (DcmDslProtocolTx): DcmDslProtocolTxPduRef=EcucPduCollection/PT_msg_diag_Response_MyECU_PP_msg_diag_Response_MyECU_Tx_0fb271d2_5e566ad9
      DcmDsd
        DcmDsdServiceTable
          9 x DcmDsdService:
            DiagSessionControl: DcmDsdSidTabServiceId=16, DcmDsdSidTabSubfuncAvail=true
              3 x DcmDsdSubService:
                Default: DcmDsdSubServiceId=1
                Programming: DcmDsdSubServiceId=2, DcmDsdSubServiceSessionLevelRef=DcmDspSession/Programming, DcmDsdSubServiceSessionLevelRef=DcmDspSession/Extended
                Extended: DcmDsdSubServiceId=3
            EcuReset: DcmDsdSidTabServiceId=17, DcmDsdSidTabSubfuncAvail=true
              Hard (DcmDsdSubService): DcmDsdSubServiceId=1
            ClearDiagInfo: DcmDsdSidTabServiceId=20, DcmDsdSidTabSubfuncAvail=false
            ReadDtcInfo: DcmDsdSidTabServiceId=25, DcmDsdSidTabSubfuncAvail=true
              3 x DcmDsdSubService:
                RDTCBSM: DcmDsdSubServiceId=2
                RNODTCBSM: DcmDsdSubServiceId=1
                RDTCEDRBDN: DcmDsdSubServiceId=6
            ReadDataById: DcmDsdSidTabServiceId=34, DcmDsdSidTabSubfuncAvail=false
            SecurityAccess: DcmDsdSidTabServiceId=39, DcmDsdSidTabSubfuncAvail=true, DcmDsdSidTabSessionLevelRef=DcmDspSession/Programming, DcmDsdSidTabSessionLevelRef=DcmDspSession/Extended
              Seed_Level1_Request (DcmDsdSubService): DcmDsdSubServiceId=1, DcmDsdSubServiceSessionLevelRef=DcmDspSession/Programming, DcmDsdSubServiceSessionLevelRef=DcmDspSession/Extended
              Level1_1_Send (DcmDsdSubService): DcmDsdSubServiceId=2, DcmDsdSubServiceSessionLevelRef=DcmDspSession/Programming, DcmDsdSubServiceSessionLevelRef=DcmDspSession/Extended
            WriteDataById: DcmDsdSidTabServiceId=46, DcmDsdSidTabSubfuncAvail=false
            TesterPresent: DcmDsdSidTabServiceId=62, DcmDsdSidTabSubfuncAvail=true
              TesterPresent (DcmDsdSubService): DcmDsdSubServiceId=0
            ControlDtcSetting: DcmDsdSidTabServiceId=133, DcmDsdSidTabSubfuncAvail=true
              Enable (DcmDsdSubService): DcmDsdSubServiceId=1
              Disable (DcmDsdSubService): DcmDsdSubServiceId=2
      DcmDsp: DcmDspMaxDidToRead=5
        Diag_RWDI_LightOnOffCounter_LightOnOffCounter_Value (DcmDspData): DcmDspDataSize=32, DcmDspDataType=UINT32, DcmDspDataInfoRef=DataInfo_Diag_RWDI_LightOnOffCounter_LightOnOffCounter_Value
        DataInfo_Diag_RWDI_LightOnOffCounter_LightOnOffCounter_Value (DcmDspDataInfo): DcmDspDataFixedLength=true
        Diag_RWDI_LightOnOffCounter (DcmDspDid): DcmDspDidIdentifier=4096, DcmDspDidInfoRef=DidInfo_Diag_RWDI_LightOnOffCounter
          LightOnOffCounter_Value (DcmDspDidSignal): DcmDspDidDataPos=0, DcmDspDidDataRef=Diag_RWDI_LightOnOffCounter_LightOnOffCounter_Value
        DidInfo_Diag_RWDI_LightOnOffCounter (DcmDspDidInfo)
          DcmDspDidAccess
            DcmDspDidRead
            DcmDspDidWrite
        DcmDspControlDTCSetting: DcmSupportDTCSettingControlOptionRecord=true
        DcmDspSecurity
          Locked (DcmDspSecurityRow): DcmDspSecurityLevel=0
          Level_01 (DcmDspSecurityRow):
            DcmDspSecurityDelayTime = 10
            DcmDspSecurityDelayTimeOnBoot = 0
            DcmDspSecurityKeySize = 2
            DcmDspSecurityLevel = 1
            DcmDspSecurityNumAttDelay = 3
            DcmDspSecuritySeedSize = 2
        DcmDspSession
          3 x DcmDspSessionRow, all with DcmDspSessionP2ServerMax=0.05, DcmDspSessionP2StarServerMax=5:
            Default: DcmDspSessionLevel=1
            Programming: DcmDspSessionLevel=2
            Extended: DcmDspSessionLevel=3
  module config Dem
    DemConfigSet
      DTCClass_DTC_0x000002 (DemDTCClass): DemUdsDTC=2
      DTC_0x000002 (DemEventParameter): DemDTCClassRef=DTCClass_DTC_0x000002, DemExtendedDataClassRef=ExtendedDataClass_4f5344cd
        DemEventClass:
          DemAgingAllowed = false
          DemAgingCycleCounterThreshold = 1
          DemEventDestination = DEM_DTC_ORIGIN_PRIMARY_MEMORY
          DemEventPriority = 2
          DemAgingCycleRef = IgnitionCycle
          DemOperationCycleRef = IgnitionCycle
          DemDebounceAlgorithmClass
            DemDebounceCounterBased: DemDebounceCounterDecrementStepSize=1, DemDebounceCounterIncrementStepSize=1, DemDebounceCounterJumpDown=false, DemDebounceCounterJumpUp=true
    DemGeneral:
      DemAgingCycleCounterProcessing = DEM_PROCESS_AGINGCTR_INTERN
      DemDebounceCounterBasedSupport = true
      DemDtcStatusAvailabilityMask = 121
      DemMaxNumberEventEntryMirror = 0
      DemPTOSupport = false
      ExtendedDataClass_4f5344cd (DemExtendedDataClass): DemExtendedDataRecordClassRef=OccurrenceCounter, DemExtendedDataRecordClassRef=OdometerValue
      OccurrenceCounter (DemExtendedDataRecordClass): DemExtendedDataRecordNumber=1, DemDataElementClassRef=OccurrenceCounter_OccurenceCounter/OccurrenceCounter_OccurenceCounter
      OdometerValue (DemExtendedDataRecordClass): DemExtendedDataRecordNumber=2, DemDataElementClassRef=OdometerValue_OdometerValue/OdometerValue_OdometerValue
      IgnitionCycle (DemOperationCycle): DemOperationCycleType=DEM_OPCYC_IGNITION
      PowerCycle (DemOperationCycle): DemOperationCycleType=DEM_OPCYC_POWER
      OccurrenceCounter_OccurenceCounter (DemDataElementClass)
        OccurrenceCounter_OccurenceCounter (DemExternalCSDataElementClass): DemDataElementDataSize=4, DemUseEventIdArgumentForCallback=false, DemDataElementStoreNonVolatile=true
      OdometerValue_OdometerValue (DemDataElementClass)
        OdometerValue_OdometerValue (DemExternalCSDataElementClass): DemDataElementDataSize=4, DemUseEventIdArgumentForCallback=false, DemDataElementStoreNonVolatile=true
  module config EcuC
    EcucPduCollection
      10 x Pdu:
        MyECU_NmRxPdu_5faa4e95: PduLength=8, SysTPduToFrameMappingRef=msg_nm_RearECU
        PT_msg_diag_RequestGlobal_PP_msg_diag_RequestGlobal_Rx_0fb271d2_5e566ad9: PduLength=7
        PT_msg_diag_Request_MyECU_PP_msg_diag_Request_MyECU_Rx_0fb271d2_5e566ad9: PduLength=8
        PT_msg_diag_Response_MyECU_PP_msg_diag_Response_MyECU_Tx_0fb271d2_5e566ad9: PduLength=8
        msg_Receive_ff2f8fca: PduLength=1, SysTPduToFrameMappingRef=msg_Receive
        msg_Transmit_ca20852c: PduLength=1, SysTPduToFrameMappingRef=msg_Transmit
        msg_diag_RequestGlobal_Tp_4e10fc23: PduLength=8, SysTPduToFrameMappingRef=msg_diag_RequestGlobal_Tp
        msg_diag_Request_MyECU_Tp_fec7ea51: PduLength=8, SysTPduToFrameMappingRef=msg_diag_Request_MyECU_Tp
        msg_diag_Response_MyECU_Tp_4167da22: PduLength=8, SysTPduToFrameMappingRef=msg_diag_Response_MyECU_Tp
        msg_nm_MyECU_5fb848b3: PduLength=8, SysTPduToFrameMappingRef=msg_nm_MyECU
  module config EcuM
    EcuMConfiguration
      EcuMCommonConfiguration
      EcuMFlexConfiguration: EcuMFlexModuleConfigurationRef=CanConfigSet
  module config Nm
    CAN00_f26020e5 (NmChannelConfig): NmComMChannelRef=ComMConfigSet/CAN00_f26020e5
      CAN00_CAN_17d0077e (NmBusType)
        NmStandardBusNmConfig: NmStandardBusType=NM_BUSNM_CANNM
    NmGlobalConfig
      NmGlobalFeatures: NmComUserDataSupport=false, NmNodeIdEnabled=true, NmUserDataEnabled=true
      NmGlobalProperties
  module config PduR
    4 x PduRBswModules:
      CanIf: PduRBswModuleRef=CanIf
      CanTp: PduRBswModuleRef=CanTp
      Com: PduRBswModuleRef=Com
      Dcm: PduRBswModuleRef=Dcm
    PduRGeneral
    PduRRoutingTables: PduRConfigurationId=0
      PduRRoutingTable
        5 x PduRRoutingPath:
          Can_PT_msg_Receive_0fb271d2_In
            DST_Can_PT_msg_Receive_0fb271d2_In (PduRDestPdu): PduRDestPduRef=msg_Receive_ff2f8fca
            SRC_Can_PT_msg_Receive_0fb271d2_In (PduRSrcPdu): PduRSrcPduRef=msg_Receive_ff2f8fca
          Can_PT_msg_Transmit_0fb271d2_Out
            DST_Can_PT_msg_Transmit_0fb271d2_Out (PduRDestPdu): PduRDestPduRef=msg_Transmit_ca20852c
            SRC_Can_PT_msg_Transmit_0fb271d2_Out (PduRSrcPdu): PduRSrcPduRef=msg_Transmit_ca20852c
          Can_PT_msg_diag_RequestGlobal_0fb271d2_In
            DST_Can_PT_msg_diag_RequestGlobal_0fb271d2_In (PduRDestPdu): PduRDestPduRef=EcucPduCollection/PT_msg_diag_RequestGlobal_PP_msg_diag_RequestGlobal_Rx_0fb271d2_5e566ad9
            SRC_Can_PT_msg_diag_RequestGlobal_0fb271d2_In (PduRSrcPdu): PduRSrcPduRef=EcucPduCollection/PT_msg_diag_RequestGlobal_PP_msg_diag_RequestGlobal_Rx_0fb271d2_5e566ad9
          Can_PT_msg_diag_Request_MyECU_0fb271d2_In
            DST_Can_PT_msg_diag_Request_MyECU_0fb271d2_In (PduRDestPdu): PduRDestPduRef=EcucPduCollection/PT_msg_diag_Request_MyECU_PP_msg_diag_Request_MyECU_Rx_0fb271d2_5e566ad9
            SRC_Can_PT_msg_diag_Request_MyECU_0fb271d2_In (PduRSrcPdu): PduRSrcPduRef=EcucPduCollection/PT_msg_diag_Request_MyECU_PP_msg_diag_Request_MyECU_Rx_0fb271d2_5e566ad9
          Can_PT_msg_diag_Response_MyECU_0fb271d2_Out
            DST_Can_PT_msg_diag_Response_MyECU_0fb271d2_Out (PduRDestPdu): PduRDestPduRef=EcucPduCollection/PT_msg_diag_Response_MyECU_PP_msg_diag_Response_MyECU_Tx_0fb271d2_5e566ad9
            SRC_Can_PT_msg_diag_Response_MyECU_0fb271d2_Out (PduRSrcPdu): PduRSrcPduRef=EcucPduCollection/PT_msg_diag_Response_MyECU_PP_msg_diag_Response_MyECU_Tx_0fb271d2_5e566ad9

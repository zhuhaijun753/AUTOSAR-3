AUTOSAR XML (schema 4-0-3)
package /MICROSAR/Det_ib_bswmd/BswModuleDescriptions
  bsw module description Det
    bsw internal behavior DetBehavior
      exclusive area DET_EXCLUSIVE_AREA_0  # Critical section to guarantee atomic handling of log buffer, requires global interrupt disabling.

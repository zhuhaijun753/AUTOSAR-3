AUTOSAR XML (schema 4-2-1)
package /ECUCompositionTypes
  composition sw component type ECU_Composition
package /EndToEndProtections
  end to end protection set EndToEndConnections
package /Systems
  system MyECU: category=SYSTEM_EXTRACT
    system mapping MyECU_MPPNG
    root-software-compositions:
      root sw composition prototype ECU_Composition: software-composition=ECU_Composition

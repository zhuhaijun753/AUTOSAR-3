AUTOSAR XML (schema 4-2-1)
package /ComponentTypes
  composition sw component type CtCoApplication
    4 x component:
      CpApMySwc: type=CtApMySwc
      CpSaDoorFrontLeft: type=CtSaDoor
      CpSaDoorFrontRight: type=CtSaDoor
      CpSaInteriorLightFront: type=CtSaInteriorLight
    connect CpApMySwc.PpLightStateFront -> CpSaInteriorLightFront.PpLightState
    connect CpSaDoorFrontLeft.PpDoorState -> CpApMySwc.PpDoorStateFrontLeft
    connect CpSaDoorFrontRight.PpDoorState -> CpApMySwc.PpDoorStateFrontRight

AUTOSAR XML (schema 4-0-3)
package /COM/VECTOR/CFG/WORKFLOW/SYSDESC/SYNC
  flat map FLATMAP
    7 x flat instance descriptor:
      ComponentPrototype: upstream-reference=ECU_Composition.CtCoApplication.CpSaInteriorLightFront, ecu-extract-reference=COMPOSITIONTYPE.CpSaInteriorLightFront
      ComponentPrototype_001: upstream-reference=ECU_Composition.CtCoApplication.CpSaDoorFrontRight, ecu-extract-reference=COMPOSITIONTYPE.CpSaDoorFrontRight
      ComponentPrototype_002: upstream-reference=ECU_Composition.CtCoApplication.CpSaDoorFrontLeft, ecu-extract-reference=COMPOSITIONTYPE.CpSaDoorFrontLeft
      ComponentPrototype_004: upstream-reference=ECU_Composition.CtCoApplication.CpApMySwc, ecu-extract-reference=COMPOSITIONTYPE.CpApMySwc
      AssemblySwConnector_001: ecu-extract-reference=CpApMySWCDPpLightStateFrontDCpSaInteriorLightFrontDPpLightState
      AssemblySwConnector_003: ecu-extract-reference=CpSaDoorFrontLeftDPpDoorStateDCpApMySWCDPpDoorStateFrontLeft
      AssemblySwConnector_004: ecu-extract-reference=CpSaDoorFrontRightDPpDoorStateDCpApMySWCDPpDoorStateFrontRight
